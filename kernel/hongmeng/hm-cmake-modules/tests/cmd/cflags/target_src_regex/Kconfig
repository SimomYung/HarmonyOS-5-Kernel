## kernel/kernel/hongmeng/hm-cmake-modules/tests/cmd/excludecflags/exclude_kasan_target/defconfig
```kconfig
CONFIG_HMBUILD_EXTRA_CFLAGS_BASE="-fsanitize=kernel-address -fasan-shadow-offset=0x66666000 --param asan-stack=1 --param asan-globals=1"
```

## kernel/kernel/hongmeng/hm-cmake-modules/tests/cmd/excludecflags/exclude_multi_src/Kconfig
```kconfig
# Copyright (c) Huawei Technologies Co., Ltd. 2022. All rights reserved.
# Description: Kconfig for testcase exclude_multi_src
# Author: Huawei OS Kernel Lab
# Create: Mon Jul 25 13:11:40 2022

source "$(HMCMAKENG_KCONFIG)"
```

## kernel/kernel/hongmeng/hm-cmake-modules/tests/cmd/excludecflags/exclude_project/Kconfig
```kconfig
# Copyright (c) Huawei Technologies Co., Ltd. 2022. All rights reserved.
# Description: Kconfig for test
# # Author: Huawei OS Kernel Lab
# # Create: Thu Jan 06 02:03:25 2022
#
# # HMCMAKENG_KCONFIG is injected by HongmengCMakeNG/Kconfig.cmake
# # which defines multiple config options which is useful for HMbuild.
source "$(HMCMAKENG_KCONFIG)"
```

## kernel/kernel/hongmeng/hm-cmake-modules/tests/cmd/excludecflags/exclude_src_regex/Kconfig
```kconfig
# Copyright (c) Huawei Technologies Co., Ltd. 2022. All rights reserved.
# Description: Kconfig for testcase exclude_src_regex
# Author: Huawei OS Kernel Lab
# Create: Sun Jul 24 21:34:51 2022

source "$(HMCMAKENG_KCONFIG)"
```

## kernel/kernel/hongmeng/hm-cmake-modules/tests/cmd/inclib/isystem/isystem_src_regex/Kconfig
```kconfig
# Copyright (c) Huawei Technologies Co., Ltd. 2022. All rights reserved.
# Description: Kconfig for testcase isystem_src_regex
# Author: Huawei OS Kernel Lab
# Create: Sun Jul 24 22:59:12 2022

source "$(HMCMAKENG_KCONFIG)"
```
