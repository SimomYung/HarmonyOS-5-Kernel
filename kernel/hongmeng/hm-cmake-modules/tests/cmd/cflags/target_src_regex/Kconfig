## kernel/hongmeng/hm-verif-kernel/uapps/devhost/backends/udk/Kconfig
```kconfig
comment "UDK Backend Settings"
source "$(HMCMAKENG_KCONFIG)"

source "Kconfig.legacy"
source "fusion/Kconfig"

config MODULE_SCHED_CLASS
	def_bool y

config COMPAT
	bool "Support for 32-bit applications at EL0"
	default n

config UDK_I2C
	bool "enable udk i2c"
	default n

config UDK_TTY
	bool "enable udk tty, only close in LDK+UDK mode"
	default y

config UDK_DMA_MEMPOOL_BITMAP
	hex "dma mempool order bitmap"
	default 0x1

config UDK_EXT
    bool "UDK EXT Support"
    help
        UDK framework has extension api. The driver could invoke
        customized extension fastcall provided by micro-kernel.
    default n

config UDK_SPI
	bool "enable udk spi"
	default n

config UDK_TIMER_PRECISION
	int "precision of udk timer(ms)"
	default 100

config UDK_FUSION
	bool "enable udk fusion"
	default n

config UDK_BLOCK_MQ
	bool "enable udk block multi queue"
	default n

config TRACEMGR
       bool "trace manager"
       default n

config NO_TRACEMGR
	def_bool !TRACEMGR

config MAS_BLK
	bool "MAS Block feature"
	depends on UDK_BLOCK_MQ
	default n
	help
		MAS Block feature

config MAS_DEBUG_FS
	bool "mas debug fs"
	depends on MAS_BLK
	default n

config MAS_BLK_BW_OPTIMIZE
	bool "Enlarge async inflight when dirty page flashing"
	depends on MAS_BLK
	default n

config MAS_MQ_USING_CP
	bool "MAS UFS Command Priority"
	depends on MAS_BLK
	default n
	help
		MAS UFS Command Priority, good for foreground APP's IO performance

config MAS_BKOPS
	bool "MAS BKOPS"
	depends on MAS_BLK
	default n
	help
		MAS BKOPS feature

# bd_types header file use this config, needs to keep the value consistent with other config
config HISI_INLINE_ENCRYPTION
	bool "Enable hisi inline encrypt"
	default n

config UDK_FALLBACK_ENCRYPTION
	bool "Enable udk fallback encrypt"
	default n

config MAS_BLK_NVME
	bool "nvme MAS Block feature"
	depends on MAS_BLK
	default n
	help
		nvme MAS Block feature
```

## kernel/hongmeng/hm-verif-kernel/uapps/devhost/configs/minimal_defconfig
```kconfig
# CONFIG_POSIX_CAPS is not set
# CONFIG_NET_IO_URING is not set
CONFIG_DEVHOST_BLK_SRING_LEN=2
CONFIG_NET_POOL_UNIT_BITS=11
# CONFIG_DEVHOST_ENTROPY_COLLECT is not set
# CONFIG_DEVHOST_PM_PLUGIN is not set
# CONFIG_DEVHOST_NETLINK is not set
```

## kernel/hongmeng/hm-verif-kernel/uapps/devhost/ldk_ext/fileguard/Kconfig
```kconfig
# Copyright (C) Huawei Technologies Co., Ltd. 2024. All rights reserved.
# Description: Kconfig for ldk extension
# Author: Huawei OS Kernel Lab
# Create: Sat Jun 08 11:54:30 2024

# HMCMAKENG_KCONFIG is injected by HongmengCMakeNG/Kconfig.cmake
# which defines multiple config options which is useful for HMbuild.

source "$(HMCMAKENG_KCONFIG)"
```

## kernel/hongmeng/hm-verif-kernel/uapps/devhost/ldk_ext/net_socket/Kconfig
```kconfig
# Copyright (C) Huawei Technologies Co., Ltd. 2022. All rights reserved.
# Description: Kconfig for ldk extension
# Author: Huawei OS Kernel Lab
# Create: Wed Jul 6 09:24:07 2022

# HMCMAKENG_KCONFIG is injected by HongmengCMakeNG/Kconfig.cmake
# which defines multiple config options which is useful for HMbuild.
source "$(HMCMAKENG_KCONFIG)"

config DEVHOST_NET_QIPCRTR
	bool "devhost support QMI socket family"
	default y

config DEVHOST_NET_INET
	bool "devhost support INET socket family"
	default n

config DEVHOST_NET_NETLINK
	bool "devhost support NETLINK socket family"
	default n

config DEVHOST_NET_PACKET
	bool "devhost support PACKET socket family"
	default n

config DEVHOST_NET_INET6
	bool "devhost support INET6 socket family"
	default n

config DEVHOST_NET_PPPOX
	bool "devhost support PPPOX socket family"
	default n

config DEVHOST_NET_XDP
	bool "devhost support XDP socket family"
	default n

config DEVHOST_NET_KEY
        bool "devhost support AF_KEY socket family"
        default n

config DEVHOST_NET_ALG
	bool "devhost support AF_ALG socket family"
	default n

config NET_FUSION
	bool "devhost support hmnetd in fusion mode"
	default n

config NET_NS
	bool "devhost support net namespace"
	default n
```

## kernel/hongmeng/hm-verif-kernel/uapps/devmgr/libs/Kconfig
```kconfig
# Copyright (c) Huawei Technologies Co., Ltd. 2022-2022. All rights reserved.
# Description: Kconfig for devmgr libs
# Author: Huawei OS Kernel Lab
# Create: Fri May 06 15:21:44 2022

source "$(HMCMAKENG_KCONFIG)"

choice
prompt "Target Arch"
default AARCH64
config ARM
bool "ARM"
config AARCH64
bool "AARCH64"
endchoice

config COMPAT
    bool "Support for 32-bit applications at EL0"
    default n
config NO_COMPAT
    def_bool !COMPAT

config AUDIT
    bool "audit support"
    default n

config MMIO_DISPATCHER
    bool "Enable hypervisor MMIO region dispatcher"
    default n

config CC_USE_CLANG
    bool "Use Clang as compiler"
    default n

config SHADOW_STACK
    bool "Enable aarch64 shadow stack"
    depends on AARCH64
    depends on !CC_USE_CLANG
    default n

config ILP32
    bool "Support for aarch64ilp32 applications at EL0"
    depends on AARCH64
    default n
    help
    This option enables support for the aarch64ilp32 EL0 apps running
    under 64-bit kernel and 64-bit servers.

config NO_ILP32
    def_bool !ILP32

config MODULE_SCHED_CLASS
    bool "Sched Class module"
    default y

config DEVMGR_NET_STACK
    bool "Enable net socket interface"
    default n

config SEHARMONY
  bool "Enable seharmony"
  default n

config HKIP
    bool "Enable HKIP Protection"
    default n
```
