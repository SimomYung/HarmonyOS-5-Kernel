## kernel/kernel/hongmeng/hm-cmake-modules/tests/cmd/include/include_src_regex/Kconfig
```kconfig
# Copyright (c) Huawei Technologies Co., Ltd. 2022. All rights reserved.
# Description: Kconfig for testcase include_src_regex
# Author: Huawei OS Kernel Lab
# Create: Sat Jul 23 22:56:59 2022

source "$(HMCMAKENG_KCONFIG)"
```

## kernel/kernel/hongmeng/hm-cmake-modules/tests/cmd/subdir/base/Kconfig
```kconfig
# Copyright (c) Huawei Technologies Co., Ltd. 2022. All rights reserved.
# Description: Kconfig for subdir_base_test
# Author: Huawei OS Kernel Lab
# Create: Mon Mar 21 10:23:46 2022

source "$(HMCMAKENG_KCONFIG)"
```

## kernel/kernel/hongmeng/hm-cmake-modules/tests/cmd/subdir/multilayer/Kconfig
```kconfig
# Copyright (c) Huawei Technologies Co., Ltd. 2022. All rights reserved.
# Description: Kconfig for subdir_multilayer_test
# Author: Huawei OS Kernel Lab
# Create: Mon Mar 21 11:09:38 2022

source "$(HMCMAKENG_KCONFIG)"
```

## kernel/kernel/hongmeng/hm-cmake-modules/tests/kconfig/source_test/Kconfig
```kconfig
# Copyright (c) Huawei Technologies Co., Ltd. 2021. All rights reserved.
# Description: Kconfig for test
# # Author: Huawei OS Kernel Lab
# # Create: Wed Sep 22 16:22:45 2021
#
# # HMCMAKENG_KCONFIG is injected by HongmengCMakeNG/Kconfig.cmake
# # which defines multiple config options which is useful for HMbuild.
source "$(HMCMAKENG_KCONFIG)"
source "subdir/Kconfig"
```

## kernel/kernel/hongmeng/hm-cmake-modules/tests/others/builtin/builtin_depends/Kconfig
```kconfig
# Copyright (c) Huawei Technologies Co., Ltd. 2022-2022. All rights reserved.
# Description: Kconfig
# Author: Huawei OS Kernel Lab
# Create: Wed Mar 30 09:48:24 2022

source "$(HMCMAKENG_KCONFIG)"
```

## kernel/kernel/hongmeng/hm-cmake-modules/tests/others/builtin/lib_same_src_name/Kconfig
```kconfig
# Copyright (c) Huawei Technologies Co., Ltd. 2021. All rights reserved.
# Description: Kconfig
# Author: Huawei OS Kernel Lab
# Create: Tue Dec 14 14:57:38 2021

source "$(HMCMAKENG_KCONFIG)"
```

## kernel/kernel/hongmeng/hm-cmake-modules/tests/others/features/Kconfig
```kconfig
# Copyright (c) Huawei Technologies Co., Ltd. 2022. All rights reserved.
# Description: Kconfig
# Author: Huawei OS Kernel Lab
# Create: Thu Sep 22 15:59:45 2022

source "$(HMCMAKENG_KCONFIG)"
```

## kernel/kernel/hongmeng/hm-compatible-headers/Kconfig
```kconfig
# Copyright (C) Huawei Technologies Co., Ltd. 2021. All rights reserved.
# Description: Kconfig for hm-linux-header
# Author: Huawei OS Kernel Lab
# Create: Mon Aug 09 15:19:37 2021

# HMCMAKENG_KCONFIG is injected by HongmengCMakeNG/Kconfig.cmake
# which defines multiple config options which is useful for HMbuild.
source "$(HMCMAKENG_KCONFIG)"
```

## kernel/kernel/hongmeng/hm-filesystems/fslibs/Kconfig
```kconfig
# Copyright (c) Huawei Technologies Co., Ltd. 2021-2021. All rights reserved.
# Description: Kconfig for fslibs
# Author: Huawei OS Kernel Lab
# Create: Mon Oct 11 20:36:42 2021

# HMCMAKENG_KCONFIG is injected by HongmengCMakeNG/Kconfig.cmake
# which defines multiple config options which is useful for HMbuild.
source "$(HMCMAKENG_KCONFIG)"

config FSLIB_DEBUG
  bool "Build in Debug mode"
  default n

config FSLIB_TRANSFER_FD
  bool "Enable transfer fd support"
  default n

config FSLIB_HM_BINDER
  bool "Enable binder support"
  depends on FSLIB_TRANSFER_FD
  default "n"

config FSLIB_HM_BINDER_32BIT
  bool "Enable binder 32bit support"
  default "n"

config FSLIB_DEFAULT_OPEN_FILES
  int "Default number of open files"
  default 512

config FSLIB_MAX_OPEN_FILES
  int "Max number of open files"
  default 1048576

config FSLIB_SERVER_INFO_LIST_SIZE
  int "Initial server info list size"
  default 8

config FSLIB_GFD_TABLE
  bool "manage fd table in fsmgr"
  default y

config FSLIB_SECURITY_XPM
  bool "Enable xpm"
  default n

config FSLIB_AUDIT
  bool "enable audit feature"
  default n

config FSLIB_ENCAPS
  bool "Enable encaps"
  default n
```

## kernel/kernel/hongmeng/hm-filesystems/fslibs/arch/aarch64/configs/libs_be_defconfig
```kconfig
CONFIG_FSLIB_DEBUG=y
CONFIG_FSLIB_DEFAULT_OPEN_FILES=1024
CONFIG_FSLIB_GFD_TABLE=y
CONFIG_FSLIB_TRANSFER_FD=y
```

## kernel/kernel/hongmeng/hm-filesystems/fslibs/arch/aarch64/configs/release_libs_defconfig
```kconfig
CONFIG_FSLIB_HM_BINDER=y
CONFIG_FSLIB_DEFAULT_OPEN_FILES=1024
CONFIG_FSLIB_TRANSFER_FD=y
```

## kernel/kernel/hongmeng/hm-libvsync/Kconfig
```kconfig
# Copyright (C) Huawei Technologies Co., Ltd. 2024. All rights reserved.
# Description: Kconfig for vsync
# Author: Huawei OS Kernel Lab
# Create: Mon Aug 09 15:19:37 2021

# HMCMAKENG_KCONFIG is injected by HongmengCMakeNG/Kconfig.cmake
# which defines multiple config options which is useful for HMbuild.
source "$(HMCMAKENG_KCONFIG)"
```

## kernel/kernel/hongmeng/hm-network/Kconfig
```kconfig
menu "Network Options"

config DEBUG_BUILD
  bool "Enable debug build"
  default n

choice
  prompt "select tcp/ip stack"
  default LWIP
config LWIP
  bool "lwip stack"
config VISP
  bool "visp stack"
config LDK_INET
  bool "ldk inet stack"
config NO_STACK
  bool "no stack"
endchoice

config LDK_QIPCRTR
  bool "ldk qipcrtr stack"
  default n

config LDK
  bool "ldk stack"
  depends on LDK_INET || LDK_QIPCRTR
  default y

config UXNET_CAN
  bool "Enable socket can"
  default n

config UXNET_NETLINK
  bool "Enable netlink"
  default y

config UXNET_PACKET
  bool "Enable PACKET"
  default y

config UXNET_NETFILTER
  depends on LWIP
  bool "Enable netfilter"
  default n

config UXNET_CTRACK
  depends on UXNET_NETFILTER
  bool "Enable ctrack"
  default n

config UXNET_TUN
  bool "Enable tun"
  default n

config UXNET_VISP_PPP
  depends on VISP
  bool "Enable ppp"
  default n

config UXNET_PPPOX
  bool "Enable pppox"
  default n

config UXNET_UNIX
  bool "Enable unix socket"
  default y

config SCM_RIGHTS
  bool "Enable scm_rights"
  default y

config POSIX_CAPS
  bool "Enable POSIX_CAPS"
  default y

config VIRTIO_VSOCK
  bool "Enable virtio vsock"
  default n

config VSOCK_HOST
  bool "Enable vsock host"
  default n

config VHOST
  bool "Enable vhost mode"
  default n

config VHOST_VNET
  bool "Enable vhost-user backend for virtio-net"
  depends on VHOST
  default n

config AUDIT
  bool "Enable audit"
  default n

config UEV_TRACE
  bool "Enable UEV trace support"
  default n

config UXNET_BPF
  bool "Enable BPF"
  default y

config UXNET_BONDING
  bool "Enable BONDING"
  default y

config NETWORK_TEST
  bool "Enbale network test"
  default y

config SOCKET_LIMIT_PER_PROC
  int "Maximum sockets a process can create"
  default 512

config COMPAT
    bool "Support for 32-bit applications at EL0"
    default n
config NO_COMPAT
    def_bool !COMPAT

config ARCH_LIB32MODE
    bool "Support for 32-bit libs"
    default n

config ILP32
    bool "Support for aarch64ilp32 applications at EL0"
    default n
config NO_ILP32
    def_bool !ILP32

config NET_FUSION
    bool "Enable hmnetd fusion mode"
    default n

config NETFS_FUSION
    bool "Enable hmnet and fs into fusion mode"
    default n

config NETFS_FUSION_PROCFS
    bool "Enable hmnet and fs into fusion mode in nosysk"
    default n

config NET_STANDALONE
    def_bool !NET_FUSION

config LSYSCALL_ENABLED
  bool "Enable lsyscall"
  default y

config FD_FLAG_INSTALL
  bool "Config flag for fd of domain socket"
  default n

config OFFLOAD_RECV_QUEUE
  bool "Offload the recvqueue into microkernel"
  default y

config SEHARMONY
  bool "Enable seharmony"
  select SEC_SERVICE
  default n

config SEC_SERVICE
  bool "Enable security service response"
  default n

config SECURITY_DSL
  bool "Enable security dsl generated headers"
  default n

config HMSD_TREND
  string "Security description generation trend"
  default "performance"

config NET_NS
  bool "Support network namespace"
  default n

config SECCOMP
  bool "Enable the secure computing feature"
  default n

config DISABLE_FPU
    bool "The netd services disable FPU"
    default n
    help
      Say Y to enable the netd services use FPU

config WORKQUEUE
  bool "Enable net workqueue"
  default y

config UNIX_FASTPATH
  bool "Enable unix fastpath"
  default n

config SEC_MULTI_USER_ISO
  bool "Enable multi user isolation"
  default n
endmenu
```

## kernel/kernel/hongmeng/hm-network/ulibs/Kconfig
```kconfig
# Copyright (C) Huawei Technologies Co., Ltd. 2021. All rights reserved.
# Description: Kconfig
# Author: Huawei OS Kernel Lab
# Create: Tue Nov 02 16:46:20 2021

source "$(HMCMAKENG_KCONFIG)"
source "../Kconfig"
```

## kernel/kernel/hongmeng/hm-network/ulibs/stub/Kconfig
```kconfig
# Copyright (c) Huawei Technologies Co., Ltd. 2022. All rights reserved.
# Description: Kconfig
# Author: Huawei OS Kernel Lab
# Create: Wed May 11 10:15:31 2022

source "$(HMCMAKENG_KCONFIG)"
```

## kernel/kernel/hongmeng/hm-security/include/Kconfig
```kconfig
# Copyright (c) Huawei Technologies Co., Ltd. 2021-2021. All rights reserved.
# Description: Kconfig for hm-security-headers
# Author: Huawei OS Kernel Lab
# Create: Fri Jan 07 11:07:13 2022

# HMCMAKENG_KCONFIG is injected by HongmengCMakeNG/Kconfig.cmake
# which defines multiple config options which is useful for HMbuild.
source "$(HMCMAKENG_KCONFIG)"
```

## kernel/kernel/hongmeng/hm-security/ulibs/libhmaudit/Kconfig
```kconfig
# Copyright (c) Huawei Technologies Co., Ltd. 2021-2022. All rights reserved.
# Description: Kconfig for hm-security-libs
# Author: Huawei OS Kernel Lab
# Create: Tue Nov 23 17:06:42 2021

# HMCMAKENG_KCONFIG is injected by HongmengCMakeNG/Kconfig.cmake
# which defines multiple config options which is useful for HMbuild.
source "$(HMCMAKENG_KCONFIG)"

config DEBUG_BUILD
  bool "debug build mode"
  default n

choice
  prompt "Instruction set"
  default AARCH64
  config AARCH64
    bool "Arm64 instruction set"
  config ARM
    bool "Arm32 instruction set"
endchoice

config COMPAT
  bool "Support for 32-bits applications at EL0"
  default n

config NO_COMPAT
  def_bool !COMPAT

config ILP32
  bool "Support for aarch64ilp32 applications at EL0"
  default n

config NO_ILP32
  def_bool !ILP32

config HMTRACE
  bool "libraries of hmaudit building with HMTRACE"
  default n

config HMTRACE_UNBLOCK_WRITE
  bool "Write hmtrace events unblockly"
  default n

config AUDIT
  bool "enable audit feature"
  select HMTRACE
  select HMTRACE_UNBLOCK_WRITE
  default n

config CMS_SIG_VERIF
  bool "Enable the cms signature verification"
  default y

config DM_SIG_VERITY
  bool "Enable the dm-verity signature verification"
  default n

# Dependency: KEYMGR_FUSION -> KEYMGR -> LIBKEYMGR
config KEYMGR_FUSION
  bool "enable key retention feature for sysmgr"
  select KEYMGR
  default n

config KEYMGR
  bool "enable key retention feature"
  select LIBKEYMGR
  default n

config LIBKEYMGR
  bool "compile keymgr as library"
  default n

config LIBKEYMGR_DEBUG
  bool "enable libkeymgr debug log"
  default n

config KEYMGR_FS_ENCRYPTION
  bool "enable fs encryption featrue for keymgr"
  depends on LIBKEYMGR
  default n

config INNER_MAC
  bool "Enable inner MAC access control"
  default y

config NOISE_SOURCE_DATA_COLLECT
  bool "collect noise source data"
  help
    it determines whether to XOR noise source data
  default n

config PIE
  bool "control whether add -fPIE to static libs"
  default n

config SEHARMONY_SIDTAB_LOCAL_MAX
  int "seharmony local sidtable size"
  default 4096
  depends on SEHARMONY

config SEHARMONY_SIDTAB_GLOBAL_MAX
  int "seharmony global sidtable size"
  default 4096
  depends on SEHARMONY

config SEHARMONY_POLICY_SPLIT
  bool "seharmony policy load split"
  default y
  depends on SEHARMONY

config SEHARMONY_LOG
  bool "seharmony log control"
  default n
  depends on SEHARMONY

config SEHARMONY_AC_CACHE_STAT
  bool "seharmony access control cache statistics"
  default n
  depends on SEHARMONY_AC_CACHE

config SEHARMONY_AC_CACHE
  bool "seharmony access control cache"
  default y
  depends on SEHARMONY

config SEHARMONY
  bool "Enable seharmony"
  select SEC_SERVICE_MANAGEMENT
  default y

config SEC_SERVICE_MANAGEMENT
  bool "Enable security service management"
  default n

config SEC_DENY_LOG
  bool "enable access control logs and backtrace"
  default n

config SECCOMP
  bool "Enable the secure computing feature"
  default n

config SECCOMP_CACHE_DEBUG
  bool "Enable the proc node debugging feature of the seccomp cache."
  default n
  depends on SECCOMP

config CRYPTO_OPENSSL
  bool "Enable use the crypto lib openssl"
  default n

config CRYPTO_HITLS
  bool "Enable use the crypto lib openssl"
  def_bool !CRYPTO_OPENSSL

config KEY_QUOTA_ROOT_MAXKEYS
    int "maximum number of keys for the root user"
    default 1000000

config KEY_QUOTA_ROOT_MAXBYTES
    int "maximum bytes of keys for the root user"
    default 25000000

config KEY_QUOTA_MAXKEYS
    int "maximum number of keys for the common user"
    default 200

config KEY_QUOTA_MAXBYTES
    int "maximum bytes of keys for the common user"
    default 20000
```

## kernel/kernel/hongmeng/hm-security/ulibs/libkasan/Kconfig
```kconfig
# Copyright (c) Huawei Technologies Co., Ltd. 2021-2021. All rights reserved.
# Description: Kconfig for libkasan
# Author: Huawei OS Kernel Lab
# Create: Wed Dec 01 08:52:37 2021

# HMCMAKENG_KCONFIG is injected by HongmengCMakeNG/Kconfig.cmake
# which defines multiple config options which is useful for HMbuild.
source "$(HMCMAKENG_KCONFIG)"

config KASAN_RUNTIME
  bool "KASAN runtime for libraries"
  default y

config PRIVILEGED_KASAN
  bool "Enable KASAN for privilege"
  default n

config KASAN_DELAY_FREE_SIZE_MB
  int "Size (in Mb) of kasan delayed free"
  range 0 256
  default 8

config PRIV_VS_SIZE_SYSMGR
  hex "Privilege services vspace size"
  default 0x400000000
```

## kernel/kernel/hongmeng/hm-security/ulibs/libucfi/Kconfig
```kconfig
# Copyright (c) Huawei Technologies Co., Ltd. 2022-2022. All rights reserved.
# Description: Kconfig for libucfi
# Author: Huawei OS Kernel Lab
# Create: Thu Mar 31 10:10:37 2022

# HMCMAKENG_KCONFIG is injected by HongmengCMakeNG/Kconfig.cmake
# which defines multiple config options which is useful for HMbuild.
source "$(HMCMAKENG_KCONFIG)"
```
