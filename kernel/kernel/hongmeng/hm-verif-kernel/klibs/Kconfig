## kernel/kernel/hongmeng/hm-verif-kernel/uapps/devhost/ldk_ext/kstate/Kconfig
```kconfig
# Copyright (C) Huawei Technologies Co., Ltd. 2023. All rights reserved.
# Description: Kconfig for ldk extension
# Author: Huawei OS Kernel Lab
# Create: Tue May 23 16:30:43 CST 2023

# HMCMAKENG_KCONFIG is injected by HongmengCMakeNG/Kconfig.cmake
# which defines multiple config options which is useful for HMbuild.

source "$(HMCMAKENG_KCONFIG)"
```
