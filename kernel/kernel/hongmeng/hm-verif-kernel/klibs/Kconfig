## kernel/kernel/hongmeng/hm-verif-kernel/uapps/devhost/backends/Kconfig
```kconfig
menu "DEVHOST Backend Settings"

comment "default backend settings"
choice
	prompt "Default backend"
	default DEVHOST_DEFAULT_LIBLINUX
	config DEVHOST_DEFAULT_LIBLINUX
		bool "liblinux" if DEVHOST_LIBLINUX=y
	config DEVHOST_DEFAULT_UDK
		bool "udk" if DEVHOST_UDK=y
	config DEVHOST_DEFAULT_NONE
		bool "none"
endchoice

config DEVHOST_DEFAULT_BACKEND
	string
	default "libdh-udk.so.0" if DEVHOST_DEFAULT_UDK
	default "libdh-linux.so.4.4" if DEVHOST_DEFAULT_LIBLINUX && DEVHOST_LIBLINUX_DEFAULT_4_4
	default "libdh-linux.so.5.10" if DEVHOST_DEFAULT_LIBLINUX && DEVHOST_LIBLINUX_DEFAULT_5_10
	default "libdh-linux.so.5.10-oh" if DEVHOST_DEFAULT_LIBLINUX && DEVHOST_LIBLINUX_DEFAULT_5_10_OH
	default "libdh-linux.so.5.10-sd5151t" if DEVHOST_DEFAULT_LIBLINUX && DEVHOST_LIBLINUX_DEFAULT_5_10_SD5151T
	default "libdh-linux.so.5.10-ipq6028" if DEVHOST_DEFAULT_LIBLINUX && DEVHOST_LIBLINUX_DEFAULT_5_10_IPQ6028
	default "libdh-linux.so.5.10-1620osp" if DEVHOST_DEFAULT_LIBLINUX && DEVHOST_LIBLINUX_DEFAULT_5_10_1620OSP
	default "libdh-linux.so.4.4-hi3516" if DEVHOST_DEFAULT_LIBLINUX && DEVHOST_LIBLINUX_DEFAULT_4_4_HI3516
	default "libdh-linux.so.4.4-stm32mp1" if DEVHOST_DEFAULT_LIBLINUX && DEVHOST_LIBLINUX_DEFAULT_4_4_STM32MP1
	default "libdh-linux.so.4.4-sd5151t" if DEVHOST_DEFAULT_LIBLINUX && DEVHOST_LIBLINUX_DEFAULT_4_4_SD5151T
	default "libdh-linux.so.5.10-m536a" if DEVHOST_DEFAULT_LIBLINUX && DEVHOST_LIBLINUX_DEFAULT_5_10_M536A
	default "libdh-linux.so.5.10-cpro" if DEVHOST_DEFAULT_LIBLINUX && DEVHOST_LIBLINUX_DEFAULT_5_10_CPRO
	default "libdh-linux.so.5.10-hi1156" if DEVHOST_DEFAULT_LIBLINUX && DEVHOST_LIBLINUX_DEFAULT_5_10_HI1156

config DEVHOST_DEFAULT_ROOT_DRIVER
	string
	default "of_udk.udk" if DEVHOST_DEFAULT_UDK
	default "of.ko" if DEVHOST_DEFAULT_LIBLINUX

comment "enable backends"

config DEVHOST_UDK
	bool "UDK backend"
	default n

config DEVHOST_LIBLINUX
	bool

config DEVHOST_LIBLINUX_4_4
	bool "liblinux-4.4 backend"
	select DEVHOST_LIBLINUX
	default n

config DEVHOST_LIBLINUX_5_10
	bool "liblinux-5.10 backend"
	select DEVHOST_LIBLINUX
	default n

config DEVHOST_LIBLINUX_5_10_OH
	bool "liblinux-5.10-oh backend"
	select DEVHOST_LIBLINUX
	default n

config DEVHOST_LIBLINUX_5_10_SD5151T
	bool "liblinux-5.10-sd5151t backend"
	select DEVHOST_LIBLINUX
	default n

config DEVHOST_LIBLINUX_5_10_IPQ6028
	bool "liblinux-5.10-ipq6028 backend"
	select DEVHOST_LIBLINUX
	default n

config DEVHOST_LIBLINUX_5_10_M536A
	bool "liblinux-5.10-m536a backend"
	select DEVHOST_LIBLINUX
	default n

config DEVHOST_LIBLINUX_5_10_CPRO
	bool "liblinux-5.10-cpro backend"
	select DEVHOST_LIBLINUX
	default n

config DEVHOST_LIBLINUX_4_4_HI3516
	bool "liblinux-4.4-hi3516 backend"
	select DEVHOST_LIBLINUX
	default n

config DEVHOST_LIBLINUX_4_4_STM32MP1
	bool "liblinux-4.4-stm32mp1 backend"
	select DEVHOST_LIBLINUX
	default n

config DEVHOST_LIBLINUX_4_4_SD5151T
	bool "liblinux-4.4-sd5151t backend"
	select DEVHOST_LIBLINUX
	default n

config DEVHOST_LIBLINUX_5_10_1620OSP
	bool "liblinux-5.10-1620osp backend"
	select DEVHOST_LIBLINUX
	default n

config DEVHOST_LIBLINUX_5_10_HI1156
	bool "liblinux-5.10-hi1156 backend"
	select DEVHOST_LIBLINUX
	default n

if DEVHOST_LIBLINUX
comment "liblinux backend settings"
choice
	prompt "Default liblinux version"
	default DEVHOST_LIBLINUX_DEFAULT_4_4
	config DEVHOST_LIBLINUX_DEFAULT_4_4
		bool "liblinux-4.4" if DEVHOST_LIBLINUX_4_4
	config DEVHOST_LIBLINUX_DEFAULT_5_10
		bool "liblinux-5.10" if DEVHOST_LIBLINUX_5_10
	config DEVHOST_LIBLINUX_DEFAULT_5_10_OH
		bool "liblinux-5.10-oh" if DEVHOST_LIBLINUX_5_10_OH
	config DEVHOST_LIBLINUX_DEFAULT_5_10_SD5151T
		bool "liblinux-5.10-sd5151t" if DEVHOST_LIBLINUX_5_10_SD5151T
	config DEVHOST_LIBLINUX_DEFAULT_5_10_IPQ6028
		bool "liblinux-5.10-ipq6028" if DEVHOST_LIBLINUX_5_10_IPQ6028
	config DEVHOST_LIBLINUX_DEFAULT_5_10_1620OSP
		bool "liblinux-5.10-1620osp" if DEVHOST_LIBLINUX_5_10_1620OSP
	config DEVHOST_LIBLINUX_DEFAULT_5_10_M536A
		bool "liblinux-5.10-m536a" if DEVHOST_LIBLINUX_5_10_M536A
	config DEVHOST_LIBLINUX_DEFAULT_5_10_CPRO
		bool "liblinux-5.10-cpro" if DEVHOST_LIBLINUX_5_10_CPRO
	config DEVHOST_LIBLINUX_DEFAULT_4_4_HI3516
		bool "liblinux-4.4-hi3516" if DEVHOST_LIBLINUX_4_4_HI3516
	config DEVHOST_LIBLINUX_DEFAULT_4_4_STM32MP1
		bool "liblinux-4.4-stm32mp1" if DEVHOST_LIBLINUX_4_4_STM32MP1
	config DEVHOST_LIBLINUX_DEFAULT_4_4_SD5151T
		bool "liblinux-4.4-sd5151t" if DEVHOST_LIBLINUX_4_4_SD5151T
	config DEVHOST_LIBLINUX_DEFAULT_5_10_HI1156
		bool "liblinux-5.10-hi1156" if DEVHOST_LIBLINUX_5_10_HI1156

endchoice

config LIBLINUX_VERSION
	string
	default "linux-4.4.162" if DEVHOST_LIBLINUX_DEFAULT_4_4
	default "linux-5.10.0" if DEVHOST_LIBLINUX_DEFAULT_5_10
	default "linux-5.10.97-oh" if DEVHOST_LIBLINUX_DEFAULT_5_10_OH
	default "linux-5.10.0-sd5151t" if DEVHOST_LIBLINUX_DEFAULT_5_10_SD5151T
	default "linux-5.10.0-ipq6028" if DEVHOST_LIBLINUX_DEFAULT_5_10_IPQ6028
	default "linux-5.10.0-1620osp" if DEVHOST_LIBLINUX_DEFAULT_5_10_1620OSP
	default "linux-4.4.162-hi3516" if DEVHOST_LIBLINUX_DEFAULT_4_4_HI3516
	default "linux-4.4.162-stm32mp1" if DEVHOST_LIBLINUX_DEFAULT_4_4_STM32MP1
	default "linux-4.4.162-sd5151t" if DEVHOST_LIBLINUX_DEFAULT_4_4_SD5151T
	default "linux-5.10.0-m536a" if DEVHOST_LIBLINUX_DEFAULT_5_10_M536A
	default "linux-5.10.0-cpro" if DEVHOST_LIBLINUX_DEFAULT_5_10_CPRO
	default "linux-5.10.0-hi1156" if DEVHOST_LIBLINUX_DEFAULT_5_10_HI1156

config LIBLINUX_EXTRA_LIBS
	string "extra libraries for liblinux"
	default ""

config DEVHOST_BACKEND_LIBLINUX_4_4
	string
	default "libdh-linux.so.4.4"

config DEVHOST_BACKEND_LIBLINUX_5_10
	string
	default "libdh-linux.so.5.10"

config DEVHOST_BACKEND_LIBLINUX_5_10_OH
	string
	default "libdh-linux.so.5.10-oh"

config DEVHOST_BACKEND_LIBLINUX_5_10_SD5151T
	string
	default "libdh-linux.so.5.10-sd5151t"

config DEVHOST_BACKEND_LIBLINUX_5_10_IPQ6028
	string
	default "libdh-linux.so.5.10-ipq6028"

config DEVHOST_BACKEND_LIBLINUX_4_4_HI3516
	string
	default "libdh-linux.so.4.4-hi3516"

config DEVHOST_BACKEND_LIBLINUX_4_4_STM32MP1
	string
	default "libdh-linux.so.4.4-stm32mp1"

config DEVHOST_BACKEND_LIBLINUX_4_4_SD5151T
	string
	default "libdh-linux.so.4.4-sd5151t"

config DEVHOST_BACKEND_LIBLINUX_5_10_M536A
	string
	default "libdh-linux.so.5.10-m536a"

config DEVHOST_BACKEND_LIBLINUX_5_10_CPRO
	string
	default "libdh-linux.so.5.10-cpro"

config DEVHOST_BACKEND_LIBLINUX_5_10_HI1156
	string
	default "libdh-linux.so.5.10-hi1156"

endif	# DEVHOST_LIBLINUX

# udk configs
if DEVHOST_UDK
source "uapps/devhost/backends/udk/Kconfig.legacy"
endif	# DEVHOST_UDK

# ldk configs
if DEVHOST_LIBLINUX
source "uapps/devhost/backends/liblinux/Kconfig.legacy"
endif	# DEVHOST_LIBLINUX

endmenu
```

## kernel/kernel/hongmeng/hm-verif-kernel/uapps/devhost/backends/common/sd/Kconfig
```kconfig
# Copyright (c) Huawei Technologies Co., Ltd. 2023. All rights reserved.
# Description: Kconfig for sd proxy
# Author: Huawei OS Kernel Lab
# Create: Thur Jun 8 11:26:07 2023

source "$(HMCMAKENG_KCONFIG)"

source "exts/hisi/Kconfig"
```

## kernel/kernel/hongmeng/hm-verif-kernel/uapps/devhost/backends/common/sd/exts/hisi/hisiplatform/Kconfig
```kconfig
# Copyright (c) Huawei Technologies Co., Ltd. 2023. All rights reserved.
# Description: Stub file for HISI
# Author: Huawei OS Kernel Lab
# Create: Mon Nov 25 11:51:30 2024

config HISI_LDKEXT_SD_CONFIG
  bool "entry for HISI hm-ldkext-sd module compile"
  default n
```

## kernel/kernel/hongmeng/hm-verif-kernel/uapps/devhost/backends/liblinux/Kconfig
```kconfig
# Copyright (c) Huawei Technologies Co., Ltd. 2021. All rights reserved.
# Description: Kconfig for devhsot
# Author: Huawei OS Kernel Lab
# Create: Fri Nov 19 11:26:07 2021
source "$(HMCMAKENG_KCONFIG)"

source "lnxbase/Kconfig"
source "modules/Kconfig"
```

## kernel/kernel/hongmeng/hm-verif-kernel/uapps/devhost/backends/liblinux/Kconfig.legacy
```kconfig
# Copyright (c) Huawei Technologies Co., Ltd. 2021-2021. All rights reserved.
# Description: Liblinux kconfig
# Author: Huawei OS Kernel Lab
# Create: Wed Sep 15 09:53:02 2021
comment "LDK Backend Settings"

config DEVHOST_VPIPE
        bool "devhost vpipe extension"
        default n

config WPA_SUPPLICANT
	bool "install wpa_supplicant for wifi"
	depends on HMNETWORK
	depends on DEVHOST_NETLINK
	default n

config DEVHOST_FS_TRANSFS
	bool "trans layer support"
	default n

config UBIFS_CTRL
	bool "ubifs ctrl support"
	default n
```

## kernel/kernel/hongmeng/hm-verif-kernel/uapps/devhost/backends/liblinux/modules/Kconfig
```kconfig
# Copyright (c) Huawei Technologies Co., Ltd. 2023. All rights reserved.
# Description: Kconfig for modules
# Author: Huawei OS Kernel Lab
# Create: Fri Mar 10 17:32:14 2023

config DEVHOST_FS_TRANSFS
  bool "trans layer support"
  default n

config DEVHOST_TTY
  bool "use tty uart driver"
  default n

config DEVHOST_TTY_STREAM
  bool "use tty stream driver"
  default n

config MDC_GODEL_HACK
  bool "For mdc Godel hacking"
  default n

config DEVHOST_VITS_PCI_MSI
  bool "devhost support its pci msi irq domain creation"
  depends on MDC_GODEL_HACK
  default n

config SERIAL_KSHORTCUT_SYS_PAUSE
  bool "Kernel handle ctrl-x input and system pause"
  help
    Some hardware platform need to be restarted in some cases.
    Kernel handle ctrl-x could ensure it be shutdown definitely.
  default n

config SERIAL_KSHORTCUT_TRIGGER_SNAPSHOT
  bool "Kernel handle ctrl-b to trigger snapshot"
  help
    Some platforms need to trigger snapshot logs for problem location.
    Kernel handle ctrl-b could trigger snapshot manually.
  default n

config UBIFS_CTRL
  bool "ubifs ctrl support"
  default n

config HISI_INLINE_ENCRYPTION
  bool "Enable hisi inline encrypt"
  default n
```

## kernel/kernel/hongmeng/hm-verif-kernel/uapps/devhost/backends/udk/Kconfig
```kconfig
comment "UDK Backend Settings"
source "$(HMCMAKENG_KCONFIG)"

source "Kconfig.legacy"
source "fusion/Kconfig"
source "exts/hisi/Kconfig"

config MODULE_SCHED_CLASS
	def_bool y

config COMPAT
	bool "Support for 32-bit applications at EL0"
	default n

config UDK_I2C
	bool "enable udk i2c"
	default n

config UDK_TTY
	bool "enable udk tty, only close in LDK+UDK mode"
	default y

config UDK_DMA_MEMPOOL_BITMAP
	hex "dma mempool order bitmap"
	default 0x1

config UDK_EXT
    bool "UDK EXT Support"
    help
        UDK framework has extension api. The driver could invoke
        customized extension fastcall provided by micro-kernel.
    default n

config UDK_SPI
	bool "enable udk spi"
	default n

config UDK_TIMER_PRECISION
	int "precision of udk timer(ms)"
	default 100

config UDK_FUSION
	bool "enable udk fusion"
	default n

config UDK_BLOCK_MQ
	bool "enable udk block multi queue"
	default n

config TRACEMGR
       bool "trace manager"
       default n

config NO_TRACEMGR
	def_bool !TRACEMGR

# bd_types header file use this config, needs to keep the value consistent with other config
config HISI_INLINE_ENCRYPTION
	bool "Enable hisi inline encrypt"
	default n

config UDK_FALLBACK_ENCRYPTION
	bool "Enable udk fallback encrypt"
	default n

config PAGE_FAULT_MARK
	bool "page fault mark feature"
	default n
	help
		for mark page fault feature

config VFS_BLK_HMCRYPTO
	bool "indicate whether hisi hmcrypto engine is used"
	default n

config UDK_BIO_INFO_MAX_COUNT
	int "udk bio info max count"
	default 256

config FSCK_BOOST
    bool "Enable CONFIG_FSCK_BOOST:Improve boot fsck, resize, and mount speed"
	default n
source "exts/hisi/Kconfig"
```

## kernel/kernel/hongmeng/hm-verif-kernel/uapps/devhost/backends/udk/Kconfig.legacy
```kconfig
comment "UDK Backend Settings"

config DEVHOST_BACKEND_UDK
	string
	default "libdh-udk.so.0"

menu "UDK Features Configuration"

config UDK_IRQ_EXT
	bool "enable udk irq extention"
	default n

config UDK_MAILBOX
	bool "enable udk mailbox"
	default n

config UDK_GPIO
	bool "enable udk gpio"
	default n

config UDK_FIRMWARE
	bool "enable udk firmware"
	default n

config UDK_CLOCK
	bool "enable udk clock"
	default n

config UDK_PCI
	bool "enable udk pci"
	default n

config UDK_MDIO
	bool "enable udk mdio"
	default n

config UDK_PHY
	bool "enable phy layer"
	default n

config UDK_NETPHY
	bool "enable udk netphy"
	select UDK_MDIO
	depends on UDK_PHY
	default n

config UDK_UART
	bool "enable udk uart"
	default n

config UDK_UEFI
	bool "enable udk uefi"
	default n

endmenu
```

## kernel/kernel/hongmeng/hm-verif-kernel/uapps/devhost/backends/udk/exts/hisi/Kconfig
```kconfig
# Copyright (c) Huawei Technologies Co., Ltd. 2023. All rights reserved.
# Description: Stub file for HISI
# Author: Huawei OS Kernel Lab
# Create: Mon Nov 25 11:51:30 2024
source "exts/hisi/hisiplatform/Kconfig"
```

## kernel/kernel/hongmeng/hm-verif-kernel/uapps/devhost/backends/udk/exts/hisi/hisiplatform/Kconfig
```kconfig
# Copyright (c) Huawei Technologies Co., Ltd. 2023. All rights reserved.
# Description: Stub file for HISI
# Author: Huawei OS Kernel Lab
# Create: Mon Nov 25 11:51:30 2024

config HISI_UDK_CONFIG
  bool "entry for HISI hm-verif-kernel module compile"
  default n
```

## kernel/kernel/hongmeng/hm-verif-kernel/uapps/devhost/backends/udk/fusion/Kconfig
```kconfig
comment "UDK Fusion Settings"

config UDK_DEPEND_SYSK
	bool "Using sysk libraries"
	default n

config UDK_DEPEND_NO_SYSK
	def_bool !UDK_DEPEND_SYSK

config UDK_FUSION_KCFI
	bool "enable udk fusion kcfi"
	select UDK_DEPEND_SYSK
	default n

config UDK_FUSION_KCFI_CFLAGS
	string "udk kcfi flags, only used in fusion mode"
	default ""

config UDK_FUISON_DRIVERS
	bool "enable udk fusion loading drivers"
	default n

config UDK_FUSION_OF
	bool "enable udk fusion of scanning"
	default y

config UDK_FUSION_KASAN_CFLAGS
	string "udk kasan flags, only used in fusion mode"
	default ""

config UDK_FUSION_KCOV_CFLAGS
    string "udk kcov flags, only used in fusion mode"
    default ""
```

## kernel/kernel/hongmeng/hm-verif-kernel/uapps/devhost/backends/udk/modules/Kconfig
```kconfig
comment "UDK modules Settings"
source "$(HMCMAKENG_KCONFIG)"

config UDK_LIBS_INSTALL_PATH
	string
	default "/lib/modules"
```

## kernel/kernel/hongmeng/hm-verif-kernel/uapps/devhost/configs/small_defconfig
```kconfig
# CONFIG_NET_IO_URING is not set
CONFIG_DEVHOST_BLK_SRING_LEN=2
CONFIG_NET_POOL_UNIT_BITS=11
# CONFIG_DEVHOST_NETLINK is not set
```

## kernel/kernel/hongmeng/hm-verif-kernel/uapps/devhost/ldk_ext/dfx/Kconfig
```kconfig
# Copyright (C) Huawei Technologies Co., Ltd. 2022. All rights reserved.
# Description: Kconfig for ldk extension
# Author: Huawei OS Kernel Lab
# Create: Wed Jul 6 09:24:07 2022

# HMCMAKENG_KCONFIG is injected by HongmengCMakeNG/Kconfig.cmake
# which defines multiple config options which is useful for HMbuild.
source "$(HMCMAKENG_KCONFIG)"

config EXPORT_HM_PROC_SHOW_PTE
	bool "Export symbol hm_proc_show_pte"
	default n
```

## kernel/kernel/hongmeng/hm-verif-kernel/uapps/devhost/ldk_ext/file_info/Kconfig
```kconfig
# Copyright (c) Huawei Technologies Co., Ltd. 2023. All rights reserved.
# Description: Kconfig for ldk extension
# Author: Huawei OS Kernel Lab
# Create: Wed Sep 13 09:13:06 2023

# HMCMAKENG_KCONFIG is injected by HongmengCMakeNG/Kconfig.cmake
# which defines multiple config options which is useful for HMbuild.
source "$(HMCMAKENG_KCONFIG)"

config DFX_MEMCHECK
	bool "consist with ldk CONFIG_DFX_MEMCHECK"
	default y

config DMABUF_MM
	bool "consist with ldk CONFIG_DMABUF_MM"
	default y

config DEBUG_BUILD
	bool "Build kernel with debug mode"
	default n
```

## kernel/kernel/hongmeng/hm-verif-kernel/uapps/devhost/ldk_ext/iaware_notify/Kconfig
```kconfig
# Copyright (C) Huawei Technologies Co., Ltd. 2023. All rights reserved.
# Description: Kconfig for ldk extension
# Author: Huawei OS Kernel Lab
# Create: Tue Mar 28 12:15:54 2023

# HMCMAKENG_KCONFIG is injected by HongmengCMakeNG/Kconfig.cmake
# which defines multiple config options which is useful for HMbuild.

source "$(HMCMAKENG_KCONFIG)"
```
