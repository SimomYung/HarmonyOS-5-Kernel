## kernel/kernel/hongmeng/hm-verif-kernel/uapps/devhost/ldk_ext/tpm_ctrl/Kconfig
```kconfig
# Copyright (c) Huawei Technologies Co., Ltd. 2023. All rights reserved.
# Description: Kconfig for ldk extension
# Author: Huawei OS Kernel Lab
# Create: Wed Jan 11 17:24:07 2023

# HMCMAKENG_KCONFIG is injected by HongmengCMakeNG/Kconfig.cmake
# which defines multiple config options which is useful for HMbuild.
source "$(HMCMAKENG_KCONFIG)"
```

## kernel/kernel/hongmeng/hm-verif-kernel/uapps/devhost/ldk_ext/transfs/Kconfig
```kconfig
source "$(HMCMAKENG_KCONFIG)"

config COMPAT
	bool "Support for 32-bit applications at EL0"
	default n
# for sysif handler
config NO_COMPAT
	def_bool !COMPAT
```

## kernel/kernel/hongmeng/hm-verif-kernel/uapps/devhost/udk_ext/net/Kconfig
```kconfig
# Copyright (C) Huawei Technologies Co., Ltd. 2023. All rights reserved.
# Description: Kconfig for udk extension
# Author: Huawei OS Kernel Lab
# Create: Wed Jul 286 21:06:07 2023

# HMCMAKENG_KCONFIG is injected by HongmengCMakeNG/Kconfig.cmake
# which defines multiple config options which is useful for HMbuild.
source "$(HMCMAKENG_KCONFIG)"
```

## kernel/kernel/hongmeng/hm-verif-kernel/uapps/hmld.so/Kconfig
```kconfig
# Copyright (c) Huawei Technologies Co., Ltd. 2022-2022. All rights reserved.
# Description: Kconfig for hmld.so
# Author: Huawei OS Kernel Lab
# Create: Tue Feb 08 16:04:58 2022

# HMCMAKENG_KCONFIG is injected by HongmengCMakeNG/Kconfig.cmake
# which defines multiple config options which is useful for HMbuild.
source "$(HMCMAKENG_KCONFIG)"

menu "Common Options"
choice
  prompt "Related choice Target Arch"
  default AARCH64
  config ARM
    bool "ARM"
  config AARCH64
    bool "AARCH64"
endchoice

endmenu

menu "Unrelated Options"

config AUDIT
  bool "Unrelated option AUDIT"
  default n

config MMIO_DISPATCHER
  bool "Unrelated option MMIO_DISPATCHER"
  default n

config SLAB_FREELIST_RANDOM
  bool "unrelated option SLAB_FREELIST_RANDOM"
  default n

config SYSMGR_BUDDY_MAX_ORDER
  bool "unrelated option SYSMGR_BUDDY_MAX_ORDER"
  default n

config DOPRA_TICK
  bool "Unrelated option DOPRA_TICK"
  default n

config RRU_PERF_HACK
  bool "Unrelated option RRU_PERF_HACK"
  default n

config STRICT_FOR_CODEDEX
  bool "unrelated option STRICT_FOR_CODEDEX"
  default n

config STRICT_NO_OVERFLOW
  bool "unrelated option"
  default n

config RT_FUTEX
  bool "Unrelated option RT_FUTEX"
  default n

config STRICT_UNUSED
  bool "Unrelated option STRICT_UNUSED"
  default n

config SUPPORT_MULT_LIBC
  bool "Support for multiple libc"
  default n

config OPENHARMONY
  bool "Enable openharmony functions"
  default n

endmenu
```

## kernel/kernel/hongmeng/hm-verif-kernel/ulibs/Kconfig.legacy
```kconfig
menu "ULIBS Options"

config RAW_THREAD_COMPATIBLE_WITH_PTHREAD
bool "Make raw thread compatible with pthread"
default y

config USERLAND_C_STANDARD
  string "C standard used for userspace (sysmgr & ulibs)"
  default "gnu99"
config RESERVE_VMEM
  int "RESERVE_VMEM"
  range 1 2097152
  default 4096

config PTPOOL_SIZE
  int "pt pool page count"
  default 128
config PTPOOL_INJECT_SIZE
   int "pt pool inject page count when allocate failed"
   default 16

config U_HW_UNALIGN_ACCESS
   bool "Hardware unalign access support"
   depends on HW_UNALIGN_ACCESS
   default y

config LIBFAULTEVT
    bool "Enable fault event"
    default n

config FUNCTION_TRACE
   bool "Enable function trace"
   depends on AARCH64
   default n

config FUNCTION_GRAPH
   bool "Enable function trace"
   depends on FUNCTION_TRACE
   default n

config HMVSYSCALL_TRACE
   bool "Enable syscall trace"
   default n

config SLAB_FREELIST_RANDOM
   bool "Enable slab freelist random"
   default n

# Dependency of keymgr config:
#   KEYMGR_FUSION -> KEYMGR -> LIBKEYMGR
config KEYMGR_FUSION
  bool "enable key retention feature"
  select KEYMGR
  default n

config KEYMGR
  bool "enable key retention feature"
  select LIBKEYMGR
  default n

config LIBKEYMGR
  bool "compile keymgr as library"
  default n

config SHMALLOC_MEM_BITS
  int "Share memory malloc bits"
  default 12

config HM_NOTIFIER
  bool "Notifier chain support"
  default n

endmenu
```

## kernel/kernel/hongmeng/hm-verif-kernel/ulibs/configs/aarch64be_defconfig
```kconfig
CONFIG_RRU_PERF_HACK=y
CONFIG_SLAB_FREELIST_RANDOM=y
CONFIG_HMTRACE=y
CONFIG_HMVSYSCALL_TRACE=y
```

## kernel/kernel/hongmeng/hm-verif-kernel/ulibs/libvdso/Kconfig
```kconfig
# Copyright (c) Huawei Technologies Co., Ltd. 2022-2022. All rights reserved.
# Description: Kconfig for libvdso.so
# Author: Huawei OS Kernel Lab
# Create: Wed Mar 23 14:30:57 2022

source "$(HMCMAKENG_KCONFIG)"

choice
    prompt "Target Arch"
    default AARCH64
    config ARM
        bool "ARM"
    config AARCH64
        bool "AARCH64"
endchoice

config AARCH64_UAO
    bool "Enable User Access Override (UAO)"
    depends on AARCH64
    default n
    help
        User Access Override (UAO) is part of the ARMv8.2 Extensions Feature.
        Enable UAO will make LDTR/STTR(Unprivilege) running in current execption
        level.

config U_HW_UNALIGN_ACCESS
    bool "Hardware unalign access support"
    default y

config CC_USE_CLANG
    bool "Use Clang as compiler"
    default n

config SMP
    bool "Enable Symmetric multi-processing support"
    default y
    help
        Enable SMP

config MMIO_DISPATCHER
    bool "Enable hypervisor MMIO region dispatcher"
    default n
    help
        Enable MMIO region dispatcher on hypervisor

config XOM
    bool "Use _xom suffix link script"
    default n
    help
        Use _xom suffix link script to separate rodata and text

config HKIP_SEC_REGION_PROT_VDSO
    bool "Use split link script"
    default n
    help
        Use split link script to separate rodata and text

config TIMER_HARDEN_S4
  bool "Support timer on harden S4"
  default n

config SUPPORT_CDC_ACE_VTIMER
  bool "Support CDC_ACE VTIMER"
  default n
```

## kernel/kernel/linux-5.10-lts/arch/liblinux/Kconfig
```kconfig
# SPDX-License-Identifier: GPL-2.0-only
if "$(USE_HM_KERNEL)" = "true"
menuconfig LIBLINUX
	bool "Enable liblinux support"
	depends on ARM || ARM64 || UML
	default n
	select SET_FS
	select ARCH_NO_PREEMPT
	select ARCH_NO_SWAP
	select VENDOR_HOOKS
	select PREEMPT_COUNT
	select GENERIC_ALLOCATOR
	select GENERIC_STRNCPY_FROM_USER
	select GENERIC_STRNLEN_USER
	# spinlock
	select ARCH_USE_QUEUED_SPINLOCKS
	select LIBLINUX_USE_NATIVE_SPINLOCK
	# arch related
	select ARCH_HAS_GCOV_PROFILE_ALL
	select ARCH_HAS_PTE_SPECIAL
	select ARCH_HAS_SYSCALL_WRAPPER
	select ARCH_HAS_STRICT_MODULE_RWX
	select ARCH_HAS_SET_MEMORY
	select HAVE_PCI
	select GENERIC_CPU_AUTOPROBE
	select IPA_THERMAL
	select SECURITY
	select LIBLINUX_HVGR_POLL_OPT
	select LIBLINUX_DMA_CMA
	select LIBLINUX_HVGR_BATCH_SYNC_OPT

if LIBLINUX

config LIBLINUX_LOGLEVEL_DEFAULT
	int "default liblinux loglevel (1-8)"
	range 1 8
	default "7"
	help
	  Default liblinux loglevel. Only print logs with a loglevel lesser
	  than this value.

config LOG_ENCRYPT
  bool "encrypt panic log"
  default n

config LIBLINUX_VMEMMAP_IOFAST
	bool "Enable liblinux vmemmap using iofast memory"
	default y

config LIBLINUX_VMEMMAP_DEBUG
	bool "Enable liblinux vmemmap debug info"
	default n

config HM_HKIP_PRMEM
	bool "Enable hkip prmem"
	default n
	help
	  Hkip prmem interfaces of the HarmonyOS.

config HM_HKIP_SEHARMONY_PROT
	bool "Enable protection for SEHARMONY policy DB"
	depends on HM_HKIP_PRMEM
	help
	  Replace LDK protection interface with HarmonyOS interface.

config HM_SEPOL_POLICYDB
	bool "Use policydb structure in sepol and parse policydb by sepol"
	depends on LIBLINUX && HKIP_SELINUX_PROT
	default n
	help
	 Use sepol to parse policydb file to keep consistent with other system
	 services.

config LIBLINUX_HMTRACE
	bool "Enable liblinux hmtrace support"
	default y

config GENERIC_CSUM
	def_bool y

config SMP
	def_bool y

config ARCH_SPARSEMEM_ENABLE
	def_bool y
	select SPARSEMEM_VMEMMAP_ENABLE

config HAVE_ARCH_PFN_VALID
	def_bool y

config LIBLINUX_OVERRIDE
    def_bool y

config LIBLINUX_HVGR_POLL_OPT
    def_bool n

config LIBLINUX_HVGR_BATCH_SYNC_OPT
    def_bool n

config HMKIP
	bool "Enable hm kernel integrity protect feature"
	depends on ARM64
	default n

config LIBLINUX_ASYNC_SYSFS
	bool "Enable asynchronous creation of sysfs nodes"
	depends on SYSFS
	default n

config LIBLINUX_KMAP_BITS
	int "Kernel mapping size"
	default 37 if 64BIT && !KASAN
	default 36 if 64BIT && KASAN
	default 27
	help
	  This option allows you to set the maximum physical memory support
	  by liblinux, 128MB for default.

config LIBLINUX_MODULES_RSVD_BITS
	int "Reserved modules size"
	default 27 if 64BIT
	default 25

config LIBLINUX_USE_NATIVE_SPINLOCK
	def_bool n

config LIBLINUX_DMA_CMA
	def_bool n

config LIBLINUX_HIBERNATE
	bool "Hibernation support"
	select HIBERNATION
	default n

# select GFP Allocator to use
choice
	prompt "GFP Allocator"
	default LIBLINUX_NATIVE_BUDDY

config LIBLINUX_SIMPLE_GFP
	bool "Simple GFP"
	help
	  This option use liblinux_page_allocator PAL APIs to allocate
	  pages from buddy.

config LIBLINUX_NATIVE_BUDDY
	bool "Linux-native Buddy"
	select MEMORY_HOTPLUG
	help
	  This option use linux-native buddy allocator for GFP.
endchoice

config LIBLINUX_UNIMPL_DFX_COUNT
	bool "Count unimpl functions"
	default n

config LIBLINUX_KERNEL_MODE_SIMD
	def_bool n
	select KERNEL_MODE_NEON if ARM || ARM64

config LIBLINUX_NET_STACK
	bool "Enable net stack support"
	default y
	select INET
	select NETFILTER
	select NF_CONNTRACK_LABELS
	select LIBLINUX_KERNEL_MODE_SIMD

config LIBLINUX_TTY_FLUSH_SYNC
	bool "flush buf to ldisc directly without workqueue when tty write"
	def_bool n

config LIBLINUX_NO_HZ
	bool "Disable ticks on all CPUs except CPU 0"
	depends on NO_HZ_FULL
	default n

config LIBLINUX_PCP_FREE_FACTOR
	bool "Scale the number of pages that are batch freed from pcp to buddy"
	default n

config LIBLINUX_USER_INVAL_CACHE
	bool "Use flush cache at el0 instead of invalid cache at el1"
	default n

config OPT_TIMER_ENERGY_EFFICIENCY
	bool "Optimize timer users to be friendly for fcm idle (LIBLINUX version)"
	default n

config LIBLINUX_THREAD_BLOCK
	bool "Utilize thread block/unblock calls instead of futex"
	default n

config LIBLINUX_HAVE_ULSR
	bool "Enable liblinux ulsr support"
	default n

config LIBLINUX_MIPS_MEM_DEV_NUM
	int "mips mem device number"
	depends on LIBLINUX_MIPSMEM_FREQ
	default 6

config LIBLINUX_C_ASYNC_PROBE
	bool "Asynchronous probing for predefined drivers"
	default n

config LIBLINUX_ASYNC_END_IO
	bool "Asynchronous notification of fs io end"
	default y

config LIBLINUX_HVC_CALL
	bool "Enable hm kernel hvc call"
	depends on ARM64
	default n

config LIBLINUX_SKIP_TIMESYNC
	bool "Skip the first time sync to accelerate boot"
	default n

config KWORKER_CACHE_DEBUG
	bool "Debug information in procfs for kworker cache"
	default n

config LDK_KALLOCD_PRIO_OPTIMIZE
	bool "Adjust the priority of ldk-kallocd dynamically"
	default n

config LIBLINUX_CDC
	bool "Enable CDC specific modifies"
	default n
	select TRACEPOINTS
	select OF_DYNAMIC
	select HIGH_RES_TIMERS
	select LIBLINUX_ASYNC_SYSFS
	select LIBLINUX_PLAT_HAVE_IDLE_TIME
	select HISI_ANDROID
	select DMA_VIRTUAL_CHANNELS
	select GPIOLIB_IRQCHIP
	select CRYPTO_CBC
	select CRYPTO_SHA256
	select CRYPTO_AES
	select HWMON
	select REGMAP_MMIO
	select DAX
	select FS_DAX
	select FS_DAX_LIMITED
	select LIBLINUX_KERNEL_MODE_SIMD

config LIBLINUX_CDC_RDA
	bool "Enable CDC RDA specific modifies"
	default n
	select LIBLINUX_CDC
	help
	   distinguish from origin rda

if !NAMESPACES
# NET_NS in linux depends on NAMESPACES, but now need enable NET_NS alone
config NET_NS
	bool "Enable net namespace"
	default n
endif # NAMESPACES

config DFX_LIBLINUX
        bool "dfx config for hm kernel build"
        default n
        help
          Say 'Y' in ohos kernel

config LIBLINUX_SYS_UNION_SHRINKER
	bool "Enable liblinux and sys union shrinker"
	default y
	help
	  Say 'Y' in ohos ldk

config LIBLINUX_NET_SOCKMAP
	bool "Enable liblinux sockmap"
	depends on NET_SOCK_MSG
	default n

config LIBLINUX_PAGE_TIME_STAT
	bool "Enable iofast pfn alloc/free and alloc pages time stat"
	default n

endif
endif

config LIBLINUX_BPF_EVENTS
	bool "Enable liblinux bpf_trace_printk, just depend on TRACEPOINTS"
	depends on TRACEPOINTS
	default n

config LIBLINUX_TIMER_BANDWIDTH
	bool "Restrict timer handling time"
	depends on LIBLINUX
	default y

config LIBLINUX_BUDDY_TRACKER
	bool "enable liblinux buddy tracker"
	depends on LIBLINUX
	default n

source "arch/liblinux/security/code_decrypt_hm/Kconfig"
```

## kernel/kernel/linux-5.10-lts/arch/liblinux/security/code_decrypt_hm/Kconfig
```kconfig
# SPDX-License-Identifier: GPL-2.0-only
config CODE_DECRYPT_HM
	bool "App code decrypt support"
	default n
	help
	  Say yes here to support the code decrypt
```

## kernel/kernel/linux-5.10-lts/drivers/block/zram/zram_dedup/Kconfig
```kconfig
# SPDX-License-Identifier: GPL-2.0
config ZRAM_DEDUP
	bool "Memory deduplication"
	depends on ZRAM && CRC32
	help
	  With this feature, zram could deduplicate the objects with the same
	  context. Admin could see the information via
	  /sys/block/zramX/io_stat.
```

## kernel/kernel/linux-5.10-lts/drivers/devkit/audiokit/audio_io_aggre/Kconfig
```kconfig
config AUDIO_IO_AGGRE
	tristate "audio io aggre driver"
	default n
	help
	  Say Y to enable audio io aggre driver support
```

## kernel/kernel/linux-5.10-lts/drivers/devkit/audiokit/audio_misc/Kconfig
```kconfig
config HUAWEI_AUDIO_MISC
    bool "audio misc driver"
    default n
    help
    Say Y to enable audio misc driver support
if HUAWEI_AUDIO_MISC
    source "drivers/devkit/audiokit/audio_misc/vibrator_state/Kconfig"
    source "drivers/devkit/audiokit/audio_misc/hifi_report/Kconfig"
    source "drivers/devkit/audiokit/audio_misc/battery_state/Kconfig"
    source "drivers/devkit/audiokit/audio_misc/collec_audio_info/Kconfig"
    source "drivers/devkit/audiokit/audio_misc/vendorcountry_state/Kconfig"
endif
```

## kernel/kernel/linux-5.10-lts/drivers/devkit/audiokit/audio_misc/audio_info_collection/Kconfig
```kconfig
config AUDIO_INFO_COLLECTION
    bool "audio info collection driver"
    default n
    help
    Say Y to enable audio info collection driver support
```

## kernel/kernel/linux-5.10-lts/drivers/devkit/audiokit/audio_misc/audio_maintain/Kconfig
```kconfig
config CUST_AUDIO_MAINTAIN
    bool "collec audio info driver"
    default n
    help
    Say Y to enable collec audio info driver support
```

## kernel/kernel/linux-5.10-lts/drivers/devkit/audiokit/audio_misc/audio_mic_block/Kconfig
```kconfig
config AUDIO_MIC_BLOCK
    bool "audio mic block driver"
    default n
    help
    Say Y to enable audio mic block driver support
```

## kernel/kernel/linux-5.10-lts/drivers/devkit/audiokit/audio_misc/audio_wakeup_info/Kconfig
```kconfig
config AUDIO_WAKEUP_INFO
    bool "audio wakeup info driver"
    default n
    help
    Say Y to enable audio wakeup info driver support
```

## kernel/kernel/linux-5.10-lts/drivers/devkit/audiokit/audio_misc/battery_state/Kconfig
```kconfig
config AUDIO_BATTERY_STATE
    bool "battery state driver"
    default n
    help
    Say Y to enable battery state driver support
```

## kernel/kernel/linux-5.10-lts/drivers/devkit/audiokit/audio_misc/collec_audio_info/Kconfig
```kconfig
config COLLEC_AUDIO_INFO
    bool "collec audio info driver"
    default n
    help
    Say Y to enable collec audio info driver support
```

## kernel/kernel/linux-5.10-lts/drivers/devkit/audiokit/audio_misc/hifi_report/Kconfig
```kconfig
config AUDIO_HIFI_REPORT
    bool "hifi report driver"
    default n
    help
    Say Y to enable hifi report driver support
```

## kernel/kernel/linux-5.10-lts/drivers/devkit/audiokit/audio_misc/vendorcountry_state/Kconfig
```kconfig
config AUDIO_VENDORCOUNTRY_STATE
    bool "vendorcountry state driver"
    default n
    help
    Say Y to enable vendorcountry state driver support
```
