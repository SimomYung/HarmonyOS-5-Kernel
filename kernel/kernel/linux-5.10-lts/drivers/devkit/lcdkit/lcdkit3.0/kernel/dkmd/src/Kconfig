## kernel/kernel/linux-5.10-lts/drivers/devkit/lcdkit/lcdkit3.0/kernel/dkmd/src/Kconfig
```kconfig
#
# lcdkit hisi driver configuration
#

menuconfig LCD_KIT_HISI
	bool "lcd kit 3.0 hisi driver"
	default n
	help
	   If you say yes here you get support for lcd kit hisi driver.

#
# lcdkit hybrid driver configuration
#
menuconfig LCD_KIT_HYBRID
	bool "lcd kit 3.0 hybrid driver"
	default n
	help
	   If you say yes here you get support for lcd kit hybrid driver.
```

## kernel/kernel/linux-5.10-lts/drivers/dma-buf/heaps/Kconfig
```kconfig
config DMABUF_HEAPS_SYSTEM
	bool "DMA-BUF System Heap"
	depends on DMABUF_HEAPS
	select DMABUF_MM
	help
	  Choose this option to enable the system dmabuf heap. The system heap
	  is backed by pages from the buddy allocator. If in doubt, say Y.

config DMABUF_HEAPS_CMA
	bool "DMA-BUF CMA Heap"
	depends on DMABUF_HEAPS && DMA_CMA
	select DMABUF_MM
	help
	  Choose this option to enable dma-buf CMA heap. This heap is backed
	  by the Contiguous Memory Allocator (CMA). If your system has these
	  regions, you should say Y here.
```

## kernel/kernel/linux-5.10-lts/drivers/file_guard/Kconfig
```kconfig
#
# huawei file guard support in kernel
#

config FILEGUARD_NETWORK
	bool "enable file_guard network"
	default n
	help
		If you say yes here you get support for huawei file guard network.

config FILEGUARD_IPCWORK
	bool "enable file_guard ipcwork"
	default n
	help
		If you say yes here you get support for huawei file guard ipcwork.
```

## kernel/kernel/linux-5.10-lts/drivers/hid/i2c-hid/Kconfig
```kconfig
# SPDX-License-Identifier: GPL-2.0-only
menu "I2C HID support"
	depends on I2C

config I2C_HID
	tristate "HID over I2C transport layer"
	default n
	depends on I2C && INPUT
	select HID
	help
	  Say Y here if you use a keyboard, a touchpad, a touchscreen, or any
	  other HID based devices which is connected to your computer via I2C.

	  If unsure, say N.

	  This support is also available as a module.  If so, the module
	  will be called i2c-hid.

config I2C_HID_ASYNC
	tristate "HID over I2C asynchronously load"
	default n
	depends on I2C_HID
	select HID
	help
	  Say Y here if you want to speed your start process.

	  If unsure, say N.

endmenu
```

## kernel/kernel/linux-5.10-lts/drivers/hisi/Kconfig
```kconfig
menu "Hisilicon platform"

menuconfig HISILICON_PLATFORM
	bool "Hisilicon platform support"
	default n
	help
	  Say yes here to support the hisilicon platform

if HISILICON_PLATFORM

source "drivers/hisi/hi1103_eeprom/Kconfig"


endif #HISILICON_PLATFORM

endmenu
```

## kernel/kernel/linux-5.10-lts/drivers/hisi/tzdriver/agent_rpmb/Kconfig
```kconfig
config RPMB_AGENT
	bool "Tzdriver Rpmb Agent"
	default n
	depends on TZDRIVER
	help
	  Tzdriver Rpmb Agent

config SSD_VRPMB_SUPPORT
	bool "Tzdriver vrpmb support"
	default n
	depends on TZDRIVER && RPMB_AGENT
	help
	  Tzdriver SSD vrpmb
```

## kernel/kernel/linux-5.10-lts/drivers/hisi/tzdriver/core/Kconfig
```kconfig
# Framework Configuration
config CPU_AFF_NR
	int "Default Cpu Affinity"
	default 0
	depends on TZDRIVER
	help
	  Default Cpu Affinity

config DRM_ADAPT
	bool "Drm Feature Adapt"
	default n
	depends on TZDRIVER
	help
	  Drm Feature Adapt

config TA_AFFINITY
	bool "TA affinity"
	default n
	depends on TZDRIVER
	help
	  TA Cpu Affinity bind range, consistent with CONFIG_MAX_NUM_NODES in TEE

config TA_AFFINITY_CPU_NUMS
	int "TA affinity max support cpus"
	default 8
	depends on TA_AFFINITY
	help
	  consistent with CONFIG_MAX_NUM_NODES in TEE

config TEECD_AUTH
	bool "Teec Daemon Path Hash Auth"
	default n
	depends on TZDRIVER
	help
	  TEEOS TEECD path hash auth

config TEE_AUDIT
	bool "Audit TA"
	default n
	depends on AUTH_ENHANCE
	help
	  Audit TA in case of evil TA

config KERNEL_CLIENT
	bool "Kernel Client Interface"
	default n
	depends on TZDRIVER
	help
	  Kernel Client Interface

config BIG_SESSION
	bool "open more sessions"
	default n
	depends on TZDRIVER
	help
	  TEEOS open more sessions

config FFA_SUPPORT
	bool "FFA Support Enable"
	default n
	depends on TZDRIVER
	help
	  FFA Support Enable

config ENABLE_DSTB
	bool "TEE enable dstb service"
	default n
	depends on TZDRIVER
	help
	  TEE Enable Dstb Service

config TEE_RESET
	bool "TEE Reset Support Enable"
	default n
	depends on TZDRIVER
	help
	  TEE Reset Support Enable

config TZ_S4_SUPPORT
	bool "TEE S4 Support Enable"
	default n
	depends on TZDRIVER
	help
	  TEE S4 Support Enable

config S4_SUSPEND_DRIVER_ONLY
	bool "TEE S4 suspend driver only"
	default n
	depends on TZ_S4_SUPPORT
	help
	  TEE S4 suspend driver only

config TZ_RESERVED_MAILBOX
	bool "Tzdriver support reserved mailbox buffer"
	default n
	depends on TZDRIVER
	help
	  Tzdriver Support Reserved Mailbox Buffer

config ENABLE_TA_CTRL
	bool "Enable TA Control Feature"
	default n
	depends on TZDRIVER
	help
	  Enable TA Control Feature

config RPMB_AGENT_IO_PRIO
	bool "RPMB agent io priority"
	default n
	depends on TZDRIVER
	help
	  Increase the thread scheduling priority of agent_rpmb
```

## kernel/kernel/linux-5.10-lts/drivers/hooks/Kconfig
```kconfig
# SPDX-License-Identifier: GPL-2.0
menu "Vendor Hooks"

config VENDOR_HOOKS
	bool "Vendor Hooks"
	depends on TRACEPOINTS
	help
	  Enable vendor hooks implemented as tracepoints

	  Allow vendor modules to attach to tracepoint "hooks" defined via
	  DECLARE_TRACE or DECLARE_HOOK

config ANDROID_STRUCT_PADDING
	bool "Android Struct Padding"
	default y
	help
	  This option enables the padding that the Android GKI kernel adds
	  to many different kernel structures to support an in-kernel stable ABI
	  over the lifespan of support for the kernel as well as OEM additional
	  fields that are needed by some of the Android kernel tracepoints.

	  Only disable this option if you have a system that needs the Android
	  kernel drivers, but is NOT an Android GKI kernel image and you do NOT
	  use the Android kernel tracepoints. If disabled it has the possibility
	  to make the kernel static and runtime image slightly smaller but will
	  NOT be supported by the Google Android kernel team.

	  If even slightly unsure, say Y.

endmenu
```

## kernel/kernel/linux-5.10-lts/drivers/huawei_platform/audio/hwcxext_codec_hmpc/Kconfig
```kconfig
menuconfig HWCXEXT_CODEC_MODULE_HMPC
	bool "hwcxext codec drivers support"
	default n
	help
	Say yes here to support the hwcxext codec module pc

if HWCXEXT_CODEC_MODULE_HMPC
config HWCXEXT_CODEC_INTERFACE_HMPC
	tristate "Support for HWCXEXT_CODEC_INTERFACE_HMPC"
	default n
	help
	 Say Y here if you want to support HWCXEXT_CODEC_INTERFACE_HMPC
config HWCXEXT_CODEC_V1_HMPC
	tristate "Support for hwcxext codec v1 pc"
	default n
	help
	 Say Y here if you want to support hwcxext codec v1 pc
config HWCXEXT_MBHC_HMPC
	tristate "Support for hwcxext mbhc pc"
	default n
	help
	 Say Y here if you want to support hwcxext mbhc pc
config HWCXEXT_I2C_OPS_HMPC
	tristate "Support for hwcxext i2c ops pc"
	default n
	help
	 Say Y here if you want to support hwcxext i2c ops pc
endif #HWCXEXT_CODEC_MODULE_HMPC
```

## kernel/kernel/linux-5.10-lts/drivers/huawei_platform/dp_source/Kconfig
```kconfig
config HW_DP_SOURCE
        bool "huawei DP_SOURCE"
        default n
        help
            if you say yes here you get support for huawei DP source switch check.

config SUPPORT_MULTI_DP_DISPLAY
        bool "huawei SUPPORT_MULTI_DP_DISPLAY
        default n
        help
            if you say yes here you get support for multi dp display.
```

## kernel/kernel/linux-5.10-lts/drivers/huawei_platform/echub/battery/Kconfig
```kconfig
#
# echub battery moudule
#

config ARMPC_ECHUB_BATTERY
        bool "echub battery"
        depends on ARMPC_ECHUB
        default n
        help
          This driver provides support for echub battery

config HW_ECHUB_CHARGER
        bool "ec charger"
        depends on ARMPC_ECHUB
        default n
        help
          This driver provides support for echub charger

config HW_ECHUB_CHARGEDATA
        bool "ec chargedata"
        depends on ARMPC_ECHUB_I2C && ARMPC_ECHUB_HMI
        default n
        help
          This driver provides support for echub chargedata

config HW_ECHUB_FLOAT_CHARGE
        bool "ec float charge"
        depends on ARMPC_ECHUB_BATTERY
        default n
        help
          This driver provides support for ec custom charge and smart charge

config HW_ECHUB_TURBO_CHARGE
        bool "ec turbo charge"
        depends on ARMPC_ECHUB_BATTERY
        default n
        help
          This driver provides support for ec turbo charge

config HW_ECHUB_SHIP_MODE
        bool "ec ship mode"
        depends on ARMPC_ECHUB_BATTERY
        default n
        help
          This driver provides support for echub ship mode

config HW_ECHUB_LADDER_STANDBY
        bool "ec ladder standby"
        depends on HW_ECHUB_CHARGEDATA
        default n
        help
          This driver provides support for ec ladder standby

config HW_ECHUB_DECIMAL
        bool "ec soc decimal"
        depends on ARMPC_ECHUB_BATTERY
        default n
        help
          This driver provides support for ec soc decimal
```

## kernel/kernel/linux-5.10-lts/drivers/huawei_platform/echub/echub_log/Kconfig
```kconfig
#
# echub dfx interface
#

config ARMPC_ECHUB_LOG
	bool "echub log"
	depends on ARMPC_ECHUB
	default n
	help
	  This driver supports echub log interface.

config ARMPC_ECHUB_COMBINE_KEY_FASTBOOT
	bool "echub combine key to fastboot"
	depends on ARMPC_ECHUB_HMI
	default n
	help
	  This driver supports press combine key to fastboot.
```

## kernel/kernel/linux-5.10-lts/drivers/huawei_platform/echub/fnled/Kconfig
```kconfig
#
# Sends commands to the EC through the I2C.
#

config ARMPC_ECHUB_FNLED
	bool "Keyboard fn led"
	depends on ARMPC_ECHUB
	default n
	help
	  This driver supports the fn indicator to return to the restarted state.

config ARMPC_ECHUB_SMART_LED
	bool "Keyboard smart led"
	depends on ARMPC_ECHUB
	default n
	help
	  This driver supports the smart led to return to the led state.
```

## kernel/kernel/linux-5.10-lts/drivers/huawei_platform/echub/pogopin/Kconfig
```kconfig
#
# echub pogopin moudule
#

config ARMPC_ECHUB_POGOPIN
        bool "echub pogopin"
        depends on ARMPC_ECHUB
        default n
        help
          This driver provides support for ec pogopin
```

## kernel/kernel/linux-5.10-lts/drivers/huawei_platform/echub/switch/Kconfig
```kconfig
#
# echub switch moudule
#


config ARMPC_ECHUB_SWITCH
        bool "echub switch func"
        depends on ARMPC_ECHUB
        default n
        help
          This driver provides support for tablet mode
          via GPIO.
```

## kernel/kernel/linux-5.10-lts/drivers/huawei_platform/echub/thermal/Kconfig
```kconfig
#
# echub thermal moudule
#

config  PC_ECHUB_THERMAL
        bool "echub thermal"
        depends on ARMPC_ECHUB
        default n
        help
          This driver provides support for echub thermal

config THERMAL_DEVICE_INTERFACE
	bool "thermal device interface"
	depends on ARMPC_ECHUB
	default n
	help
	  Say Yes here to support thermal device interface

config ARMPC_ECHUB_OVERHEAT
        bool "echub overheat protect"
        depends on ARMPC_ECHUB_I2C && LPM_HKADC
        default n
        help
          This driver provides support for echub overheat protect

config ARMPC_ECHUB_FAN
        bool "echub fan control"
        depends on ARMPC_ECHUB_I2C && BLPWM
        default n
        help
          This driver provides support for echub fan control

config  ECHUB_SYNC_THERMAL
        bool "sync thermal to ec"
        depends on ARMPC_ECHUB
        default n
        help
          This driver provides support for sync thermal
```

## kernel/kernel/linux-5.10-lts/drivers/huawei_platform/ext_camera_eeprom/Kconfig
```kconfig
config HW_CAMERA_EXTERNAL_EEPROM
	bool "huawei external CAMERA EEPROM device control"
	default n
	help
	  Say yes here to support external CAMERA EEPROM device control.
```

## kernel/kernel/linux-5.10-lts/drivers/huawei_platform/hw_peripheral/dp2mipi/Kconfig
```kconfig
#
# huawei LT6911GXD drivers
#

config HW_LT6911GXD_DRIVER
	tristate "LT6911GXD driver"
	default n
	help
	  MCU LT6911GXD I2C driver.
```

## kernel/kernel/linux-5.10-lts/drivers/huawei_platform/inputhub/Kconfig
```kconfig
menuconfig INPUTHUB
	bool "InputHub feature support"
	default n
	help
	Say yes here to support inputhub feature.

menuconfig INPUTHUB_20
	bool "InputHub feature2.0 support"
	default n
	help
	Say yes here to support inputhub2.0 feature.

menuconfig CYPRESS_PSOC4000
	bool "cypress capsense support"
	default n
	help
	Say yes here if you want to configure cypress capsense

config INPUTHUB_20_710
	bool "INPUTHUB_20_710"
	depends on INPUTHUB_20 && !INPUTHUB_30
	default n
	help
	Say yes here if you want to configure INPUTHUB_20 version

config INPUTHUB_20_970
	bool "INPUTHUB_20_970"
	depends on INPUTHUB_20 && !INPUTHUB_30
	default n
	help
	Say yes here if you want to configure INPUTHUB_20 version

config CONTEXTHUB_IDLE_32K
	bool "CONTEXTHUB_IDLE_32K"
	depends on INPUTHUB || INPUTHUB_20
	default n
	help
	Say yes here if you want to configure CONTEXTHUB_IDLE_32K

config IOM3_RECOVERY
	bool "iom3 recovery feature support"
	depends on INPUTHUB
	default n
	help
	Say yes here to support the cmdline parse

config INPUTHUB_VIBRATOR_CHANNEL
	bool "inputhub vibrator channel support"
	depends on INPUTHUB || INPUTHUB_20
	default n
	help
	Say yes here to support the cmdline parse

config MLPS_OPERATE_CONN
	bool "mlps operate conn support"
	depends on INPUTHUB_20
	default n
	help
	Say yes here to support the cmdline parse

config INPUTHUB_PLAT_C
	bool "target platform for INPUTHUB"
	default n
	help
	Say yes here to support the C platform

config INPUTHUB_SENSORHUB_IPC
	bool "sensorhub ipc debug channel"
	default n
	help
	Say yes here to support the IPC debug

config INPUTHUB_MAG_EXTEND_DATA
	bool "mag support extend data"
	default n
	help
	Say yes here to support mag extend data

config INPUTHUB_PS_EXTEND_DATA
	bool "ps support extend data"
	default n
	help
	Say yes here to support ps extend data
```

## kernel/kernel/linux-5.10-lts/drivers/huawei_platform/kapi_test/Kconfig
```kconfig
# SPDX-License-Identifier: GPL-2.0

config KAPI_TEST
	bool "kapi test"
	help
	  Performance and stability test for
	  linux kernel api.
```

## kernel/kernel/linux-5.10-lts/drivers/huawei_platform/net/phy/Kconfig
```kconfig
if PHYLIB
config HW_MOTORCOMM_PHY
        tristate "Motorcomm PHYS"
	      default y
        help
          Support the YT8521
endif
```

## kernel/kernel/linux-5.10-lts/drivers/huawei_platform/nfc/nfc_watch_commu/Kconfig
```kconfig
#
# Near Field Communication (NFC) devices
#
config NFC_WATCH_COMMU
	tristate "NFC WATCH COMMU"
	depends on I2C
	select CRC_CCITT
	default n
	help
	  Say yes if you want watch commu driver.
	  This is for watch commu connected version. If unsure, say N here.

	  To compile this driver as a module, choose m here. The module will
	  be called watch commu.
```

## kernel/kernel/linux-5.10-lts/drivers/huawei_platform/power/battery/battery_ct/fdw/fm1210/Kconfig
```kconfig
# SPDX-License-Identifier: GPL-2.0+
#
# IC FM1210 drivers
#

config HUAWEI_BATTCT_FM1210
	bool
	prompt "Support fm1210 as certification IC."
	depends on HUAWEI_BATTERY_INFORMATION
	default n
	help
	  Say Y here to enable fm1210 ic driver
```

## kernel/kernel/linux-5.10-lts/drivers/huawei_platform/power/hw_kstate/Kconfig
```kconfig
config HUAWEI_KSTATE
    tristate "Huawei Kernel State"
    help
        Huawei kernel state, please choose it.

config HW_BINDER_RECORD
	bool "Huawei Binder Record"
	depends on HUAWEI_KSTATE
	default n
	help
		Record the binder time, Unfrozen processes do not report the binder.
```
