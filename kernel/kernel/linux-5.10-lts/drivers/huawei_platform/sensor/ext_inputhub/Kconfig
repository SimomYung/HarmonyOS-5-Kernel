## kernel/kernel/linux-5.10-lts/drivers/huawei_platform/sensor/ext_inputhub/Kconfig
```kconfig
menuconfig EXT_INPUTHUB_DRIVER_SDIO
	bool "External InputHub feature support sdio driver"
	depends on EXT_INPUTHUB
	default n
	help
	Say yes here to support external sensorhub feature.

menuconfig EXT_INPUTHUB_DRIVER_SPI
	bool "External InputHub feature support sdio driver"
	depends on EXT_INPUTHUB
	default n
	help
	Say yes here to support external sensorhub feature.

menuconfig EXT_INPUTHUB_DRIVER_UART
	bool "External InputHub feature support sdio driver"
	depends on EXT_INPUTHUB
	default y
	help
	Say yes here to support external sensorhub feature.

menuconfig EXT_INPUTHUB_DRIVER_SPI_SLAVE
	bool "External InputHub feature support sdio driver"
	depends on EXT_INPUTHUB
	default y
	help
	Say yes here to support external sensorhub feature.

menuconfig EXT_INPUTHUB
	bool "External InputHub feature support"
	default n
	help
	Say yes here to support external sensorhub feature.

menuconfig EXT_INPUTHUB_IPC_COMMU
	bool "External InputHub ipc commu feature support"
	depends on EXT_INPUTHUB
	default n
	help
	Say yes here to support external sensorhub feature.

menuconfig EXT_INPUTHUB_COMMU
	bool "External InputHub common commu feature support"
	depends on EXT_INPUTHUB
	default y
	help
	Say yes here to support external sensorhub feature.

menuconfig EXT_INPUTHUB_INNER_CMD
	bool "External InputHub inner cmd feature support"
	depends on EXT_INPUTHUB
	default y
	help
	Say yes here to support external sensorhub feature.

menuconfig EXT_INPUTHUB_COMMON_CMD
	bool "External InputHub common cmd feature support"
	depends on EXT_INPUTHUB
	default y
	help
	Say yes here to support external sensorhub feature.

menuconfig EXT_INPUTHUB_FILETRANSFER
	bool "External InputHub feature support"
	depends on EXT_INPUTHUB
	default y
	help
	Say yes here to support external sensorhub feature.

menuconfig EXT_INPUTHUB_FILETRANSFER_SHAREMEM
	bool "External InputHub feature support"
	depends on EXT_INPUTHUB
	default n
	help
	Say yes here to support external sensorhub feature.

menuconfig EXT_INPUTHUB_TIMESYNC
	bool "External InputHub feature support"
	depends on EXT_INPUTHUB
	default y
	help
	Say yes here to support external sensorhub feature.

menuconfig EXT_INPUTHUB_MATTING
	bool "External InputHub feature support"
	depends on EXT_INPUTHUB
	default y
	help
	Say yes here to support external sensorhub feature.

menuconfig EXT_INPUTHUB_MATTING_ALSC
	bool "hisi alsc platform support matting algo feature"
	default n
	help
	Say yes here to support matting algo feature for hisi alsc platform.
```

## kernel/kernel/linux-5.10-lts/drivers/huawei_platform/sensor/ext_inputhub/dagger/Kconfig
```kconfig
# SPDX-License-Identifier: GPL-2.0-only

menuconfig DAGGER_KEY
	bool "dagger key"
	help
	  Say Y here, and a list of supported dagger key will be displayed.
	  This option doesn't affect the kernel.
```

## kernel/kernel/linux-5.10-lts/drivers/huawei_platform/sensor/ext_inputhub/div/Kconfig
```kconfig
# SPDX-License-Identifier: GPL-2.0-only
 
menuconfig DIV_KEY
	bool "div key"
	help
	  Say Y here, and a list of supported div key will be displayed.
	  This option doesn't affect the kernel.
```

## kernel/kernel/linux-5.10-lts/drivers/huawei_platform/sensor/super_privacy/Kconfig
```kconfig
#
# super privacy driver configuration
#

config SUPER_PRIVACY
	bool "super privacy support"
	default n
	help
	Say yes here to support super privacy feature.
```

## kernel/kernel/linux-5.10-lts/drivers/huawei_platform/taskmanager_collector/Kconfig
```kconfig
#
# taskmanager collector driver configuration
#
menuconfig TASK_MANAGER_COLLECTOR
	bool "taskmanager collector driver"
	default n
	help
	Say yes here to support for taskmanager collector.
```

## kernel/kernel/linux-5.10-lts/drivers/huawei_platform/usb/Kconfig
```kconfig
source "drivers/huawei_platform/usb/switch/Kconfig"
source "drivers/huawei_platform/usb/otg_gpio_switch/Kconfig"
source "drivers/huawei_platform/usb/typec/Kconfig"
source "drivers/huawei_platform/usb/pd/Kconfig"
source "drivers/huawei_platform/usb/otg_gpio_id/Kconfig"
source "drivers/huawei_platform/usb/superswitch/Kconfig"
source "drivers/huawei_platform/usb/otg_dual_role/Kconfig"
source "drivers/huawei_platform/usb/hw_pogopin/Kconfig"
source "drivers/huawei_platform/usb/hw_ycable/Kconfig"
source "drivers/huawei_platform/usb/hw_hishow/Kconfig"
source "drivers/huawei_platform/usb/usb_extra_modem/Kconfig"
source "drivers/huawei_platform/usb/usbhub/Kconfig"
source "drivers/huawei_platform/usb/check_usbmode/Kconfig"
source "drivers/huawei_platform/usb/multi_port/cs32g050/Kconfig"
source "drivers/huawei_platform/usb/pm/Kconfig"
source "drivers/huawei_platform/usb/net/Kconfig"
source "drivers/huawei_platform/usb/smart_usb/Kconfig"
-source "drivers/huawei_platform/usb/usb_iot_driver/Kconfig"
```

## kernel/kernel/linux-5.10-lts/drivers/huawei_platform/usb/pm/Kconfig
```kconfig
#
# USB PM Driver
#
config HW_USB_PM
	bool "USB PM Driver"
	help
	  Say Y to enable USB PM Driver
```

## kernel/kernel/linux-5.10-lts/drivers/huawei_platform/usb/smart_usb/Kconfig
```kconfig
#smart usb
menuconfig HUAWEI_ARMPC_SMART_USB
	bool "hw armpc smart usb"
	default n
	help
	Say yes here to support smart usb for hw arm PC.
```

## kernel/kernel/linux-5.10-lts/drivers/huawei_platform/usb/usb_iot_driver/Kconfig
```kconfig
config USB_IOT_DRIVERS
	bool "Enable USB IoT drivers"
	default n
	help
		This option enables support for USB IoT drivers

source "drivers/huawei_platform/usb/usb_iot_driver/hid_hdrc/Kconfig"
source "drivers/huawei_platform/usb/usb_iot_driver/usb_mode_switch/Kconfig"
source "drivers/huawei_platform/usb/usb_iot_driver/tv_flash_adapter/Kconfig"
source "drivers/huawei_platform/usb/usb_iot_driver/tv_pwm_adapter/Kconfig"
source "drivers/huawei_platform/usb/usb_iot_driver/power_key/Kconfig"
source "drivers/huawei_platform/usb/usb_iot_driver/input/misc/Kconfig"
source "drivers/huawei_platform/usb/usb_iot_driver/i2c/Kconfig"
source "drivers/huawei_platform/usb/usb_iot_driver/leds/Kconfig"
-source "drivers/huawei_platform/usb/usb_iot_driver/net/ethernet/yt6801/Kconfig"
-source "drivers/huawei_platform/usb/usb_iot_driver/lsw/Kconfig"
source "drivers/huawei_platform/usb/usb_iot_driver/fan/Kconfig"
source "drivers/huawei_platform/usb/usb_iot_driver/audio/adc/Kconfig"
```

## kernel/kernel/linux-5.10-lts/drivers/huawei_platform/usb/usb_iot_driver/audio/adc/Kconfig
```kconfig
#
#adc config driver configuration
#
menuconfig SND_SOC_ES7243L
        bool "es7243l config driver"
        default n
        help
        Say yes here to support for es7243l config driver.
```

## kernel/kernel/linux-5.10-lts/drivers/huawei_platform/usb/usb_iot_driver/fan/Kconfig
```kconfig
# SPDX-License-Identifier: GPL-2.0

config FAN_ROTATE
	tristate "fan rotate support"
	default n
	help
	  Support the fan for some devices.
```

## kernel/kernel/linux-5.10-lts/drivers/huawei_platform/usb/usb_iot_driver/hid_hdrc/Kconfig
```kconfig
config HID_HDRC
	tristate "HDRC HID devices"
	depends on HID
	default n
	help
	Support for HDRC devices.
```

## kernel/kernel/linux-5.10-lts/drivers/huawei_platform/usb/usb_iot_driver/i2c/Kconfig
```kconfig
# SPDX-License-Identifier: GPL-2.0

config I2C_RTC_RX8900
	depends on RTC_CLASS
	bool "i2c support rtc 8900"
	default n
	help
	 i2c support rtc 8900 or not.
```

## kernel/kernel/linux-5.10-lts/drivers/huawei_platform/usb/usb_iot_driver/input/misc/Kconfig
```kconfig
# SPDX-License-Identifier: GPL-2.0

config GPIO_KEY
	bool "GPIO_KEY"
	default n
	help
	  Say Y to enable support for gpio key.
```

## kernel/kernel/linux-5.10-lts/drivers/huawei_platform/usb/usb_iot_driver/leds/Kconfig
```kconfig
# SPDX-License-Identifier: GPL-2.0

config GPIO_LED
	bool "GPIO_LED"
	default n
	help
	  Say Y to enable support for gpio led.

config LAMP_EFFECT
	bool "LAMP_EFFECT"
	default n
	help
	  Say Y to enable support for lamp effect.
```

## kernel/kernel/linux-5.10-lts/drivers/huawei_platform/usb/usb_iot_driver/lsw/Kconfig
```kconfig
# SPDX-License-Identifier: GPL-2.0

config EXT_LSW
	bool "Support Ext Lan Switch"
	default n

config L2SW_DEBUG
	bool "Lan Switch debug"
	depends on EXT_LSW
	default n

config ESC2507_LSW
	bool "ESC2507 Lan Switch"
	depends on EXT_LSW
	default n

config RTL8367_LSW
	bool "RTL8367 Lan Switch"
	depends on EXT_LSW
	default n
```

## kernel/kernel/linux-5.10-lts/drivers/huawei_platform/usb/usb_iot_driver/net/ethernet/yt6801/Kconfig
```kconfig
config PCIE_NETCARD_YT6801
	bool "support pcie netcard yt6801"
	default n
	depends on PCI
	help
		support pcie netcard yt6801
```

## kernel/kernel/linux-5.10-lts/drivers/huawei_platform/usb/usb_iot_driver/power_key/Kconfig
```kconfig
# SPDX-License-Identifier: GPL-2.0

config POWERKEY_TV
	bool "huawei tv power key"
	default n
	help
	  Say Y to enable support for the tv power key driver.

config POWERKEY_PWRON
	bool "huawei poweron power key"
	default n
	help
	  Say Y to enable support for the poweron power key driver.
```

## kernel/kernel/linux-5.10-lts/drivers/huawei_platform/usb/usb_iot_driver/tv_flash_adapter/Kconfig
```kconfig
#
# tv flash adapter driver configuration
#

config TV_FLASH_ADAPTER
	bool "TV_FLASH_ADAPTER"
	default n
	help
		Say yes here to support TV FLASH ADAPTER
```

## kernel/kernel/linux-5.10-lts/drivers/huawei_platform/usb/usb_iot_driver/tv_pwm_adapter/Kconfig
```kconfig
#
# tv pwm adapter driver configuration
#

config BLPWM_TV_ADAPTER
	bool "blpwm tv adapter"
	depends on BLPWM
	default n
	help
		Say yes here to support BLPWM TV ADAPTER
```

## kernel/kernel/linux-5.10-lts/drivers/huawei_platform/usb/usb_iot_driver/usb_mode_switch/Kconfig
```kconfig
config USB_MODE_SWITCH
	bool "USB MODE SWITCH support"
	depends on USB_HIUSB
	default n
	help
	  Say yes here to support the usb mode switch to device by gpio

config USB_NDEV_CONFIG
	bool "USB TO ETH ndev config support"
	default n
	help
	  Say yes here to support reconfig eth usb to eth ndev

config USB_MODE_SWITCH_ATTR
	bool "USB MODE SWITCH ATTR support"
	default n
	help
	  Say yes here to support the usb mode switch to device by attr
```

## kernel/kernel/linux-5.10-lts/drivers/huawei_platform/uwb/nrt82885/Kconfig
```kconfig
# SPDX-License-Identifier: GPL-2.0-only
#
# SPI driver configuration
#
menuconfig UWB_NRT82885
	tristate "NRT82885 UWB SPI driver"
	help
	  This supports NRT82885 UWB device.
```

## kernel/kernel/linux-5.10-lts/drivers/hwpower/cc_battery/battery_info_storage/Kconfig
```kconfig
# SPDX-License-Identifier: GPL-2.0
#
# huawei battery info storage driver
#

config HUAWEI_BATTERY_INFO_STORAGE
	bool "huawei battery info storage driver"
	default n
	help
	  Say Y here to enable battery info storage driver.
	  This driver provides a unified interface to
	  get battery info.
```
