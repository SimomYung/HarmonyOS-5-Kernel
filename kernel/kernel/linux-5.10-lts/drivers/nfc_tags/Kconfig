## kernel/kernel/linux-5.10-lts/drivers/nfc_tags/Kconfig
```kconfig
config NFC_TAGS
	tristate "nfc tags"
	depends on I2C
	default n
	help
	   NFC tag controller core driver.
```

## kernel/kernel/linux-5.10-lts/drivers/staging/android/Kconfig
```kconfig
# SPDX-License-Identifier: GPL-2.0
menu "Android"

if ANDROID

config ASHMEM
	bool "Enable the Anonymous Shared Memory Subsystem"
	depends on SHMEM
	help
	  The ashmem subsystem is a new shared memory allocator, similar to
	  POSIX SHM but with different behavior and sporting a simpler
	  file-based API.

	  It is, in theory, a good memory allocator for low-memory devices,
	  because it can discard shared memory units when under memory pressure.

config ANDROID_LOW_MEMORY_KILLER
	bool "Android Low Memory Killer"
	help
	  Registers processes to be killed when low memory conditions, this is useful
	  as there is no particular swap space on android.

	  The registered process will kill according to the priorities in android init
	  scripts (/init.rc), and it defines priority values with minimum free memory size
	  for each priority.

config ANDROID_LOW_MEMORY_KILLER_DAEMON
	bool "Android Low Memory Killer Daemon"
	depends on !ANDROID_LOW_MEMORY_KILLER
	default n
	help
	  This is a userspace daemon process used to kill processes in low-memory situations.
	  ANDROID_LOW_MEMORY_KILLER_DAEMON and ANDROID_LOW_MEMORY_KILLER can only choose one.

source "drivers/staging/android/ion/Kconfig"

source "drivers/staging/android/hwlogger/Kconfig"

endif # if ANDROID

endmenu
```

## kernel/kernel/linux-5.10-lts/drivers/staging/ucollection/Kconfig
```kconfig
# SPDX-License-Identifier: GPL-2.0
config UNIFIED_COLLECTION
	tristate "Enable unified collection"
	help
	  Unified collection driver

config HUAWEI_PERFD
	bool "cpu load"
	help
	  Enable get the running time of each frequency point of the CPU
```

## kernel/kernel/linux-5.10-lts/drivers/video/fbdev/akmd/Kconfig
```kconfig
config AKMD_ENABLE
	bool "AKMD driver support"
	default n
	help
	  This feature driver supports akmd driver.

config AKMD_AAE_RES_MGR
	bool "AKMD aae resource manager"
	default n
	help
	  This feature supports aae resource manager

config AKMD_AAE_DEVICE
	bool "AKMD aae device"
	default n
	help
	  This feature supports aae device

source "drivers/video/fbdev/akmd/aksm/Kconfig"
```

## kernel/kernel/linux-5.10-lts/drivers/video/fbdev/dkmd/aod/Kconfig
```kconfig
config DKMD_AOD_DEBUG
	bool "support DKMD aod debug function"
	default n
	help
	  This feature driver supports aod debug function.
```

## kernel/kernel/linux-5.10-lts/drivers/video/fbdev/ukmd/cmdlist/Kconfig
```kconfig
config UKMD_CMDLIST_ENABLE
	bool "UKMD support cmdlist driver"
	default n
	depends on DMA_CMA
	depends on UKMD_UKSM
	help
	  This feature driver supports UKMD config by cmdlist.
```

## kernel/kernel/linux-5.10-lts/include/hwnet/hw_rf/Kconfig
```kconfig
config HW_RF
	tristate "kernel space hw_rf communicate with user space use vcom."
    default n
    help
	  rf kernel driver.
```

## kernel/kernel/linux-5.10-lts/include/hwpower/cc_hardware_ic/boost_ic/Kconfig
```kconfig
# SPDX-License-Identifier: GPL-2.0
#
# huawei boost drivers
#

config BOOST_SC8726
	bool "boost sc8726"
	default n
	help
	  Say Y here to enable boost sc8726 driver.

config BOOST_SC8886
	bool "boost sc8886"
	default n
	help
	  Say Y here to enable boost sc8886 driver.
```

## kernel/kernel/linux-5.10-lts/kernel/cgroup_workingset/Kconfig
```kconfig
config HW_CGROUP_WORKINGSET
        bool "workingset cgroup subsystem"
        depends on CRYPTO_CRC32C
        depends on TASK_DELAY_ACCT
        help
          Provides a cgroup implementing filepage collector and prereader of workingset.
          This cgroup workingset for application, collect it touched filepages and
          preread those filepages.

config HW_CGROUP_WORKINGSET_FAULT_AROUND
        bool "workingset fault around feature"
        depends on HW_CGROUP_WORKINGSET
        help
          Precisely map as many pages as possible around the page fault exception address
          in advance, which base on cgroup workingset.
```

## kernel/kernel/linux-5.10-lts/kernel/user_handle_freezing/Kconfig
```kconfig
config USER_HANDLE_FREEZING
    bool "back to user space before freeze"
    depends on FREEZER
    help
        Try to choose one thread back to user space do something
        when application is going to freeze.
```

## kernel/kernel/linux-5.10-lts/mm/high_randomize/Kconfig
```kconfig
# SPDX-License-Identifier: GPL-2.0-or-later
# Copyright (c) 2023 Huawei Device Co., Ltd.
#
# Config for high randomize address of process manager
#

menu "High address randomize manager"

config OH_HIGH_RANDOMIZE
	default n
	bool "High randomize memory address"
	help
	  Select high randomize memory address or not.
endmenu
# a blank line must be existed
```

## kernel/kernel/linux-5.10-lts/net/smartcom/Kconfig
```kconfig
menuconfig HUAWEI_SMARTCOM
    bool "Huawei smartcom feature support"
    default n
    help
    Say yes here to support smartcom feature

if HUAWEI_SMARTCOM
source "net/smartcom/schedule_driver/Kconfig"
source "net/smartcom/nstack/Kconfig"
source "net/smartcom/mpflow/Kconfig"
source "net/smartcom/nat_trav/Kconfig"
endif # if HUAWEI_SMARTCOM
```

## kernel/kernel/linux-5.10-lts/net/smartcom/mpflow/Kconfig
```kconfig
menuconfig HUAWEI_SMARTCOM_MPFLOW
    bool "Huawei smartcom mpflow feature support"
    default n
```

## kernel/kernel/linux-5.10-lts/net/smartcom/nat_trav/Kconfig
```kconfig
menuconfig HUAWEI_NAT_TRAV
    bool "Huawei smartcom nat traversal feature support"
    default n
```

## kernel/kernel/linux-5.10-lts/net/smartcom/nstack/Kconfig
```kconfig
menuconfig HW_SMARTCOM_NSTACK
	bool "Huawei Smartcom Nstack"
	depends on HUAWEI_SMARTCOM
	default n

if HW_SMARTCOM_NSTACK
source "net/smartcom/nstack/fi/Kconfig"
config HW_NSTACK_MINTP
       tristate "Huawei NSTACK MinTP layer2 Reliable Transmission Protocol"
       depends on HW_SMARTCOM_NSTACK
       default n
endif # if HW_SMARTCOM_NSTACK
```

## kernel/kernel/linux-5.10-lts/net/smartcom/nstack/fi/Kconfig
```kconfig
config HW_NSTACK_FI
	bool "Huawei NSTACK FI"
	depends on HW_SMARTCOM_NSTACK
	default n
```

## kernel/kernel/linux-5.10-lts/net/smartcom/schedule_driver/Kconfig
```kconfig
config HUAWEI_SCHEDULE_DRIVER
	bool "Huawei schedule_driver feature support"
	default n
```

## kernel/kernel/linux-5.10-lts/platform_source/ai/drivers/npu/Kconfig
```kconfig
menu "NPU Driver Configuration"

config NPU_DRIVER
	tristate "NPU_DRIVER"
	default n

-source "platform_source/ai/drivers/npu/nkd/Kconfig"
-source "platform_source/ai/drivers/npu/npd/Kconfig"
-source "platform_source/ai/drivers/npu/pcie/Kconfig"
-source "platform_source/ai/drivers/npu/bbit_debugfs/Kconfig"
-source "platform_source/ai/drivers/npu/load_ts/Kconfig"

config NPU_OHOS
	tristate "NPU_OHOS"
	default n

endmenu
```

## kernel/kernel/linux-5.10-lts/platform_source/audio/Kconfig
```kconfig
menu "audio Kernel Configuration"

AUDIO_DRIVERS_SRC_PATH := $(if-success,[ "$(BUILD_CDC_RDA)" = "true" ],platform_source/audio/rda/ldk,platform_source/audio/drivers)

menuconfig SND_SOC_PLATFORM
	bool "Enable ASoC platform drivers"
	depends on SND_SOC
	default y
	help
	Say yes here to support ASoC platform drivers

if SND_SOC_PLATFORM
source "platform_source/audio/sound/Kconfig"
endif

source "$(AUDIO_DRIVERS_SRC_PATH)/Kconfig"

endmenu
```

## kernel/kernel/linux-5.10-lts/platform_source/audio/drivers/Kconfig
```kconfig
if SND_SOC_PLATFORM
source "platform_source/audio/drivers/da_combine_dsp/Kconfig"
endif

source "platform_source/audio/drivers/hifi_dsp/Kconfig"
source "platform_source/audio/drivers/hifi_mailbox/Kconfig"
source "platform_source/audio/drivers/soundtrigger/Kconfig"
source "platform_source/audio/drivers/soc_mad/Kconfig"
source "platform_source/audio/drivers/rdr/Kconfig"

if SYS_PM_STR
endif
```

## kernel/kernel/linux-5.10-lts/platform_source/audio/drivers/hifi_dsp/Kconfig
```kconfig
menu "Hifimisc driver serve HIFI dsp"

config HIFI_DSP_ONE_TRACK
     bool "hifi low power play device support"
     select SND_HWDEP
     help
          hifi lpp device provide service for HIFI and AP, in case of HIFI ultra-low power audio play.
config HIFI_MEMORY_21M
    bool "hifi memory is 21M"
    help
         hifi memory is 21M
config HIFI_MEMORY_15M
    bool "hifi memory is 15M"
    help
         hifi memory is 15M
config DSP_VAD_WAKEUP
    bool "4mic 4ec vad wakeup"
    help
         4mic 4ec vad wakeup
config 2MIC_LP_WAKEUP
    bool "2mic lp wakeup"
    help
         2mic lp wakeup
config SOCDSP_CMA_SIZE_7M
    bool "socdsp cma size 7M"
    help
         socdsp cma size 7M
config AUDIO_DEBUG
    bool "support audio debug function"
    help
        support audio debug function
config HIFI_EXTRA_MODEM_MODE
    bool "support a+b function"
    help
        support a+b function
config HIFI_RESET_CDEV
    bool "support hifi reset cdev"
    help
        support hifi reset cdev
config HIFI_SUPPORT_VIBRATOR
    bool "support transfer vibrator data"
    help
        support transfer vibrator data
config DP_MULTI_CHANNELS
    bool "support dp audio multi channels"
    help
        support dp audio multi channels
config HIFI_SECOS_LOAD
        tristate "Support secos load hifi"
        default n
        help
          Enables secos load hifi.
config HIFI_NPU_ROUTE
    bool "hifi npu route support"
    default n
    help
        hifi npu route.
config HIFI_SPATIAL_AUDIO_SUPPORT
    bool "hifi spatial audio support"
    help
        hifi spatial audio.
config RDA_AUDIO
    bool "audio funcs for CDC RDA support"
    help
        audio funcs for CDC RDA.
config HIFI_EXTEND_MISC
    bool "hifi extend misc support"
    default n
    help
        hifi extend misc.
config HIFI_AUDIO_NN_SUPPORT
    bool "hifi audio nn support"
    default n
    help
        hifi audio nn.
config HIFI_HISTEN_OFFLOAD
    bool "hifi histen offload support"
    default n
    help
        hifi histen offload.
config UPLOAD_CHANNEL_COUNT
    int "upload channel count"
    default 1
    help
        upload channel count
config AUDIO_HIBERNATION_V2
    bool "audio hibernation s4 v2 support"
    default n
    help
        DSP security and non-security ddr buffer are freezed and restored in ATF during S4 hibernation.
config HIFI_OHOS
    bool "hifi ohos"
    help
        hisi ohos.
source "platform_source/audio/drivers/hifi_dsp/voice_proxy/Kconfig"
endmenu
```

## kernel/kernel/linux-5.10-lts/platform_source/audio/drivers/soc_mad/Kconfig
```kconfig
config SOC_MAD
	tristate "audio mad support"

source "platform_source/audio/drivers/soc_mad/mad_extension/Kconfig"
```

## kernel/kernel/linux-5.10-lts/platform_source/audio/drivers/soundtrigger/Kconfig
```kconfig
config SOUND_TRIGGER
	tristate "Support for sound trigger"
	default n
	help
	 Say Y here if you want to support sound trigger
config SND_SOC_THIRD_CODEC
	tristate "Support third codec for sound trigger"
	default n
	help
	Say Y here if you want to support third codec for sound trigger
config HIFI_WATCH_WAKEUP
	tristate "Support hifi watch wakeup for sound trigger"
	default n
	help
	Say Y here if you want to support watch wakeup for sound trigger
```
