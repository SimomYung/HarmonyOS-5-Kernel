## kernel/kernel/linux-5.10-lts/platform_source/basicplatform/drivers/nvme_crypto/Kconfig
```kconfig
# SPDX-License-Identifier: GPL-2.0

config NVME_CRYPTO
	tristate "nvme crypto support"
	depends on HISI_FALLBACK_ENCRYPTION
	default y
	help
	  config nvme crypto driver
```

## kernel/kernel/linux-5.10-lts/platform_source/basicplatform/drivers/onewire/Kconfig
```kconfig
# SPDX-License-Identifier: GPL-2.0

config HS_ONEWIRE
	tristate "hisi onewire master"
	help
	  If you say yes to this option, support will be included for the
	  onewiire common code on some plat.
	  Only master mode is supported.

config ONEWIRE_V100_MASTER
	tristate "ONEWIRE_V100 MASTER"
	depends on HS_ONEWIRE
	help
	  If you say yes to this option, support will be included for the
	  onewire adapter on some plat.

config ONEWIRE_HIPHYIO_MASTER
	tristate "ONEWIRE_HIPHYIO MASTER"
	depends on HS_ONEWIRE && CONTEXTHUB_IO_DIE_HIPHYIO
	help
	  If you say yes to this option, support will be included for the
	  onewire adapter on some plat.
```
