## kernel/kernel/linux-5.10-lts/platform_source/audio/drivers/str/Kconfig
```kconfig
config STR_NOTIFY_DSP
	tristate "entry or exit STR mode will notify dsp"
	default n
	help
	  STR mode status will notify dsp.
```

## kernel/kernel/linux-5.10-lts/platform_source/audio/rda/ldk/common_image/Kconfig
```kconfig
config AUDIO_COMMON_IMAGE
        tristate "audio common image feature support"
        help
          Say y to enable audio common image feature for audio

config HISI_VOICE_NVPARAM_SUPPORT_EXP
        tristate "hisi voice nv param expand support"
        help
          Say y to enable audio common image feature for audio
```

## kernel/kernel/linux-5.10-lts/platform_source/audio/sound/soc/codecs/Kconfig
```kconfig
config SND_SOC_DA_COMBINE_V3
	tristate "Support Sound SoC DA combine v3 Codec"
	depends on DA_COMBINE_V3_CODEC

config SND_SOC_DA_COMBINE_V5
	tristate "Support Sound SoC DA combine v5 Codec"


config SND_SOC_DP_AUDIO
	tristate "Support Sound SoC DP audio"

# Supported au pa

config SND_SOC_CODEC_DA_SEPARATE_V2
	tristate "Soc Smartstar Codec DA separate v2 support"

config SND_SOC_CODEC_DEBUG
	bool "Codec debug support"

config SND_SOC_ASP_CODEC
	tristate "Soc Smartstar asp codec"

config SND_SOC_ASP_CODEC_CODECLESS
	tristate "Soc Smartstar asp codec for codecless support"

config SND_SOC_ASP_CODEC_ANA
	tristate "Soc Smartstar asp codec for ana support"

config DISABLE_REGULATOR_WHEN_RUNTIME_SUSPEND
	tristate "disable asp regulator when runtime_suspend"

config AUDIO_SR_NO_RESOURCE_OPERATION
	tristate "Audio suspend and resume no resource operation"

# Support codecless series audio ana codec
source "platform_source/audio/sound/soc/codecs/vendor/asp_codec_ana/Kconfig"

# Supported da separate codecs
```

## kernel/kernel/linux-5.10-lts/platform_source/audio/sound/soc/codecs/vendor/asp_codec_ana/Kconfig
```kconfig
source "platform_source/audio/sound/soc/codecs/vendor/asp_codec_ana/platform/asp_codec_ana_v7/Kconfig"
source "platform_source/audio/sound/soc/codecs/vendor/asp_codec_ana/platform/asp_codec_ana_v8/Kconfig"
```

## kernel/kernel/linux-5.10-lts/platform_source/audio/sound/soc/codecs/vendor/asp_codec_ana/platform/asp_codec_ana_v8/Kconfig
```kconfig
config SND_SOC_ASP_CODEC_ANA_V8
	tristate "HI Soc Smartstar Codec codec_ana_v8 support"
```

## kernel/kernel/linux-5.10-lts/platform_source/basicplatform/drivers/bootdevice/Kconfig
```kconfig
menu "Bootdevice"

config BOOTDEVICE
        bool "Support multiple bootdevice, eMMC or UFS"
        default n
        help
          Used to dynamic select boot device from eMMC or UFS

config STORAGE_LOW_POWER_INTERFACE
        bool "Support userspace storage low power interface"
        default n
        help
          Say yes here to enable userspace storage low power interface

endmenu
```

## kernel/kernel/linux-5.10-lts/platform_source/basicplatform/drivers/clk/extreme/Kconfig
```kconfig
config CLK_ALWAYS_ON
	bool "all clocks of Soc are always on"
	default n

config CLK_PM_MONITOR
	bool "clock pm_monitor spec"
	default n

config VM_CLK
	depends on PLAT_CLK
	bool "clk driver support vm"
	default n

config VM_CLK_DEV
	depends on PLAT_CLK
	bool "clk driver support rda vm dev"
	default n

config CLK_MAILBOX_SUPPORT
	depends on PLAT_CLK
	depends on IPC_MAILBOX
	bool "clk driver support mailbox communication"
	default n

config CKM_MODULE
	depends on PLAT_CLK
	bool "clk monitor driver"
	default n

config CLK_SMC_SUPPORT
	depends on PLAT_CLK
	bool "clk SMC handler"
	default n

config PLL_LOCK_RETRY
	depends on PLAT_CLK
	bool "clk pll lock retry"
	default n

config MCLK_SUPPORT
	depends on CLK_MAILBOX_SUPPORT
	bool "mclk support in phoe CDC"
	default n

config PLL_UNLOCK_DETECT
	depends on PLAT_CLK
	bool "pll clk unlock detect"

config CLK_BUCK13_DVS
	bool "buck13 dvs feature"
	default n

config FSM_PPLL_VOTE
	depends on PLAT_CLK
	bool "clk ppll fsm vote"
	default n

config CLOCK_SUPPORT_FFA
	depends on PLATDRV_SUPPORT_FFA
	bool "clock support ffa"
	default n
	help
	 clock support ffa or not.

config CLK_PLATFORM
	string "CLK platform name parameter"
	default ""
	depends on IP_PLATFORM_UNIFICATION
	help
	  This driver provides system interior bus switch for the CLK on the system.

source "platform_source/basicplatform/drivers/clk/extreme/dvfs/Kconfig"
source "platform_source/basicplatform/drivers/clk/extreme/debug/Kconfig"
```

## kernel/kernel/linux-5.10-lts/platform_source/basicplatform/drivers/clk/extreme/suspend/Kconfig
```kconfig
config CLK_HIBERNATION
	depends on PLAT_CLK
	bool "clock hibernation suspend-resume"
	default n
```

## kernel/kernel/linux-5.10-lts/platform_source/basicplatform/drivers/common_ctrl/Kconfig
```kconfig
config COMMON_CTRL
	bool "common ctrl module support"
	default n
 
config WHITELIST_CHECK_STRONG_POLICY
  bool "whitelist check use strong policy or not"
  default n
 
config WHITELIST_CHECK_FAIL_TO_REBOOT
  bool "whitelist check fail to reboot"
  default n
```

## kernel/kernel/linux-5.10-lts/platform_source/basicplatform/drivers/dma-buf/Kconfig
```kconfig
source "platform_source/basicplatform/drivers/dma-buf/heaps/Kconfig"
source "platform_source/basicplatform/drivers/dma-buf/mm/Kconfig"
source "platform_source/basicplatform/drivers/dma-buf/dmabuf_reclaim/Kconfig"
source "platform_source/basicplatform/drivers/dma-buf/dmabuf_reclaim_dev/Kconfig"
source "platform_source/basicplatform/drivers/dma-buf/pa_offset/Kconfig"
```

## kernel/kernel/linux-5.10-lts/platform_source/basicplatform/drivers/dma-buf/dmabuf_reclaim/Kconfig
```kconfig
config DMABUF_SWAP
    bool "dmabuf swap"
    depends on DMABUF_HEAPS
    help
      Choose this option to enable dmabuf swap of System Heap.
      To store or resume the memory data from the UFS.

config DMABUF_RECLAIM
    bool "dmabuf reclaim"
    select ION_FAULT
    depends on DMABUF_HEAPS
    help
      Choose this option to enable Dmabuf Reclaim of System Heap.
      Reclaiming and restoring

config DMABUF_RECLAIM_TEST
    bool "dmabuf reclaim test"
    depends on DMABUF_RECLAIM
    help
      Choose this option to enable Dmabuf test program.
```

## kernel/kernel/linux-5.10-lts/platform_source/basicplatform/drivers/dma-buf/heaps/Kconfig
```kconfig
config DMABUF_HEAPS_SECSG
	bool "DMA-BUF Secsg Heap"
	depends on DMABUF_HEAPS
	select DMABUF_MM
	help
	  Choose this option to enable the secsg dmabuf heap. The secsg heap
	  can init many heaps and is backed by cma allocate. If in doubt, say Y.

config DMABUF_HEAPS_SECSG_IRIS_SUPPORT_CAMERA
	bool "DMA-BUF Secsg Heap iris support camera allocate"
	depends on DMABUF_HEAPS_SECSG
	help
	  Choose this option to enable the camera allocate mem from secsg dmabuf
	  iris heap. If in doubt, say Y.

config DMABUF_HEAPS_SECCG
	bool "DMA-BUF Seccg Heap"
	depends on DMABUF_HEAPS
	select DMABUF_MM
	help
	  Choose this option to enable the seccg dmabuf heap. The seccg heap
	  can init many heaps and is backed by cma allocate. If in doubt, say Y.

config TRANSPARENT_HUGEPAGE_DEVICE
	bool "DMA-BUF cma huge Heap"
	depends on DMABUF_HEAPS
	select DMABUF_MM
	help
	  Choose this option to enable the cma huge dmabuf heap.

config DMABUF_HEAPS_CPA
	bool "DMA-BUF CPA Heap"
	depends on DMABUF_HEAPS
	select DMABUF_MM
	help
	  Choose this option to enable the cpa dmabuf heap. The cpa heap
	  is backed by pages from the buddy allocator. If in doubt, say Y.

config DMABUF_HEAPS_CPA_SIZE_OPTIMIZE
	bool "DMA-BUF CPA Size Optimize"
	depends on DMABUF_HEAPS
	select DMABUF_MM
	help
	  Choose this option to enable the cpa dmabuf heap size change.
	  If in doubt, say Y.

config DMABUF_HEAPS_DMA_POOL
	bool "DMA-BUF DMA POOL Heap"
	depends on DMABUF_HEAPS
	select DMABUF_MM
	help
	  Choose this option to enable the dma_pool dmabuf heap. The dma_pool heap
	  is backed by pages from the cma allocator. If in doubt, say Y.

config DMABUF_HEAPS_CARVEOUT
	bool "DMA-BUF CARVEOUT Heap"
	depends on DMABUF_HEAPS
	select DMABUF_MM
	help
	  Choose this option to enable the carveout dmabuf heap. The carveout heap
	  is backed by pages from the reserved memory. If in doubt, say Y.

config MM_SECMEM_DRM_TEE_API_SUPPORT
	bool "DMA-BUF Heap DRM secure buffer tee map/unmap API support"
	depends on DMABUF_HEAPS
	help
	  Choose this option to support DRM secure buffer call TEE map/unmap in user TA at secure os.

config DMABUF_NPU_HUGE_POOL
	bool "DMA-BUF NPU Huge Pool"
	depends on DMABUF_HEAPS && DMABUF_MM
	default n
	help
	  Choose this option to enable the npu dmabuf huge pool in system heap.
	  The npu huge buffer alloc pages from this huge pool first.

config DMABUF_HEAPS_SYSTEM_BATCH
	bool "DMA-BUF System Heap Batch"
	depends on DMABUF_HEAPS_SYSTEM
	default n
	help
	  Choose this option to enable the system heap support batch.
	  If in doubt, say Y.

config DMABUF_HEAPS_SYSTEM_MULTI_WMARK
	bool "DMA-BUF System Heap Multi Watermark"
	depends on DMABUF_HEAPS_SYSTEM
	default n
	help
	  Choose this option to enable the system heap support multi watermark.
	  If in doubt, say Y.

config DMABUF_HEAPS_TEST
	bool "DMA-BUF HEAP TEST Support"
	depends on DMABUF_HEAPS
	select DMABUF_MM
	help
	  DMA-BUF HEAP TEST Support.

config DMABUF_HEAPS_SYSTEM_NOTIFY
	bool "DMA-BUF System Heap Notify"
	depends on DMABUF_HEAPS_SYSTEM
	default n
	help
	  Choose this option to enable the system dmabuf heap support notify chain.
	  If in doubt, say Y.

config DMABUF_POOL_RESIZE
	bool "DMA-BUF System Heap Resize"
	depends on DMABUF_HEAPS_SYSTEM
	default n
	help
	  Choose this option to enable the system dmabuf heap pool resize.
	  If in doubt, say N.

config DISABLE_FLUSH_ALL_CPUS_CACHES
	bool "DISABLE FLUSH_ALL_CPUS_CACHES"
	default n
	help
	  Choose this option to disable the xxx_flush_all_cpus_caches.

config MM_EBIT_SUPPORT
	bool "Support 4K CPA Heap memory alloc"
	depends on DMABUF_HEAPS_CPA
	help
	  CPA HEAP can alloc 4K page for configuring EBIT signals on the page table to
	  implement encryption and decryption.
```

## kernel/kernel/linux-5.10-lts/platform_source/basicplatform/drivers/gpio/Kconfig
```kconfig
# SPDX-License-Identifier: GPL-2.0

config GPIO_HIV500
	bool "PrimeCell HIV500 GPIO support"
	depends on ARM_AMBA
	select IRQ_DOMAIN
	select GPIOLIB_IRQCHIP
	help
	  Say yes here to support the PrimeCell HIV500 GPIO device

config GPIO_HIV500_VM
	bool "PrimeCell HIV500 GPIO VM support"
	depends on ARM_AMBA
	select IRQ_DOMAIN
	select GPIOLIB_IRQCHIP
	help
	  Say yes here to support the PrimeCell HIV500 GPIO VM device

config GPIO_HI6502
	bool "HI6502 GPIO support"
	depends on GPIO_PL061
	help
	  Say yes here to support the HI6502 GPIO device

config GPIO_PL061_VM
	bool "HI Virtual GPIO support"
	depends on GPIO_PL061
	default n
	help
	  Say yes here to support the virtual gpio

config GPIO_HI9030
	bool "HI9030 GPIO support"
	depends on GPIOLIB
	select IRQ_DOMAIN
	select GPIOLIB_IRQCHIP
	default n
	help
	  Say yes here to support the HI9030 GPIO device

config GPIO_HIPHYIO
	bool "HI9030 HIPHYIO GPIO support"
	depends on GPIOLIB
	select IRQ_DOMAIN
	select GPIOLIB_IRQCHIP
	default n
	help
	  Say yes here to support the HI9030 GPIO device

config GPIO_SUPPORT_IOMCU
	bool "HIV500 GPIO support IOMCU"
	depends on GPIOLIB
	select IRQ_DOMAIN
	select GPIOLIB_IRQCHIP
	default n
	help
	  Say yes here to support the HIV500 IOMCU GPIO

config GPIO_IRQ_DUMP
	bool "HIV500 GPIO irq dump"
	depends on GPIOLIB
	select IRQ_DOMAIN
	select GPIOLIB_IRQCHIP
	default n
	help
	  Say yes here to support the HIV500 GPIO IRQ info DUMP

config GPIO_VALUE_DEBUG
	bool "HIV500 GPIO support debug GPIO028 for modem"
	depends on GPIO_HIV500
	default n
	help
	  Say yes here to support the gpio debug
```

## kernel/kernel/linux-5.10-lts/platform_source/basicplatform/drivers/hisi_typec/Kconfig
```kconfig
config KIRIN_TYPEC
	bool "Kirin USB Typei-C Driver"
	help
	  Say Y to enable Kirin USB Typec Driver

config KIRIN_TYPEC_DBG
	bool "Kirin USB Type-C driver verbost debug infomation."
	depends on KIRIN_TYPEC
	help
	  Say Y here if you want verbost debug infomation. If unsure, say N.

source "platform_source/basicplatform/drivers/hisi_typec/hisi_tcpc/Kconfig"
```

## kernel/kernel/linux-5.10-lts/platform_source/basicplatform/drivers/hisi_typec/hisi_tcpc/Kconfig
```kconfig
if KIRIN_TYPEC

config KIRIN_TCPC
	bool "Hisilicon TypeC Port Controller Device"
	help
	  Say Y to enable Hisilicon Typec Port Controller Driver

config KIRIN_TCPC_HI6526
	bool "Hisilicon hi6526 Type-C Port Controller support"
	default n
	help
	  Say Y to enable Hisilicon hi6525 support

config KIRIN_TYPEC_CAP_DBGACC_SNK_SUPPORT
	bool "DebugAccessory sink support"
	default n
	help
	  Debug Accessory sink support.

config KIRIN_TYPEC_CAP_CUSTOM_SRC_SUPPORT
	bool "Custom SRC support"
	default n
	help
	  Custom SRC support

config KIRIN_TCPC_VSAFE0V_DETECT_SUPPORT
	bool "TCPC Vsafe0V detect support"
	default n
	help
	  TCPC Vsafe0V detect support

config KIRIN_POWER_DELIVERY_SUPPORT
	bool "Hisilicon Power Delivery Support"
	help
	  Support PD using hisi tcpc.

config KIRIN_USB_PD_ALT_MODE_SUPPORT
	bool "Alternate Mode support"
	default n
	help
	  Alternate Mode support

config KIRIN_USB_PD_ALT_MODE_DFP_SUPPORT
	bool "Alternate Mode DFP support"
	default n
	help
	  Alternate Mode DFP support

config KIRIN_USB_PD_UVDM_SUPPORT
	bool "USB PD Unstructed VDM support"
	default n
	help
	  USB PD Unstructed VDM support

config KIRIN_USB_PD_CUSTOM_DBGACC_SUPPORT
	bool "Custom Debug Accessory support"
	default n
	help
	  Custom Debug Accessory support

config KIRIN_PD_REV30
	bool "PD REV30"
	depends on KIRIN_TCPC
	depends on KIRIN_POWER_DELIVERY_SUPPORT
	default n
	help
		PD REV30

config KIRIN_PD_REV30_PPS_SINK
	bool "sink pps feature of PD REV30"
	depends on KIRIN_TCPC
	depends on KIRIN_POWER_DELIVERY_SUPPORT
	depends on KIRIN_PD_REV30
	default n
	help
		sink pps feature of PD REV30

endif
```

## kernel/kernel/linux-5.10-lts/platform_source/basicplatform/drivers/i3c/Kconfig
```kconfig
# SPDX-License-Identifier: GPL-2.0-only
config I3C_V100_DESIGNWARE
	tristate "Synopsys DesignWare of i3c"
	depends on HAVE_CLK
	select DW_I3C_MASTER
	help
	  If you say yes to this option, support will be included for the
	  Synopsys DesignWare I3C master on platform.
	  Only master mode is supported.

config I3C_V200_MASTER
	tristate "i3c v200 master"
	depends on I3C
	help
	  If you say yes to this option, support will be included for the
	  I3C V200 master on platform.
	  Only master mode is supported.
```

## kernel/kernel/linux-5.10-lts/platform_source/basicplatform/drivers/improve_yield/Kconfig
```kconfig
config IMPROVE_YIELD
	bool "improve yield driver"
	default n
	help
		Say 'Y' here if you want to use improve yield driver
```

## kernel/kernel/linux-5.10-lts/platform_source/basicplatform/drivers/mmc_wrapper/Kconfig
```kconfig
config MMC_WRAPPER
	bool "mmc wrapper"
	depends on LIBLINUX
	default n
	help
	  this select mmc wrapper for ldk & udk
```

## kernel/kernel/linux-5.10-lts/platform_source/basicplatform/drivers/mntn/dfx_efr/Kconfig
```kconfig
config DFX_EFR
	bool "DFX EFR"
	default n
	help
		Say 'Y' here if you want to use enable dfx efr stimulate
```

## kernel/kernel/linux-5.10-lts/platform_source/basicplatform/drivers/mntn/dfx_sh/Kconfig
```kconfig
config DFX_SH
	bool "DFX sh driver"
	default n
	help
		Say 'Y' here if you want to use enable dfx sh

config DFX_SH_DDR
	bool "DFX sh ddr driver"
	default n
	help
		Say 'Y' here if you want to use enable dfx sh ddr
```

## kernel/kernel/linux-5.10-lts/platform_source/basicplatform/drivers/mntn/powerkey_reboot/Kconfig
```kconfig
config MNTN_POWERKEY_REBOOT
	bool "powerkey reboot support"
	default n
	depends on LIBLINUX
	help
	  Say yes here to support powerkey reboot
```

## kernel/kernel/linux-5.10-lts/platform_source/basicplatform/drivers/nvme/Kconfig
```kconfig
config NVME_WRAPPER
	bool "nvme wrapper"
	depends on LIBLINUX
	default n
	help
	  this select nvme wrapper for ldk & udk
```
