## kernel/kernel/linux-5.10-lts/platform_source/basicplatform/drivers/pci/controller/phy/Kconfig
```kconfig
#
# Kirin PCIe driver configuration
#

config HIPCIE_KPHY
	tristate "HiPCIe kphy"
	depends on HIPCIE_PHY
	help
	  Say Y here to enable PCIe kphy support on Kirin SoCs.

config HIPCIE_COMBPHY
	tristate "HiPCIe combphy"
	depends on HIPCIE_PHY
	help
	  Say Y here to enable PCIe combphy support on Kirin SoCs.

config HIPCIE_XWPHY
	tristate "HiPCIe xwphy"
	depends on HIPCIE_PHY
	help
	  Say Y here to enable PCIe xwphy support on Kirin SoCs.
```

## kernel/kernel/linux-5.10-lts/platform_source/basicplatform/drivers/power/platform/coul/Kconfig
```kconfig
config COUL_DRV
        bool "pmic coul"
        default n

config COUL_TEST
        bool "coul test"
        default n

config COUL_ALGORITHM_CORE
        bool "coul algorithm"
        default n

config COUL_NVME_MANAGER
        bool "coul nvmanager"
        default n

config COUL_MERGE_BIGDATA
        bool "coul merge bigdata"
        default n

config COUL_UUC
        bool "coul uuc enable"
        default n

source "platform_source/basicplatform/drivers/power/platform/coul/coul_core/Kconfig"
```

## kernel/kernel/linux-5.10-lts/platform_source/basicplatform/drivers/spi/Kconfig
```kconfig
# SPDX-License-Identifier: GPL-2.0-only

config SPI_V400
	bool "Using spi_pl022 extra added code"

config SPI_V400_TIMEOUT_LOG
	bool "for spi v400 dma logcat"
	depends on SPI_V400
	help
	  If you say yes to this option, will show spi v400 timeout log.

config SPI_V500_MASTER
	tristate "SPI_V500 controller"
	help
	  If you say yes to this option,support will be inclued for spi
	  controller on v500.

config SPI_V500_VM
	tristate "SPI_V500 controller vm"
	depends on SPI_V500_MASTER
	help
	   If you say yes to this option,support will be inclued for spi
	   controller on v500 vm.

config SPI_DMA_DIFF
    bool "Spi dma offset diff"
    depends on SPI_V500_MASTER
    default n
```

## kernel/kernel/linux-5.10-lts/platform_source/camera/drivers/Kconfig
```kconfig
menu "driver Configuration"

source "platform_source/camera/drivers/ivp/Kconfig"
source "platform_source/camera/drivers/arpp/Kconfig"
source "platform_source/camera/drivers/rda/Kconfig"

if MEDIA_NATIVE_SUPPORT
source "platform_source/camera/drivers/media/native/Kconfig"
endif

endmenu
```

## kernel/kernel/linux-5.10-lts/platform_source/camera/drivers/media/native/camera/hisp/hisp120/Kconfig
```kconfig
comment "MODULE ISP"

choice
	prompt "HISP Version"
	default KERNEL_CAMERA_USE_HISP120
	depends on KERNEL_CAMERA
	help
        Select ISP version.

config KERNEL_CAMERA_USE_HISP120
	bool "HISP120"
	depends on KERNEL_CAMERA

config KERNEL_CAMERA_ISPV120_A
    tristate "Support histar ispv120_A driver"
    depends on KERNEL_CAMERA_USE_HISP120
    default n

endchoice
```

## kernel/kernel/linux-5.10-lts/platform_source/camera/drivers/media/native/camera/hisp/hisp600/Kconfig
```kconfig
comment "MODULE ISP"

choice
	prompt "HISP Version"
	default KERNEL_CAMERA_USE_HISP600
	depends on KERNEL_CAMERA
	help
        Select ISP version.

config KERNEL_CAMERA_USE_HISP600
	bool "HISP600"
	depends on KERNEL_CAMERA

endchoice
```

## kernel/kernel/linux-5.10-lts/platform_source/camera/drivers/rda/Kconfig
```kconfig
config CAMERA_VM_CTRL
    bool "camera vm control"
    default n
    help
        This config controls camera on the system.

config CAM_SENSOR_VM_DEV
    bool "camera sensor vm support"
    default n
    help
        This driver provides camera sensor vm on the system.

config IDI2AXI_VM_DEV
    bool "idi2axi vm support"
    default n
    help
        This driver provides idi2axi vm on the system.
```

## kernel/kernel/linux-5.10-lts/platform_source/cee/Kconfig
```kconfig
menu "cee Kernel Configuration"

source "platform_source/cee/drivers/Kconfig"
source "platform_source/cee/kernel/sched/Kconfig"

config KERNEL_CODEMERGE
	bool "enable CodeMerge in kernel"
	default n
	help
	  Improve the kernel performance by using compiler optimization.
	  CodeMerge includes these compiler passes:PGO, Function Reorder,
	  Hot-Cold Split and Unplt.
	  It is a feature based on profiling data and needs to update when
	  version of kernel changes.

config KERNEL_CODEMERGE_ENTRY_INSTR
	bool "enable Entry instrumentation feature in kernel"
	depends on KERNEL_CODEMERGE
	default n
	help
	  Different from the common instrumentation, the entry instrumentation
	  ensures that instrumentation is performed at the entry of a function.
	  Therefore, the entry instrumentation can records more accurate
	  runtime information.
	  Note that the compilation time may be prolonged after this feature
	  is enabled.
	  If this feature is enabled, CodeMerge will use another profdata.
	  This feature can be enabled only if KERNEL_CODEMERGE is enabled.

config KERNEL_CODEMERGE_MFS
	bool "enable MFS feature in kernel"
	depends on KERNEL_CODEMERGE
	default n
	help
	  Improve Hot-Cold Split to Machine Function Split. This is a more
	  efficient way to separate hot and cold sections without adding
	  redundant instructions.
	  Because this feature is based on profiling data, it can be enabled
	  only if KERNEL_CODEMERGE is enabled.
endmenu
```

## kernel/kernel/linux-5.10-lts/platform_source/cee/drivers/adc/Kconfig
```kconfig
config LPM_HKADC
	bool "LPM ADC support"
	depends on IPC_MAILBOX
	default n
	help
	  Say yes here to support the LPM ADC device

config HKADC_DEBUG
	tristate "ADC DEBUG"
	help
	  Say yes here to support this lock

config IODIE_HKADC
	bool "IODIE ADC support"
	depends on CONTEXTHUB_IO_DIE_HIPHYIO
	default n
	help
	  Say yes here to support the IODIE ADC device

config IODIE_HKADC_DEBUG
	tristate "IODIE ADC DEBUG"
	help
	  Say yes here to support this lock
```

## kernel/kernel/linux-5.10-lts/platform_source/cee/drivers/cpu_hwp_ctrl/Kconfig
```kconfig
menu "cpu hwp ctrl"
config CPU_HWP_CTRL
	bool "cpu hwp ctrl"
	default n
	help
	 support cpu hwp ctrl

config CPU_HWP_CTRL_DEBUG
	bool "cpu hwp ctrl debug"
	depends on CPU_HWP_CTRL
	default n
	help
	 support cpu hwp ctrl for debug

endmenu
```

## kernel/kernel/linux-5.10-lts/platform_source/cee/drivers/ddrc/big_model_monitor/Kconfig
```kconfig
config BIG_MODEL_MONITOR
	bool "big model monitor"
	default n
	help
	  big model monitor driver
```

## kernel/kernel/linux-5.10-lts/platform_source/cee/drivers/gp/Kconfig
```kconfig
config GP
	bool "Global Predictor"
	default n
	help
	 support gp device and enable driver
```

## kernel/kernel/linux-5.10-lts/platform_source/cee/drivers/gpufreq/Kconfig
```kconfig
menu "GPUFREQ Options"

config GPUFREQ
    tristate "GPUFREQ Driver"
    depends on ARCH_PLATFORM && PM_DEVFREQ
    select PM_OPP
    help
      This enables the gpufreq driver.

config GPUFREQ_INDEPDENT
    tristate "NEW GPUFREQ Driver"
    depends on ARCH_PLATFORM && PM_DEVFREQ
    select PM_OPP
    help
      This enables the gpufreq driver.

config GPUFREQ_HW_VOTE
	bool "Enable hardware vote gpu freq feature"
	depends on GPUFREQ_INDEPDENT && HW_VOTE
	default n
	help
	  enable hardware vote gpu freq feature

config GPU_FHSS
    tristate "GPU Frequency-Hopping Spread Spectrum Driver"
    depends on GPUFREQ
    help
      This enables the Frequency-Hopping Spread Spectrum of GPU feature.

config GPUTOP_FREQ
    tristate "GPUTOP Driver"
    depends on GPUFREQ
    help
      This enables the GPUTOP feature.

config GPUTOP_FREQ_DEBUG
    tristate "GPUTOP Driver debug"
    depends on GPUTOP_FREQ
    help
      This enables the GPUTOP debug feature.

config GPUFREQ_VOTE
    tristate "GPUFREQ Vote Driver"
    depends on GPUFREQ_INDEPDENT
    help
      This enables the GPUFREQ vote drvier feature.

config GPUFREQ_USER_VOTE
    tristate "GPUFREQ Vote User Space interface"
    depends on GPUFREQ_VOTE
    help
      This enables the GPUFREQ vote User Space interface feature.

config FRAME_WINDOW_GPUFREQ
    bool "Frame Window Aware GPUFREQ"
    default n
    depends on FRAME_WINDOW
    help
      This enables the GPUFREQ polling_interval dynamically by frame window size

config GPUFREQ_FREQ_HIDE
    bool "Freq-Info Hide"
    default n

config FREQ_HIDE_GPU
    int "Freq hide for gpu"
    default 747000000
    depends on GPUFREQ_FREQ_HIDE

config FREQ_SHOW_GPU
    int "Freq show for gpu"
    default 750000000
    depends on GPUFREQ_FREQ_HIDE

config GPU_REMOVE_FREQ
    tristate "GPU remove freq"
    depends on GPUFREQ
    help
      This enables the gpu remove freq.

source "platform_source/cee/drivers/gpufreq/link/Kconfig"
source "platform_source/cee/drivers/gpufreq/guest/Kconfig"
endmenu
```

## kernel/kernel/linux-5.10-lts/platform_source/cee/drivers/heca/heca_v2/Kconfig
```kconfig
config HECA_V2_LTS
	bool "HECA_V2_LTS"
	default n
	help
	  Hisilicon Efficiency Control Algorithm version 2 lts
```

## kernel/kernel/linux-5.10-lts/platform_source/cee/drivers/mpam/Kconfig
```kconfig
menu "MPAM"
config MPAM
	depends on ARM64
	tristate "CPU MPAM ARMv8"
	help
	  MPAM Support for ARMv8.
	  For debugging issues having to do with stability and overall system
	  health, you should probably say 'Y' here.

config MPAM_POLICY
	depends on MPAM
	tristate "CPU MPAM POLICY"
	help
	  MPAM POLICY SUPPORT.

config MPAM_DEBUG
	depends on MPAM
	bool "MPAM debug"
	default n
	help
	  Say y if you want to use MPAM debug function.

config MPAM_MON_DEBUG
	depends on MPAM_DEBUG
	bool "MPAM debug"
	default n
	help
	  Say y if you want to use MPAM MON debug function.

config MPAM_CPBM_DEBUG
	depends on MPAM_DEBUG
	bool "MPAM debug"
	default n
	help
	  Say y if you want to use MPAM CPBM debug function.

config MPAM_QOS_DEBUG
	depends on MPAM_DEBUG
	bool "MPAM debug"
	default n
	help
	  Say y if you want to use MPAM QOS debug function.

config MPAM_UX_SPEEDUP_POLICY
	depends on MPAM_POLICY
	tristate "MPAM POLICY SYSCTL"
	help
	  MPAM POLICY SYSCTL.
endmenu
```

## kernel/kernel/linux-5.10-lts/platform_source/cee/drivers/pm/main/Kconfig
```kconfig
menu "S/R options for main function"

config SR_SYNC
	bool "The optimizes file synchronization in the SR process"
	depends on SR
	default n
	help
	  Optimizes file synchronization in the SR process

config PM_LPCTRL
	bool "ap kernel can control functions of sr in lpm3"
	depends on SR
	default n
	help
	  The ap kernel controls the sr function of lpm3

config SR_SWITCH_32K
	bool "Switch 32K clock source when the system is suspend or resume for more power saving"
	depends on PM_LPCTRL
	default n
	help
	  Switch 32K clock source

config SYS_PM_ULSR
	bool "ultra lowpower system suspend"
	depends on SR
	default n
	help
	  Ultra lowpower system suspend
config SYS_PM_DOZE
	bool "Support doze state"
	depends on SR
	default n
	help
	  Support doze state
config SYS_PM_DOZE_INDEPEND_VOTE
	bool "Support doze state"
	depends on SYS_PM_DOZE
	default n
	help
	  Support doze state independ control
config FORCE_SUSPEND
	bool "Force suspend"
	depends on SR
	default n
	help
	  Force suspend, ignor pm wakeup pending
config HM_SR_PHONE
	bool "Support HM SR for phone products only, but not for cdc"
	depends on SR
	default n
	help
	  Support HM SR for phone products only, but not for cdc

config SR_HIBERNATION_SUSPEND_TIME_OPP
	bool "S4 suspend time opp"
	default n
	help
	   suspend time opp
config SR_HIBERNATION_WATCHDOG
	bool "S4 suspend watchdog timeout adjust"
	default n
	help
	  Hibernation watchdog timeout
config SR_STAT_VOTE_IN_KERNEL
	bool "s3 lpm suspend state vote"
	depends on SR
	default n
	help
	   lpm suspend state vote

config S4_RESERVE_BIGCORE
	bool "Reserve big core as the primary cpu when hibernate"
	default n
	help
	   Reserve big core as the primary cpu when hibernate
config S4_SNAPSHOT_WITH_LZ4
	bool "Use LZ4 algorithm for Memory Snapshot compression/decompression"
	default n
	help
	  Default compression/decompression algorithm is LZO
config EXTEND_SYNC_TIMEOUT_FOR_CDC
	bool "Support extend sys_sync timeout for kirin990 cdc products only"
	default n
	help
	  Support extend sys_sync timeout for kirin990 cdc products only
config SYS_PM_STR
	bool "str for watch"
	depends on SR
	default n
	help
	  STR and AW Mode Switching
endmenu
```

## kernel/kernel/linux-5.10-lts/platform_source/cee/drivers/rtm/Kconfig
```kconfig
config RTM_DEBUG
	depends on ARM64 && DFX_DEBUG_FS
	bool "rtm"
	default n
	help
		Say y if you want to use rtm feature.

config RTM_DEBUG_EN_AVAILABLE
	depends on ARM64 && DFX_DEBUG_FS
	bool "rtm"
	default n
	help
		The debug_en function is available only when it is supported.
```

## kernel/kernel/linux-5.10-lts/platform_source/cee/drivers/smt_qos/Kconfig
```kconfig
menu "SMT-QOS Driver"

config PLATFORM_ARM64_SMT_QOS
    bool "enable SMT-QOS extension"
    default n
    help
      This enables the SMT-QOS driver.
endmenu
```
