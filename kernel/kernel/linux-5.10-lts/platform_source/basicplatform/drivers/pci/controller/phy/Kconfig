## kernel/kernel/linux-5.10-lts/platform_source/cee/drivers/thermal_platform/Kconfig
```kconfig
config IPA_THERMAL
	tristate "Temperature sensor on ARM SoC based on THERMAL_TSENSOR interface (IPA)"
	depends on THERMAL_TSENSOR
	depends on CPU_FREQ
	depends on OF
	select THERMAL_POWER_ACTOR_CPU
	help
	  Support for the thermal sensor driver in the Linux thermal
	  framework.

config THERMAL_TSENSOR
	tristate "Thermal sensor driver"
	default n
	help
	  Enable this to plug the thermal sensor driver into the Linux
	  thermal framework

config LDK_THERMAL
	tristate "LDK thermal driver"
	depends on IPA_THERMAL
	default n
	help
	  Enable this to use LDK thermal driver
	  thermal framework

config THERMAL_SUPPORT_SMT
	tristate "thermal support smt driver"
	depends on IPA_THERMAL
	default n
	help
	  Enable this to use thermal smt driver
	  thermal framework

config FREQ_LIMIT_THERMAL
	tristate "Ipa cluster0 freq limit"
	depends on IPA_THERMAL
	default n
	help
	  Enable this to limit cluster0 freq
	  thermal framework

config THERMAL_TSENSOR_GET_TEMP
	tristate "Thermal sensor driver with temp value"
	depends on THERMAL_TSENSOR
	default n
	help
	  Enable this to plug the thermal sensor driver into the Linux
	  thermal framework which get temperature directly
 
config THERMAL_SUPPORT_FFA
	tristate "Thermal sensor driver support ffa"
	depends on THERMAL_TSENSOR
	depends on PLATDRV_SUPPORT_FFA
	default n
	help
	  Enable this to support ffa interface

config THERMAL_PERIPHERAL
	tristate "Peripheral thermal driver"
	default n
	help
	  Enable this to plug the peripheral thermal sensor driver into the Linux
	  thermal framework

config THERMAL_PERIPHERAL_HIGHRESTEMP
	bool "High resolution thermal format for peripheral thermal driver"
	depends on THERMAL_PERIPHERAL
	default n
	help
	  Enable this to use hi-resolution temperature format for PERIPHERAL thermal.

config THERMAL_CONTEXTHUB
	bool "Contexthub thermal driver"
	default n
	help
	  Enable Contexthub Thermal

config THERMAL_SPM
	bool "Sustainable performance mode"
	depends on IPA_THERMAL
	default n
	help
	  Enable sustainable performance mode

config GPU_IPA_THERMAL
	bool "Gpu ipa thermal support"
	depends on IPA_THERMAL
	default n
	help
		Enable gpu ipa thermal

config THERMAL_HOTPLUG
	bool "Thermal hotplug support"
	depends on HOTPLUG_CPU
	default n
	help
	  Enable thermal hotplug

config THERMAL_GPU_HOTPLUG
	bool "Thermal gpu hotplug support"
	depends on THERMAL_HOTPLUG
	default n
	help
	  Enable gpu thermal hotplug

config THERMAL_NPU_HOTPLUG
	bool "Thermal npu hotplug support"
	depends on THERMAL_HOTPLUG
	default n
	help
	  Enable npu thermal hotplug

config THERMAL_ISP_HOTPLUG
	bool "Thermal isp hotplug support"
	depends on THERMAL_HOTPLUG
	default n
	help
	  Enable isp thermal hotplug

config HOTPLUG_EMULATION
	bool "Thermal hotplug emulation support"
	depends on THERMAL_HOTPLUG
	default n
	help
	  Enable thermal hotplug emulation

config THERMAL_TRIP
	bool "Trip point for thermal zone"
	depends on THERMAL_TSENSOR
	depends on THERMAL_PERIPHERAL

	default n
	help
	  Enable trip point for thermal zone

config THERMAL_SHELL
	bool "Shell temp calculation"
	depends on THERMAL_PERIPHERAL
	default n
	help
	  Enable shell temp calculation

config SHELL_TEMP_DEBUG
	bool "Shell temp debug configuration"
	depends on THERMAL_SHELL
	default n
	help
	  Enable debug node for shell temp calculation

config THERMAL_AMBIENT
	bool "Ambient temp calculation"
	depends on THERMAL_PERIPHERAL
	depends on COUL_DRV
	default n
	help
	  Enable ambient temp calculation

config THERMAL_NPU
	bool "Npu thermal contral"
	depends on THERMAL_GOV_STEP_WISE
	depends on THERMAL_TSENSOR
	default n
	help
		Enable npu thermal contral

config THERMAL_GOV_INTERVAL_CTRL
	bool "interval_ctrl thermal governor"
	help
	  Enable this to manage platform thermals using temperature intervals

config THERMAL_GOV_DYNAMIC_INTERVAL_CTRL
	bool "dynamic interval_ctrl thermal governor"
	depends on THERMAL_GOV_INTERVAL_CTRL
	depends on THERMAL_SHELL
	default n
	help
	  Enable this to manage platform thermals using temperature intervals

config THERMAL_NPU_V2
	bool "Npu thermal contral by interval governor"
	depends on THERMAL_GOV_INTERVAL_CTRL
	depends on THERMAL_TSENSOR
	default n
	help
	  Enable npu thermal contral

config THERMAL_BOOST_BYPASS
	bool "boost bypass"
	depends on IPA_THERMAL
	default n
	help
	  Enable boost bypass

config THERMAL_IPA_OTHER_POWER
	bool "ipa other power"
	depends on IPA_THERMAL
	default n
	help
	  Enable ipa other power

config THERMAL_EX_SUSTAIN_POWER
	bool "ipa ex sustain power calc"
	depends on IPA_THERMAL
	default n
	help
	  Enable ipa ex sustain power

config THERMAL_FAN
	bool "Fan thermal control"
	depends on THERMAL_GOV_STEP_WISE
	depends on THERMAL_TSENSOR
	default n
	help
	  Enable fan thermal control

config THERMAL_OPP_TABLE_V2
	bool "opp_table v2"
	depends on IPA_THERMAL
	default n
	help
	  Enable opp table v2

config THERMAL_PERCORE
	bool "per core"
	depends on IPA_THERMAL
	depends on LDK_THERMAL
	default n
	help
	  Enable percore

config HKADC_MODEM
	bool "Hkadc modem temp"
	default n
	help
	  Enable hkadc modem temp

config ITS
	bool "ITS driver"
	default n
	help
	  Enable this to enable ITS driver

config ITS_DEBUG
	bool "ITS driver debug message"
	depends on ITS
	default n
	help
	  Enable this to print debug power message for ITS driver

config ITS_IPA
	bool "IPA using ITS/DPM power data"
	depends on IPA_THERMAL
	depends on ITS
	depends on DPM_HWMON
	default n
	help
	  Use ITS/DPM power during IPA calculate power.

config IPA_MNTN_INFO
	bool "ipa maintain info"
	depends on IPA_THERMAL
	default n
	help
	  Enable Ipa maintain info record

config THERMAL_MNTN_DMD
	bool "thermal maintain info dmd"
	depends on IPA_THERMAL
	default n
	help
	  Enable Thermal maintain info dmd record

config IPA_LIMIT_RESET
	bool "ipa limit reset"
	depends on IPA_THERMAL
	default n
	help
	  Enable Ipa limit reset

config IPA_CPU_EM_PWR
	bool "ipa use em pwr"
	depends on IPA_THERMAL
	default n
	help
	  Enable Ipa em power

config TSENS_TEMP_SAPPHIRE
	bool "sapphire temp calu"
	depends on THERMAL_TSENSOR
	default n
	help
	  Enable temp calu for sapphire

config THERMAL_ISOLATE
	bool "Thermal isolate support"
	depends on THERMAL_HOTPLUG
	default n
	help
	  Enable thermal isolate

config THERMAL_WEIGHT
	bool "Update thermal ipa weight"
	depends on IPA_THERMAL
	default n
	help
	  Enable thermal weight Update mode

config THERMAL_SOC_SHELL
	bool "enable soc-shell thermal joint optimization"
	depends on IPA_THERMAL
	depends on THERMAL_SHELL
	default n
	help
	  Enable soc-shell thermal joint optimization

config OPT_IPA_THERMAL
	bool "enable optimal ipa thermal"
	depends on IPA_THERMAL
	depends on SCHED_RUNNING_TASK_ROTATION
	default n
	help
	  Enable optimal ipa thermal

config OHOS_THERMAL
	bool "optimal ohos thermal sysfs node"
	depends on IPA_THERMAL
	default n
	help
	  Enable thermal zone sysfs optimal

config LDK_THERMAL_INTELLIGENT
	bool "ldk thermal intelligent freq ctrl"
	depends on LIBLINUX
	depends on IPA_THERMAL
	default n
	help
	  Enable shell_frame thermal intelligent freq ctrl

source "platform_source/cee/drivers/thermal_platform/hw_dpm/Kconfig"
```

## kernel/kernel/linux-5.10-lts/platform_source/cee/drivers/trace/Kconfig
```kconfig
menu "platform trace worker Options"
config PLATFORM_TRACE_WORKER
	bool "platform trace worker enable"
	default n
	help
		platform trace worker enable.

endmenu
```

## kernel/kernel/linux-5.10-lts/platform_source/display/Kconfig
```kconfig
menu "display Kernel Configuration"

DISPLAY_KCONFIG_PATH := $(if-success,[ "$(BUILD_CDC_RDA)" = "true" ],platform_source/display/drivers/cdc_rda,platform_source/display/drivers)
source "$(DISPLAY_KCONFIG_PATH)/Kconfig"

endmenu
```

## kernel/kernel/linux-5.10-lts/platform_source/display/drivers/dpu_drm/Kconfig
```kconfig
config DPU_DRM
	tristate "DRM Support for Hisi DPU SoC Platform"
	depends on DRM && OF && ARM64 && DPU_COMPOSER
	select DRM_KMS_HELPER
	select DRM_GEM_CMA_HELPER
	select DRM_KMS_CMA_HELPER
	select DRM_MIPI_DSI
	select DRM_PANEL
	help
	  Choose this option if you have a hisi dpu chipsets.
	  If M is selected the module will be called dpu_drm.

config DPU_COMPOSER
	tristate "Dpu composer driver support"
	depends on DRM && OF && ARM64 && DPU_OPR_MGR
	select DRM_KMS_HELPER
	select DRM_GEM_CMA_HELPER
	select DRM_KMS_CMA_HELPER
	select DRM_MIPI_DSI
	select DRM_PANEL
	help
	  This feature driver supports dpu composer device driver.

config DPU_MIPI_DSI
	tristate "Hisi DPU MIPI-DSI Controller Support"
	select DRM_MIPI_DSI
	help
	  Choose this option if you want have an Hisi Dpu SoC with
	  MIPI-DSI support. If M is selected the module will be called
	  dpu_mipi_dsi.

config DPU_PANEL
	tristate "DPU panel support"
	depends on OF
	depends on DRM_MIPI_DSI
	depends on BACKLIGHT_CLASS_DEVICE
	help
	  Say Y here if you want to enable support for TFT-LCD modules.

config DPU_OPR_MGR
	tristate "Hisi Dpu operator manager support"
	help
	  Say Y here if you want to enable support for Hisi Dpu operator manager.

config DPU_CMDLIST
	tristate "Hisi Dpu cmdlist support"
	help
	  Say Y here if you want to enable support for Hisi Dpu cmdlist.

config DPU_DEBUG_ENABLE
	tristate "DPU debug info"
	default y if DPU_MIPI_DSI
	help
	  Say y here if you want show debug info

config DPU_DRM_GEM
	tristate "Hisi DPU drm support GEM memory manager"
	depends on DPU_DRM
	help
	  It is mainly responsible for displaying the allocation and release of buffer,
	  and it is also the only place where GPU uses DRM, directly dealing with physical buffer,
	  linking fb and physical buffer

config DPU_DRM_BRIDGE
	tristate "Dpu DRM bridge driver support"
    default y
	help
	  This feature driver supports dpu composer device driver.

config DRM_DSS_IOMMU
	tristate "Enable dss iommu"
	default n
	help
	  Choose this option if you have a need dss iommu support.

config DPU_FFA_SUPPORT
	tristate "Hisi Dpu support ffa"
	depends on PLATDRV_SUPPORT_FFA
	default n
	help
	  Hisi Dpu support ffa or not.

config DPU_DKSM
	tristate "Hisi DPU drm support DP dksm"
	default y
	help
		This feature driver supports dp dksm

config DPU_CONN_MANAGER
	tristate "Hisi DPU drm support DP MANAGER"
	depends on DPU_DKSM
	default n
	help
		This feature driver supports dp manager driver

config DP_DSC
	tristate "Hisi DPU drm support DP DSC"
	depends on DPU_DKSM
	default n
	help
		This feature driver supports dp dsc

config DPU_DP_CTRL
	tristate "Hisi DPU drm support DP ctrl"
	depends on DPU_DKSM
	default n
	help
		This feature driver supports dp ctrl

config DPU_HDCPTX
	tristate "Hisi DPU drm support DP HDCPTX"
	default y
	help
		This feature driver supports dp hdcptx
		
config DPU_DRM_DP
	tristate "Hisi DPU drm support DP"
	depends on DPU_DKSM
	default n
	help
		This feature driver supports dp driver
source "platform_source/display/drivers/dpu_drm/heap/Kconfig"
```

## kernel/kernel/linux-5.10-lts/platform_source/display/drivers/video/akmd/Kconfig
```kconfig
config AKMD_ENABLE
	bool "AKMD driver support"
	default n
	help
	  This feature driver supports akmd driver.

config AKMD_AAE_VERSION
	int "AKMD AAE version"
	depends on AKMD_ENABLE
	help
	  This driver supports AAE version

config AKMD_AAE_RES_MGR
	bool "AKMD aae resource manager"
	default n
	help
	  This feature supports aae resource manager

config AKMD_AAE_DEVICE
	bool "AKMD aae device"
	default n
	help
	  This feature supports aae device

config AKMD_AAE_OHOS
	bool "akmd aae ohos adapter feature switch"
	default n
	help
	  ohos adapter features be opened by setting y

source "drivers/video/fbdev/akmd/aksm/Kconfig"
```
