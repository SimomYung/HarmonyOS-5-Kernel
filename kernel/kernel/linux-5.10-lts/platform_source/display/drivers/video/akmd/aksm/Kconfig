## kernel/kernel/linux-5.10-lts/platform_source/display/drivers/video/akmd/aksm/Kconfig
```kconfig
config AKMD_AKSM
	bool "AKMD aksm driver support"
	default n
	help
	  This feature supports aksm driver

config AKMD_DEBUG_ENABLE
	bool "AKMD debug enable"
	default n
	depends on AKMD_AKSM
	help
	  This feature supports debug config

config AKMD_ASSERT_ENABLE
	bool "AKMD assert enable"
	default n
	depends on AKMD_AKSM
	help
	  This feature supports assert enable
```

## kernel/kernel/linux-5.10-lts/platform_source/display/drivers/video/dkmd/mdfx/Kconfig
```kconfig
config MDFX_KMD
	tristate "hisi multimedia dfx"
	default n
	help
	  This is multimedia module dfx driver

config MDFX_KMD_ENG_MODE
	tristate "config mdfx kmd is eng mode or user mode"
	default n
	depends on MDFX_KMD
	help
		this is mdfx kmd driver eng mode or user mode

config MDFX_KMD_CALL_STACK
	bool "mdfx ohos adapter feature switch"
	default n
	help
	  ohos adapter features be opened by setting y
```

## kernel/kernel/linux-5.10-lts/platform_source/display/drivers/video/ukmd/uksm/Kconfig
```kconfig
config UKMD_UKSM
	bool "UKMD uksm driver support"
	default n
	help
	  This feature supports uksm driver

config UKMD_DEBUG_ENABLE
	bool "UKMD debug enable"
	default n
	depends on UKMD_UKSM
	help
	  This feature supports debug config

config UKMD_ASSERT_ENABLE
	bool "UKMD assert enable"
	default n
	depends on UKMD_UKSM
	help
	  This feature supports assert enable
```

## kernel/kernel/linux-5.10-lts/platform_source/ffrt_ohos/Kconfig
```kconfig
menu "FFRT Kernel Configuration"

-source "platform_source/ffrt_ohos/ffts/Kconfig"
-source "platform_source/ffrt_ohos/hts/Kconfig"
-source "platform_source/ffrt_ohos/uniform_id/Kconfig"

endmenu
```

## kernel/kernel/linux-5.10-lts/platform_source/see/drivers/cpusec_test/Kconfig
```kconfig
config EL3_PA_TEST
	bool "El3 PA Restriction feature test support"
	depends on HAVE_ARM_SMCCC
	default n
	help
          El3 PA Restriction test function

config BTI_TEST
	bool "bti test support"
	depends on HAVE_ARM_SMCCC
	default n
	help
          bti test function

config PAC_TEST
	bool "pac test "
	depends on HAVE_ARM_SMCCC
	default n
	help
	  pac test function

config FAC_TEST
	bool "fac test "
	depends on HAVE_ARM_SMCCC
	default n
	help
	  fac test function

config FGT_TEST
	bool "fgt test "
	depends on HAVE_ARM_SMCCC
	default n
	help
	  fgt test function

config PMU_RESTRICTION_TEST
	bool "pmu restriction test "
	depends on HAVE_ARM_SMCCC
	default n
	help
	  pmu restriction el3 test function
```

## kernel/kernel/linux-5.10-lts/platform_source/see/drivers/ddr_sec/Kconfig
```kconfig
menu "DDR SEC"

config SEC_REGION_MNTN
	bool "sec region mntn support"
	default n
	help
	  Say yes here to support sec region in kernel

endmenu
```

## kernel/kernel/linux-5.10-lts/platform_source/see/drivers/file_encry/Kconfig
```kconfig
config FILE_BASED_ENCRYPTO
	bool "FEB3 support"
	default n
	help
	  Say yes here to support the FBE3

config FBE3_1
	bool "FEB3_1 support with UFSC KM"
	depends on FILE_BASED_ENCRYPTO
	default n
	help
	  Say yes here to support the FBE3_1 ufsc KM

config FBE4_UECE_FOR_HM_FSCRYPTO
	bool "FEB4 for hm uece support"
	depends on FILE_BASED_ENCRYPTO
	default n
	help
	  Say yes here to support the FBE4 for hm uece

config FBE4_UECE_ENHANCE_FOR_HM_FSCRYPTO
	bool "FEB4 for hm uece enhance support"
	depends on FILE_BASED_ENCRYPTO
	default n
	help
	  Say yes here to support the FBE4 for hm uece enhance

config FBE_DE_DOUBLE_TO_SINGLE
	bool "FEB for double to single de user id has changed"
	depends on FILE_BASED_ENCRYPTO
	default n
	help
	  Say yes here to support the FBE for hm

config FILE_BASED_ENCRYPTO_FOR_HM_FSCRYPTO
	bool "FEB3 for fs crypto support"
	default n
	help
	  Say yes here to support the FBE3 for fs crypto

config FILE_BASED_ENCRYPTO_DBG
	bool "FEB3 debug support"
	depends on FILE_BASED_ENCRYPTO
	depends on DFX_DEBUG_FS
	default n
	help
	  Say yes here to support the FBE3 debug

config FBE_MSPC_ABSENT
	bool "FEB3 not to use MSPC"
	depends on FILE_BASED_ENCRYPTO
	default n
	help
	  Say yes here FBE3 not to use MSPC

config FBE_ARMPC
	bool "FEB3 armpc"
	depends on FILE_BASED_ENCRYPTO
	default n
	help
	  Say yes here to support armpc product

config FBE_FPGA
	bool "FEB3 FPGA mode"
	depends on FILE_BASED_ENCRYPTO
	default n
	help
	  Say yes here to adapt the FBE3 in FPGA

config FILE_BASED_ENCRYPTO_S4
	bool "FEB S4 related func"
	depends on HIBERNATION
	default n
	help
	  Say yes here to support the FBE S4 for hm

config FBE_DIRECT_RESTOREKEY
	bool "FBE3 direct restorekey"
	depends on FILE_BASED_ENCRYPTO
	default n
	help
	  Say yes here to support direct restorekey for hm

config FBE_ACCESS_CONTROL
	bool "FEB adapts access control sinking"
	depends on FILE_BASED_ENCRYPTO
	default n
	help
	  Say yes here to support the FBE ACCESS CONTROL for hm
```

## kernel/kernel/linux-5.10-lts/platform_source/see/drivers/kpu/Kconfig
```kconfig
config KPU_TEST
	bool "kpu test"
	default y
	help
		Say yes here to support kpu test in kernel
```

## kernel/kernel/linux-5.10-lts/platform_source/see/drivers/load_image/Kconfig
```kconfig
config LOAD_IMAGE
	bool "Support load sec_image"
	default n
	depends on TZDRIVER
	help
	  This driver supports LOAD SEC_IMAGE

config SECBOOT_BUFFER_FORM_PAGE
	bool "load image ohos"
	default n
	help
        Indicates ohos page enable.
```

## kernel/kernel/linux-5.10-lts/platform_source/see/drivers/module_update/Kconfig
```kconfig
config MODULE_UPDATE
	bool "Support module update"
	default n
	help
	module upate support
```

## kernel/kernel/linux-5.10-lts/platform_source/see/drivers/safety_island/Kconfig
```kconfig
config SAFETY_ISLAND
	bool "safety_island"
	default n
	help
	  safety_island driver

config SAFETY_ISLAND_ENG
	bool "safety_island_eng"
	default n
	help
	  safety_island eng test

config SAFETY_ISLAND_RDA_HEARTBEAT
	bool "safety_island_rda_heartbeat"
	default n
	help
	  The safety_island monitors the heartbeat of the RDA.
```

## kernel/kernel/linux-5.10-lts/platform_source/see/drivers/sec_auth_lib/Kconfig
```kconfig
config SEC_AUTH_LIB
	bool "secauth_img module support"
	default n
	depends on TZDRIVER
	help
	  This driver supports sec_auth
```

## kernel/kernel/linux-5.10-lts/platform_source/see/drivers/seplat/Kconfig
```kconfig
config SEPLAT
	bool "seplat"
	default n
	help
	  seplat driver

config SEPLAT_MNTN
	bool "seplat_mntn"
	depends on SEPLAT
	default n
	help
	  seplat maintain upload option

config SEPLAT_FMD_REPORT
	bool "seplat_fmd_report"
	depends on SEPLAT
	default n
	help
	  seplat fmd report big-data

config SEPLAT_TPM
	bool "seplat_tpm"
	depends on SEPLAT
	default n
	help
	  seplat tpm option
```

## kernel/kernel/linux-5.10-lts/platform_source/see/drivers/uvmm_load_boot/Kconfig
```kconfig
config UVMM_LOAD_BOOT
	bool "uvmm load boot img support"
	default n
	depends on TZDRIVER
	help
	  This driver supports load boot image
```

## kernel/kernel/linux-5.10-lts/platform_source/smart/drivers/bsp/Kconfig
```kconfig
config INPUTHUB_30
	bool "INPUTHUB_30"
	depends on  CONTEXTHUB
	help
	support INPUTHUB_30.

config SMART_WATCHDOG_V500
	bool "SMART WATCHDOG V500 support"
	depends on CONTEXTHUB
	default n
	help
	Enable support for watchdog v500 driver

config IPC_V5
	bool "IPC_V5"
	depends on  INPUTHUB_30
	help
	support IPC_V5.

config RISCV_DUMP_ADAPT
	bool "RISCV_DUMP_ADAPT"
	depends on  INPUTHUB_30
	default n
	help
	RISCV dump adapt

config BOX_RECOVERY
	bool "BOX_RECOVERY"
	depends on  INPUTHUB_30
	default n
	help
	support box recovery

config USER_DUMP_BUFFER
	bool "USER_DUMP_BUFFER"
	depends on  INPUTHUB_30
	default n
	help
	Use Dump Buffer

config CONTEXTHUB_LOAD_IOMCU_IMAGE
	bool "LOAD IOMCU IMAGE"
	depends on  INPUTHUB_30
	default n
	help
	support kernel load iomcu iamge

config WATCH_IOMCU_DUMP_TIME
	bool "WATCH_IOMCU_DUMP_TIME"
	depends on  INPUTHUB_30
	default n
	help
	support watch config dump time

config CONTEXTHUB_MNTN_STATUS_SAVELOG
	bool "CONTEXTHUB_MNTN_STATUS_SAVELOG support"
	depends on INPUTHUB_30
	default n
	help
	Enable support for CONTEXTHUB_MNTN_STATUS_SAVELOG load

config CONTEXTHUB_LPMCU_DUMP_LOG
	bool "CONTEXTHUB_LPMCU_DUMP_LOG"
	default n
	help
	save sensorhub log via lpmcu

config CONTEXTHUB_EXTRACT_DUMP_LOG
	bool "CONTEXTHUB_EXTRACT_DUMP_LOG"
	default n
	help
	extract sensorhub log and save

config CONTEXTHUB_IOMCU_IPC_SLAB
	bool "CONTEXTHUB_IOMCU_IPC_SLAB"
	default n
	help
	extract iomcu ipc slab
```

## kernel/kernel/linux-5.10-lts/platform_source/smart/drivers/channels/igs/Kconfig
```kconfig
config CONTEXTHUB_IGS
	tristate "intelligent gesture sensor driver"
	default n
	help
	Igs driver support aonn.

config CONTEXTHUB_IGS_DBG
	tristate "intelligent gesture sensor dbg drvier"
	default n
	help
	Igs debug drvier support aonn.

config CONTEXTHUB_IGS_20
	bool "intelligent gesture sensor 2.0"
	default n
	help
	  intelligent gesture sensor 2.0 config

config CONTEXTHUB_IGS_30
	bool "intelligent gesture sensor 3.0"
	default n
	help
	  intelligent gesture sensor 3.0 config

config CONTEXTHUB_IGS_SC_READ_BUFFER
	bool "intelligent gesture sensor support sc read buffer"
	default n
	help
	  Igs dev support scan code read buffer

config CONTEXTHUB_IGS_TOF
	tristate "intelligent gesture sensor tof"
	default n
	help
	Igs tof driver
config CONTEXTHUB_IGS_DBG_50
	bool "intelligent gesture sensor dbg for cpro"
	default n
	help
	Igs driver support aonn.
config CONTEXTHUB_IGS_TQM_SUPPORT_6_OUTPUT
	bool "intelligent gesture sensor tqm support 6 output"
	default n
	help
	Igs tqm driver support 6 output.
config CONTEXTHUB_IGS_VOLTAGE_CURE
	bool "intelligent gesture sensor support tiny voltage cure"
	default n
	help
	Igs driver support tiny voltage cure.
```

## kernel/kernel/linux-5.10-lts/platform_source/smart/drivers/channels/sdc/Kconfig
```kconfig
config SENSOR_DIRECT_CHANNEL
	bool "sensor direct channel support"
	depends on INPUTHUB_30
	default n
	help
	Say yes here to support the sensor direct channel

config SENSOR_DIRECT_CHANNEL_EXPAND
	bool "sensor direct channel expand 9 sensors"
	depends on SENSOR_DIRECT_CHANNEL
	default n
	help
	Say yes here to support the sensor direct channel expand

config SENSOR_DIRECT_CHANNEL_EXPAND_V1
        bool "sensor direct channel v1 expand 2 sensors"
        depends on SENSOR_DIRECT_CHANNEL
        default n
        help
        Say yes here to support the sensor direct channel expand v1
```

## kernel/kernel/linux-5.10-lts/platform_source/smart/drivers/channels/smart_lpc/Kconfig
```kconfig
config CONTEXTHUB_LPC
	bool "Smart LPC driver"
	default n
	help
	smart lpc driver support aios.
```

## kernel/kernel/linux-5.10-lts/platform_source/vcodec/vdec/Kconfig
```kconfig
menu "video vdec support"
config VCODEC_VDEC
    tristate "video decoder support"
    default n
    help
      This is the decoder driver

config VDEC_TVP_SUPPORT
    bool "Vdec vfmw tvp support"
    depends on VCODEC_VDEC
    default n

config LOAD_VDEC
	bool "Support load vdec image"
	default n
	depends on TZDRIVER
	help
	  This driver supports load vdec image

endmenu
```

## kernel/kernel/linux-5.10-lts/platform_source/vcodec/vdec/vdec_indep_rst/Kconfig
```kconfig
config VDEC_INDEP_RST_VM_CTRL
    bool "vdec indep rst vm control"
    default n
    help
        This config controls vdec indep rst on the system.
```

## kernel/kernel/linux-5.10-lts/samples/ldk/Kconfig
```kconfig
# SPDX-License-Identifier: GPL-2.0-only
config SAMPLE_LDK_EXTRA_HEAD
	bool "Link extra LDK source"
	default y
	help
	  Link extra LDK source with liblinux build.

config SAMPLE_LDK_EXTRALIBS
	string "Extra libraries for liblinux"
	depends on LIBLINUX
	default ""

config SAMPLE_LDK_TEST_KSYS
	bool "Test LDK ksys_* functions"
	default n

config LIBLINUX_BOOTFDT
	def_bool y

config LIBLINUX_REBOOT_ON_POWERKEY
	tristate "Reboot to bootloader when powerkey is pressed in a special pattern"
	depends on POWERKEY_SPMI
	default n

config LIBLINUX_UDK_UFS
	bool "Enable udk ufs"
	select LIBLINUX_UDK_MISC
	default n

config LIBLINUX_UDK_MISC
	bool "Enable udk misc"
	default n

config LIBLINUX_DEBUGFS
	bool "Enable liblinux debugfs extension support"
	depends on DEBUG_FS
	default n

if LIBLINUX_DEBUGFS
source "samples/ldk/debugfs/Kconfig"
endif

config LIBLINUX_MODULE_BINDER
	tristate "Enable binder module"
	default n

config BLK_DEV_SD_HELPER
	tristate "SCSI disk helper support"
	depends on SCSI
	depends on LIBLINUX_UDK_UFS
	help
	  This is a scsi disk helper module designed to export scsi proxy
	  device info.

config LIBLINUX_BATCH_UACCESS
	bool "Batch uaccess support"
	default n

config LIBLINUX_DEVFS_WORKAROUND
	bool "Workground for blue tooth hotplug"
	default n

config LIBLINUX_VB2_VMALLOC_WORKAROUND
	bool "Replace vmalloc with kmalloc as a workaround for videobuf2"
	depends on VIDEOBUF2_VMALLOC
	default n

config LIBLINUX_MEM_SHRINK
	bool "Enable liblinux mem shrink"
	default y

config LIBLINUX_BATTERY_WORKAROUND
	bool "Workground for pc battery"
	default n

config LIBLINUX_HMTRACEFS
	bool "Enable hongmeng tracefs"
	default n

config LIBLINUX_MIPSMEM_FREQ
	bool "Enable mips mem freq"
	default n

config LIBLINUX_CONFIGFS_EXT
	bool "Enable hongmeng configfs extension"
	default n
	help
	  Enable configfs extension, to support configfs usage by other
	  services, like hmdfs/sharefs.

config LIBLINUX_USE_LASTKLOG
	bool "Use lastklog for pstore"
	default n

config LIBLINUX_READ_MIDR_EL0
	bool "Enable reading MIDR register from EL0"
	default n

config LIBLINUX_USE_TRACK_INFO
	bool "Use track_info"
	default n

config HISI_INLINE_ENCRYPTION
  bool "Enable hisi inline encrypt"
  default n
```
