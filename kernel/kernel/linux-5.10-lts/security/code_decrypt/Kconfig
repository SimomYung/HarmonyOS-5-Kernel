## kernel/kernel/linux-5.10-lts/security/code_decrypt/Kconfig
```kconfig
# SPDX-License-Identifier: GPL-2.0-or-later
#
# Copyright (c) 2023 Huawei Device Co., Ltd.
#

config CODE_DECRYPT
	bool "Enable code decrypt support"
	default n
	help
	  This option provides support for code decrypt.
```

## kernel/kernel/linux-5.10-lts/security/container_escape_detection/Kconfig
```kconfig
config SECURITY_CONTAINER_ESCAPE_DETECTION
	bool "Enable container escape detection"
	default n
	depends on SECURITY_SELINUX
	help
	  Build support for container escape detection.
```

## kernel/kernel/linux-5.10-lts/security/device_threat_detection/Kconfig
```kconfig
#
# Copyright (c) Huawei Technologies Co., Ltd. 2022-2022. All rights reserved.
# Description: device threat detection kernel config
#

menu "kernel DTD"

config DEVICE_THREAT_DETECTION
	bool "enables device threat detection feature"
	default n
	help
	  This option enables feature for device threat detection in kernel
	  space. The device threat detection report device security status by
	  check the content of the kcode/syscall/rootprocs/syscall/sehooks
	  is tampered or not.

config DEVICE_THREAT_DETECTION_DEBUG
	bool "device threat detection debug mode"
	depends on DEVICE_THREAT_DETECTION
	default n
	help
	  This option should only be enabled for engineering mode & debug test.
	  In engineering or debug test mode, tester can enable the config and
	  use supported interface debug test interface.

endmenu
# a blank line must be existed
```

## kernel/kernel/linux-5.10-lts/security/kernel_sg/Kconfig
```kconfig
# SPDX-License-Identifier: GPL-2.0
#
# Copyright (c) Huawei Technologies Co., Ltd. 2022-2022. All rights reserved.
# Description: Huawei kernel sg configuration
# Cryptographic API Configuration
# Create: 2022-07-23
#

menu "Huawei KERNEL SG"

config HW_KERNEL_SG
	tristate "enables Huawei KERNEL SG"
	default n
	help
	  This option enables support for Huawei kernel sg in kernel space.
	  Huawei kernel sg is a threat perception module at kernel.
	  each source of threat can report the risk info to native throught the kernel sg

config HW_KERNEL_SG_ENG_DEBUG
	bool "Huawei KERNEL SG for engineering mode debug"
	depends on HW_KERNEL_SG
	default n
	help
	  This option should only be enabled for engineering mode & debug log.
	  In engineering mode, more debug info can be print.

endmenu
```

## kernel/linux-5.10-lts/arch/liblinux/Kconfig
```kconfig
# SPDX-License-Identifier: GPL-2.0-only
if "$(USE_HM_KERNEL)" = "true"
menuconfig LIBLINUX
	bool "Enable liblinux support"
	depends on ARM || ARM64 || UML
	default n
	select SET_FS
	select ARCH_NO_PREEMPT
	select ARCH_NO_SWAP
	select VENDOR_HOOKS
	select PREEMPT_COUNT
	select GENERIC_ALLOCATOR
	select GENERIC_STRNCPY_FROM_USER
	select GENERIC_STRNLEN_USER
	# spinlock
	select ARCH_USE_QUEUED_SPINLOCKS
	select LIBLINUX_USE_NATIVE_SPINLOCK
	# arch related
	select ARCH_HAS_GCOV_PROFILE_ALL
	select ARCH_HAS_PTE_SPECIAL
	select ARCH_HAS_SYSCALL_WRAPPER
	select ARCH_HAS_STRICT_MODULE_RWX
	select ARCH_HAS_SET_MEMORY
	select HAVE_PCI
	select GENERIC_CPU_AUTOPROBE
	select IPA_THERMAL
	select SECURITY
	select LIBLINUX_HVGR_POLL_OPT
	select LIBLINUX_DMA_CMA
	select LIBLINUX_HVGR_BATCH_SYNC_OPT

if LIBLINUX

config LIBLINUX_LOGLEVEL_DEFAULT
	int "default liblinux loglevel (1-8)"
	range 1 8
	default "7"
	help
	  Default liblinux loglevel. Only print logs with a loglevel lesser
	  than this value.

config LOG_ENCRYPT
  bool "encrypt panic log"
  default n

config LIBLINUX_VMEMMAP_IOFAST
	bool "Enable liblinux vmemmap using iofast memory"
	default y

config LIBLINUX_VMEMMAP_DEBUG
	bool "Enable liblinux vmemmap debug info"
	default n

config HM_HKIP_PRMEM
	bool "Enable hkip prmem"
	default n
	help
	  Hkip prmem interfaces of the HarmonyOS.

config HM_HKIP_SEHARMONY_PROT
	bool "Enable protection for SEHARMONY policy DB"
	depends on HM_HKIP_PRMEM
	help
	  Replace LDK protection interface with HarmonyOS interface.

config LIBLINUX_HMTRACE
	bool "Enable liblinux hmtrace support"
	default y

config GENERIC_CSUM
	def_bool y

config SMP
	def_bool y

config ARCH_SPARSEMEM_ENABLE
	def_bool y
	select SPARSEMEM_VMEMMAP_ENABLE

config HAVE_ARCH_PFN_VALID
	def_bool y

config LIBLINUX_OVERRIDE
    def_bool y

config LIBLINUX_HVGR_POLL_OPT
    def_bool n

config LIBLINUX_HVGR_BATCH_SYNC_OPT
    def_bool n

config HMKIP
	bool "Enable hm kernel integrity protect feature"
	depends on ARM64
	default n

config LIBLINUX_ASYNC_SYSFS
	bool "Enable asynchronous creation of sysfs nodes"
	depends on SYSFS
	default n

config LIBLINUX_KMAP_BITS
	int "Kernel mapping size"
	default 37 if 64BIT && !KASAN
	default 36 if 64BIT && KASAN
	default 27
	help
	  This option allows you to set the maximum physical memory support
	  by liblinux, 128MB for default.

config LIBLINUX_MODULES_RSVD_BITS
	int "Reserved modules size"
	default 27 if 64BIT
	default 25

config LIBLINUX_USE_NATIVE_SPINLOCK
	def_bool n

config LIBLINUX_DMA_CMA
	def_bool n

config LIBLINUX_HIBERNATE
	bool "Hibernation support"
	select HIBERNATION
	default n

# select GFP Allocator to use
choice
	prompt "GFP Allocator"
	default LIBLINUX_NATIVE_BUDDY

config LIBLINUX_SIMPLE_GFP
	bool "Simple GFP"
	help
	  This option use liblinux_page_allocator PAL APIs to allocate
	  pages from buddy.

config LIBLINUX_NATIVE_BUDDY
	bool "Linux-native Buddy"
	select MEMORY_HOTPLUG
	help
	  This option use linux-native buddy allocator for GFP.
endchoice

config LIBLINUX_UNIMPL_DFX_COUNT
	bool "Count unimpl functions"
	default n

config LIBLINUX_KERNEL_MODE_SIMD
	def_bool n
	select KERNEL_MODE_NEON if ARM || ARM64

config LIBLINUX_NET_STACK
	bool "Enable net stack support"
	default y
	select INET
	select NETFILTER
	select NF_CONNTRACK_LABELS
	select LIBLINUX_KERNEL_MODE_SIMD

config LIBLINUX_NO_HZ
	bool "Disable ticks on all CPUs except CPU 0"
	depends on NO_HZ_FULL
	default n

config LIBLINUX_PCP_FREE_FACTOR
	bool "Scale the number of pages that are batch freed from pcp to buddy"
	default n

config LIBLINUX_USER_INVAL_CACHE
	bool "Use flush cache at el0 instead of invalid cache at el1"
	default n

config OPT_TIMER_ENERGY_EFFICIENCY
	bool "Optimize timer users to be friendly for fcm idle (LIBLINUX version)"
	default n

config LIBLINUX_THREAD_BLOCK
	bool "Utilize thread block/unblock calls instead of futex"
	default n

config LIBLINUX_HAVE_ULSR
	bool "Enable liblinux ulsr support"
	default n

config LIBLINUX_MIPS_MEM_DEV_NUM
	int "mips mem device number"
	depends on LIBLINUX_MIPSMEM_FREQ
	default 6

config LIBLINUX_C_ASYNC_PROBE
	bool "Asynchronous probing for predefined drivers"
	default n

config LIBLINUX_ASYNC_END_IO
	bool "Asynchronous notification of fs io end"
	default y

config LIBLINUX_HVC_CALL
	bool "Enable hm kernel hvc call"
	depends on ARM64
	default n

config LIBLINUX_SKIP_TIMESYNC
	bool "Skip the first time sync to accelerate boot"
	default n

if !NAMESPACES
# NET_NS in linux depends on NAMESPACES, but now need enable NET_NS alone
config NET_NS
	bool "Enable net namespace"
	default n
endif # NAMESPACES

config DFX_LIBLINUX
        bool "dfx config for hm kernel build"
        default n
        help
          Say 'Y' in ohos kernel

config LIBLINUX_SYS_UNION_SHRINKER
	bool "Enable liblinux and sys union shrinker"
	default n
	help
	  Say 'Y' in ohos ldk

endif
endif
source "arch/liblinux/security/code_decrypt_hm/Kconfig"
```

## kernel/linux-5.10-lts/drivers/huawei_platform/echub/battery/Kconfig
```kconfig
#
# echub battery moudule
#

config ARMPC_ECHUB_BATTERY
        bool "echub battery"
        depends on ARMPC_ECHUB
        default n
        help
          This driver provides support for echub battery

config HW_ECHUB_CHARGER
        bool "ec charger"
        depends on ARMPC_ECHUB
        default n
        help
          This driver provides support for echub charger

config HW_ECHUB_CHARGEDATA
        bool "ec chargedata"
        depends on ARMPC_ECHUB_HMI
        default n
        help
          This driver provides support for echub chargedata

config HW_ECHUB_FLOAT_CHARGE
        bool "ec float charge"
        depends on ARMPC_ECHUB_BATTERY
        default n
        help
          This driver provides support for ec custom charge and smart charge

config HW_ECHUB_TURBO_CHARGE
        bool "ec turbo charge"
        depends on ARMPC_ECHUB_BATTERY
        default n
        help
          This driver provides support for ec turbo charge
```

## kernel/linux-5.10-lts/drivers/huawei_platform/echub/hmi/Kconfig
```kconfig
#
# hmi driver
#
 
config ARMPC_ECHUB_HMI
	bool "Echub hmi driver"
	depends on ARMPC_ECHUB
	default n
	help
	  This driver supports the hmi feature of EC or MCU.
```

## kernel/linux-5.10-lts/drivers/huawei_platform/edp/Kconfig
```kconfig
config HW_EDP_DRIVER
        bool "huawei EDP_DRIVER"
        depends on DKMD_DPU_DP
        default n
        help
            if you say yes here you get support for huawei EDP DRV.
```

## kernel/linux-5.10-lts/drivers/huawei_platform/usb/multi_port/cs32g050/Kconfig
```kconfig
#
# Cs32g050 Multi Port Driver
#
config CS32G050_MULTI_PORT
	bool "Cs32g050 Multi Port Driver"
	help
	  Say Y to enable Cs32g050 Multi Port Driver
```

## kernel/linux-5.10-lts/drivers/platform_drivers/modem/drv/heating_cal/Kconfig
```kconfig
config HEATING_CALIBRATION
	tristate "support heating calibration"
	default n
	help
	  modem heating_cal driver
```

## kernel/linux-5.10-lts/include/hwnet/fem/Kconfig
```kconfig
config HW_FEM_VOL_CONTROL
    tristate "kernel huawei wifi fem control voltage value"
    default n
    help
    This module adds control wifi fem voltage value
```

## kernel/linux-5.10-lts/kernel/hwqos_sched/Kconfig
```kconfig
config HW_QOS_SCHED
    bool "qos sched thread"
    default n
    help
      if set, qos thread is propagated by lock&binder, and picked first in lock's waitlist.
      The thread priority and min util can be set with the change of qos values.
```

## kernel/linux-5.10-lts/kernel/sched/rtg/Kconfig
```kconfig
menu "Related Thread Group"

config SCHED_RTG
	bool "Related Thread Group"
	depends on SCHED_WALT
	default n
	help
	  Set related threads into a group.

config SCHED_RTG_DEBUG
	bool "Related Thread Group DebugFS"
	depends on SCHED_RTG
	default n
	help
	  If set, debug node will show rtg threads

config SCHED_RTG_CGROUP
	bool "enable DEFAULT_CGROUP_COLOC RTG"
	depends on SCHED_RTG
	default n
	help
	  If set, support for adding the tasks which belong to
	  co-located cgroup to DEFAULT_CGROUP_COLOC RTG.

config SCHED_RTG_FRAME
	bool "Frame-based Related Thread Group"
	depends on SCHED_RTG
	default n
	help
	 Support frame-based related thread group scheduling.
	 If set, you can set the task to RTG and kernel will
	 statistic the load per frame.

config SCHED_RTG_TRANS
	bool "Frame-based Related Thread Group support trans"
	depends on SCHED_RTG_FRAME
	default n
	help
	 Support frame-based related thread group inherit.
	 If set, thread will be added to FrameRTG when it become
	 the blocker.

config SCHED_RTG_RT_THREAD_LIMIT
	bool "Limit the number of RT threads in groups"
	depends on SCHED_RTG_FRAME
	default n
	help
	  If set, limit the number of RT threads in frame RTG.

config RTG_RT_AUTO_SET
	bool "auto set threads policy when joining RTG"
	depends on SCHED_RTG_FRAME
	default n
	help
	  If set, auto set threads policy when joining RTG.

config RTG_RT_ACCOUNT
	bool "limit the number of new RT threads in signal frame RTG"
	depends on RTG_RT_AUTO_SET
	default n
	help
	  If set, limit the number of new RT threads in signal frame RTG.
endmenu
```

## kernel/linux-5.10-lts/platform_source/ai/drivers/npu/pcie/Kconfig
```kconfig
config NPU_PCIE
	tristate "NPU PCIE"
	depends on ARCH_PLATFORM
	default n
config NPU_UDP_FPGA_MIXED_PLAT
	tristate "npu verify in UDP+FPGA MIXED PLAT"
	depends on NPU_PCIE
	default n
```

## kernel/linux-5.10-lts/platform_source/basicplatform/Kconfig
```kconfig
menu "basicplatform Kernel Configuration"

config VENDOR_CHIP_PREFIX
    string "SOC chip prefix"
    help
        Indicates the chip prefix.

config VENDOR_CHIP_SUFFIX
    string "SOC chip suffix"
    help
        Indicates the chip suffix.

config SOC_PG_INFO
    bool "Get soc pg info"
    default n

source "platform_source/basicplatform/drivers/Kconfig"
source "platform_source/basicplatform/block/Kconfig"
source "platform_source/basicplatform/fs/Kconfig"
source "platform_source/basicplatform/kernel/Kconfig"
source "platform_source/basicplatform/mm/Kconfig"

endmenu
```

## kernel/linux-5.10-lts/platform_source/basicplatform/drivers/dma-buf/Kconfig
```kconfig
source "platform_source/basicplatform/drivers/dma-buf/heaps/Kconfig"
source "platform_source/basicplatform/drivers/dma-buf/mm/Kconfig"
source "platform_source/basicplatform/drivers/dma-buf/dmabuf_reclaim/Kconfig"
```

## kernel/linux-5.10-lts/platform_source/basicplatform/drivers/mntn/blackbox/platform_ap/Kconfig
```kconfig
config DFX_IRQ_REGISTER
	bool "record irq register"
	depends on DFX_BB
	default n
	help
	  This module can record irq register.

config DFX_REENTRANT_EXCEPTION
	bool "reentrant exception"
	depends on DFX_BB
	default n
	help
	  this module deal with reentrant exception.

config DFX_TIME_HOOK
	bool "support print time call trace "
	depends on DFX_BB
	default n
	help
	  Say 'Y' here if you want to print time call trace.

config DFX_EXC_INFO
	bool "support record exception information such as regs"
	default n
	help
	  Say 'Y' here if you want to record exception information

config OPTIMIZE_DFX_RINGBUFFER_WRITE
	bool "optimize ringbuffer write"
	default n
	help
	  this module optimze ringbuffer write

config LIBLINUX_REBOOT_WITH_SNAPSHOT
	bool "Reboot with snapshot printed in the HM kernel."
	depends on LIBLINUX
	default n

config DFX_CONTEXTHUB_LOG_SAVE
	bool "save contexthub log"
	default n
	help
	  this module save contexthub log

config DFX_PSCI_RESET
	bool "PSCI Reset"
	default n
	help
	  this option enables psci Reset

config DFX_EXPAND_AP_PANIC
	bool "support expand ap panic type"
	default n
	help
	  Say 'Y' here if you want to expand ap panic type
```

## kernel/linux-5.10-lts/platform_source/basicplatform/drivers/phy/Kconfig
```kconfig
# SPDX-License-Identifier: GPL-2.0-only
#
# PHY
#

source "platform_source/basicplatform/drivers/phy/hisilicon/Kconfig"

config PHY_HISI_USB2_T5
	tristate "USB2 PHY T5 support"
	select GENERIC_PHY
	select MFD_SYSCON
	help
	  Enable this to support the HISILICON USB2 T5 PHY.
	  To compile this driver as a module, choose M here.

config PHY_HISI_USB3_LITE
	tristate "HISI USB3 Lite PHY support"
	select GENERIC_PHY
	select MFD_SYSCON
	help
	  Enable this to support the HISILICON USB3 Lite PHY.
	  To compile this driver as a module, choose M here.

config PHY_USB2_HI6502
	tristate "USB2 HI6502 PHY support"
	select GENERIC_PHY
	select MFD_SYSCON
	help
	  Enable this to support the HISILICON USB2 Hi6502 PHY.
	  To compile this driver as a module, choose M here.

config PHY_USB2_EUSB
	tristate "USB2 Eusb PHY support"
	select GENERIC_PHY
	select MFD_SYSCON
	help
	  Enable this to support the HISILICON USB2 Eusb PHY.
	  To compile this driver as a module, choose M here.
config PHY_USB4_COMBOPHY
        tristate "USB4 COMBOPHY support"
        select GENERIC_PHY
        select MFD_SYSCON
        help
          Enable this to support the HISILICON USB4 Combo PHY.
          To compile this driver as a module, choose M here.
```

## kernel/linux-5.10-lts/platform_source/cee/drivers/cpu_intellisense/Kconfig
```kconfig
config CPU_INTELLISENSE
        bool "cpu_intellisense"
        depends on PHASE
        depends on PHASE_PERF
        default n
        help
          Note that use pmu informance to change cpu uarch configuration
config CPU_INTELLISENSE_DEBUG
        bool "cpu_intellisense_debug"
        depends on CPU_INTELLISENSE
        default n
        help
          Note that use pmu informance to change cpu uarch configuration debug
```
