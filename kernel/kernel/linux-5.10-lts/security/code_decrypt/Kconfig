## kernel/linux-5.10-lts/platform_source/cee/drivers/flo/Kconfig
```kconfig
config FLO
	bool "Frame learning Optimization"
	default n
	help
	 support flo device and enable driver

config FLO_DEBUG
	bool "flo debug"
	depends on FLO
	default n
	help
	 Enable flo debug

config FLO_TEST
	bool "flo test"
	depends on FLO && FLO_DEBUG
	default n
	help
	 Enable flo test
```

## kernel/linux-5.10-lts/platform_source/cee/drivers/mcuthermal_trace/Kconfig
```kconfig
config MCUTHERMAL_TRACE
	bool "show lpmcu thermal trace"
	default n
	help
	  Show the mcuthermal freq limit trace.
```

## kernel/linux-5.10-lts/platform_source/display/drivers/video/ukmd/Kconfig
```kconfig
config UKMD_ENABLE
	bool "UKMD driver support"
	default n
	help
	  This feature driver supports ukmd driver.

source "drivers/video/fbdev/ukmd/cmdlist/Kconfig"
source "drivers/video/fbdev/ukmd/uksm/Kconfig"
```

## kernel/linux-5.10-lts/platform_source/see/drivers/bl31_hibernate/Kconfig
```kconfig
config HISI_BL31_HIBERNATE
	bool "Hisilicon BL31 S4 Hibernate feature support"
	default n
	depends on HIBERNATION
	help
	---help---
	  This module supports the safe configuration or saving and recovery of
	  data for bl31 modules. Bl31 implements the saving and recovery
	  mechanism of S4 state, which is used by bl31 module.
	  If unsure, say N.
config BL31_HIBERNATE_V2
	bool "Hisilicon BL31 S4 Hibernate feature support for future"
	default n
	depends on HIBERNATION
	help
	---help---
	  This module is improved based on past module of HISI_BL31_HIBERNATE. 
	  Bl31 implements the saving and recovery mechanism of S4 state, 
	  which is used by bl31 module.
	  If unsure, say N.
config HISI_BL31_HIBERNATE_TEST
	bool "Hisilicon BL31 S4 Hibernate test support"
	default n
	depends on HISI_BL31_HIBERNATE
	help
	---help---
	  This module is designed to test bl31 hibernate feature.
	  If unsure, say N.
config BL31_HIBERNATE_RPMB_STORE
	bool "Hisilicon BL31 S4 Hibernate RPMB support"
	default n
	depends on HISI_BL31_HIBERNATE
	help
	---help---
	  This module is designed to store key with rpmb.
	  If unsure, say N.
config HIBERNATE_FORGERY_ATTACK_TEST
	bool "Hisilicon BL31 S4 Hibernate Forgery Attack test support"
	default n
	depends on BL31_HIBERNATE_V2
	help
	---help---
	  This module is designed to test bl31 hibernate feature for forgery attack.
	  If unsure, say N.
```
