## kernel/linux-5.10-lts/platform_source/smart/drivers/Kconfig
```kconfig
config CONTEXTHUB
	bool "Sensor CONTEXTHUB driver"
	default n
	help
	Sensor CONTEXTHUB driver.

config CONTEXTHUB_BOOT_STAT
	bool "sensorhub boot stat"
	depends on CONTEXTHUB
	default n
	help
	Say yes here if you want to record boot stat during sensorhub startup

config CONTEXTHUB_TZSP
	bool "sensorhub tzsp"
	depends on CONTEXTHUB && ARM_FFA_TRANSPORT
	default n
	help
	Say yes here if you want to use tzsp to send messages.

config CONTEXTHUB_SH_NOCZERO
	bool "Sensor CONTEXTHUB_SH_NOCZERO"
	default n
	help
	Sensor CONTEXTHUB_SH_NOCZERO

config CONTEXTHUB_DFX_NOCMID
	bool "Sensor CONTEXTHUB_DFX_NOCMID"
	default n
	help
	New platform has no MID, So you need to open this Kconfig.

config SECURITY_HEADER_FILE_REPLACE
	bool "Security header file Replacement"
	default n
	help
	If the kernel use the security header file information,
	you can say yes here and use DTS to obtain it.

config HEADER_FILE_REPLACE_EXTRACT
	bool "Security header file by extracting small file"
	default n
	help
	Extract macros only used by iomcu from soc_sctrl_interface,
	soc_syscounter_interface, iomcu_ddr_map, gloabal_ddr_map.

config CONTEXTHUB_MID_HEADER_FILE
	bool "use sensorhub mid header file"
	default n
	help
	If the kernel need to use the sensorhub mid header file,
	you can say yes here.

config SUPPORT_EXTEND_TAGS
	bool "sensorhub support more tags"
	depends on CONTEXTHUB
	default n
	help
	Say yes here if you want to extend more tags during sensorhub startup

config CONTEXTHUB_DSS_TRISTATEID  
	bool "CONTEXTHUB DSS TRISTATEID"
	default n
	help
	Added three state IDs for DSS

source "platform_source/smart/drivers/bsp/Kconfig"
source "platform_source/smart/drivers/channels/Kconfig"
source "platform_source/smart/drivers/syscounter/Kconfig"
```

## kernel/linux-5.10-lts/platform_source/smart/drivers/bsp/Kconfig
```kconfig
config INPUTHUB_30
	bool "INPUTHUB_30"
	depends on  CONTEXTHUB
	help
	support INPUTHUB_30.

config SMART_WATCHDOG_V500
	bool "SMART WATCHDOG V500 support"
	depends on CONTEXTHUB
	default n
	help
	Enable support for watchdog v500 driver

config IPC_V5
	bool "IPC_V5"
	depends on  INPUTHUB_30
	help
	support IPC_V5.

config RISCV_DUMP_ADAPT
	bool "RISCV_DUMP_ADAPT"
	depends on  INPUTHUB_30
	default n
	help
	RISCV dump adapt

config BOX_RECOVERY
	bool "BOX_RECOVERY"
	depends on  INPUTHUB_30
	default n
	help
	support box recovery

config USER_DUMP_BUFFER
	bool "USER_DUMP_BUFFER"
	depends on  INPUTHUB_30
	default n
	help
	Use Dump Buffer

config CONTEXTHUB_LOAD_IOMCU_IMAGE
	bool "LOAD IOMCU IMAGE"
	depends on  INPUTHUB_30
	default n
	help
	support kernel load iomcu iamge

config CONTEXTHUB_MNTN_STATUS_SAVELOG
	bool "CONTEXTHUB_MNTN_STATUS_SAVELOG support"
	depends on INPUTHUB_30
	default n
	help
	Enable support for CONTEXTHUB_MNTN_STATUS_SAVELOG load

config CONTEXTHUB_LPMCU_DUMP_LOG
	bool "CONTEXTHUB_LPMCU_DUMP_LOG"
	default n
	help
	save sensorhub log via lpmcu

config CONTEXTHUB_EXTRACT_DUMP_LOG
	bool "CONTEXTHUB_EXTRACT_DUMP_LOG"
	default n
	help
	extract sensorhub log and save

config CONFIG_CONTEXTHUB_LOG_LEVEL_INFO
	bool "CONFIG_CONTEXTHUB_LOG_LEVEL_INFO"
	default n
	help
	set contexthub log level to info when boot
```

## kernel/linux-5.10-lts/platform_source/vcodec/venc/Kconfig
```kconfig
menu "video venc support"
config VCODEC_VENC
      #depends on ANDROID_PMEM
      tristate "Support for venc"
      default n
      help
        The decode device provides venc function
config VCODEC_SECURE_VENC
      tristate "Vcodec support secure venc"
      default n

config LOAD_VENC
	bool "Support load venc image"
	default n
	depends on TZDRIVER
	help
	  This driver supports load venc image
endmenu
```

## kernel/linux-5.10-lts/samples/ldk/debugfs/Kconfig
```kconfig
# SPDX-License-Identifier: GPL-2.0-only
config LIBLINUX_DEBUGFS_BINDER
	bool "Enable debugfs binder"
	default n
config LIBLINUX_DEBUGFS_XPM
	bool "Enable debugfs xpm"
	default n
config LIBLINUX_DEBUGFS_COMPACTION
	bool "Enable hongmeng debugfs compaction"
	default n
```

## kernel/scripts/self_source/devhost/ldk_ext/Kconfig
```kconfig
# Copyright (c) Huawei Technologies Co., Ltd. 2021. All rights reserved.
# Description: Kconfig for devhsot
# Author: Huawei OS Kernel Lab
# Create: Fri Nov 19 11:26:07 2021
source "$(HMCMAKENG_KCONFIG)"

comment "Common Settings Inherited from kernel"

# fixed settings
config MODULE_SCHED_CLASS
	def_bool y
config TPPMGR
	def_bool y

# configurable settings
config AUDIT
	bool "audit support"
	default n

config COMPAT
	bool "Support for 32-bit applications at EL0"
	default n
config NO_COMPAT
	def_bool !COMPAT

config ILP32
	bool "Support for aarch64-ilp32 applications at EL0"
	default n
config NO_ILP32
	def_bool !ILP32

config POSIX_CAPS
	bool "posix caps support"
	default y

config PM_WAKELOCK
	bool "PM wakelock support"
	default n

config PM_SUSPEND
	bool "PM suspend support"
	default n

config PM_HIBERNATE
	bool "PM hibernate support"
	default n

config NET_IO_URING
	bool "net io uring support"
	default y

#
# Private configs for devhost only
#
comment "Private Settings for devhost only"

config DEVHOST_BLK_SRING_LEN
	int "max number of bd_io in a block queue"
	default 16

config BLK_INLINE_ENCRYPTION
	bool "Enable block inline encrypt"
	default n

config FILEGUARD
  bool "Enable file guard"
  default n
  help
    Enable file guard if available. This
    feature is only supported on PC.

config HISI_INLINE_ENCRYPTION
	bool "Enable hisi inline encrypt"
	default n

config NET_POOL_BITS
	int "net pool size"
	default 23

config NET_POOL_UNIT_BITS
	int "net unit size"
	default 12

config NET_FUSION
	bool "devhost support hmnetd in fusion mode"
	default n

config DEVHOST_NET_SPARSE_POOL
	bool "Support sparse net pool"
	default n

config DEVHOST_ENTROPY_COLLECT
	bool "Collect unstable system status as entropy"
	default y

#
# import common settings from legacy kconfig
#
source "Kconfig.common"

#
# devhost use ngbuild
#
config USE_DEVHOST_NGBUILD
	def_bool y

config SYSIF_TRACE
	bool "Enable sysif user event trace"
	default n

config SHMEC
  bool "Enable shared memory event channel"
  default n

config SEC_SERVICE
  bool "Enable security service response"
  default n

config SEHARMONY
  bool "Enable seharmony"
  select SEC_SERVICE
  default n

config HKIP
  bool "Enable HKIP Protection"
  default n

config NO_HKIP
  bool "disable ro after init segment"
  def_bool !HKIP

config HKIP_TEST_CASES
  bool "Enable hkip service test cases"
  depends on DEBUG_BUILD
  default n

config SECCOMP
  bool "Enable the secure computing feature"
  default n

choice
  prompt "devhost.elf use HMSecLib_static or HMSecLib_shared"
  default DEVHOST_USE_DYNAMIC_LINK
  config DEVHOST_USE_STATIC_LINK
    bool "devhost.elf use HMSecLib_static"
  config DEVHOST_USE_DYNAMIC_LINK
    bool "devhost.elf use HMSecLib_shared"
endchoice

config DEBUG_BUILD
  bool "Build kernel with debug mode"
  default n

config HMSD_TREND
  string "Security description generation trend"
  default "performance"


config DEVHOST_NET_QIPCRTR
	bool "devhost support QMI socket family"
	default y

config DEVHOST_NET_INET
	bool "devhost support INET socket family"
	default n

config DEVHOST_NET_NETLINK
	bool "devhost support NETLINK socket family"
	default n

config DEVHOST_NET_PACKET
	bool "devhost support PACKET socket family"
	default n

config DEVHOST_NET_INET6
	bool "devhost support INET6 socket family"
	default n

config DEVHOST_NET_PPPOX
	bool "devhost support PPPOX socket family"
	default n

config DEVHOST_NET_XDP
	bool "devhost support XDP socket family"
	default n

config DEVHOST_NET_KEY
        bool "devhost support AF_KEY socket family"
        default n

config DEVHOST_NET_ALG
	bool "devhost support AF_ALG socket family"
	default n

config NET_FUSION
	bool "devhost support hmnetd in fusion mode"
	default n

config NET_NS
	bool "devhost support net namespace"
	default n
```
